# DSPIC33FJ32MC102 register map
Vendor: Microchip
Architecture 33xxxx. Special function registers and configuration words.
Registers are 16-bit, read-write, reset 0x0 unless marked. A register's access mark holds for its fields unless they carry their own. Addresses are absolute, and some are shared; only a register's first bit layout is shown; lines under a group give offsets from that group; [hi:lo] are bit positions; {n}, {i} and the like mark numbered series; 'fields as' and 'values as' point back to an identical list; <NAME> marks a mode.

## Further device data
pins=1: MCLR; 2: RA0/CN2/CTED1/C1INA/C3INB/AN0/PGED2; 3: RA1/CN3/CTED2/C1INB/C3INA/AN1/PGEC2; 4: RB0/CN4/RP0/CTCMP/C1INC/C2INA/AN2/PGED1; 5: RB1/CN5/RP1/C1IND/C2INB/CVREFO/CVREFI/AN3/PGEC1; 6: RB2/CN6/RP2/C2INC/C3INC/AN4; 7: RB3/CN7/RP3/C2IND/C3IND/AN5; 8: RB10/CN16/RP10/PWM1H3/TDI; 9: VSS; 10: RA2/CN30/CLKI/OSC1; 11: RA3/CN29/CLKO/OSC2; 12: RB4/CN1/RP4/AN9/SOSCI/PGED3; 13: RA4/CN0/T1CK/AN10/SOSCO/PGEC3; 14: VDD; 15: RB5/CN27/RP5/ASDA1/FLTB; 16: RB6/CN24/RP6/ASCL1/FLTA; 17: RB7/CN23/RP7/INT0; 18: RB8/CN22/RP8/SCL1/TCK; 19: RB9/CN21/RP9/SDA1/TDO; 20: VSS; 21: VCAP; 22: RB11/CN15/RP11/PWM1L3/TMS; 23: RB12/CN14/RP12/PWM1H2; 24: RB13/CN13/RP13/PWM1L2; 25: RB14/CN12/RP14/RTCC/PWM1H1; 26: RB15/CN11/RP15/PWM1L1; 27: AVSS; 28: AVDD, interrupts=0 INT0Interrupt — INT0 - External Interrupt 0; 1 IC1Interrupt — IC1 - Input Compare 1; 2 OC1Interrupt — OC1 - Output Compare 1; 3 T1Interrupt — T1 - Timer1; 5 IC2Interrupt — IC2 - Input Capture 2; 6 OC2Interrupt — OC2 - Output Compare 2; 7 T2Interrupt — T2 - Timer2; 8 T3Interrupt — T3 - Timer3; 9 SPI1ErrInterrupt — SPI1E - SPI1 Error; 10 SPI1Interrupt — SPI1 - SPI1 Transfer Done; 11 U1RXInterrupt — U1RX - UART1 Receiver; 12 U1TXInterrupt — U1TX - UART1 Transmitter; 13 ADC1Interrupt — ADC1 - A/D Converter 1; 16 SI2C1Interrupt — SI2C1 - I2C1 Slave Events; 17 MI2C1Interrupt — MI2C1 - I2C1 Master Events; 18 CompInterrupt — Analog Comparator Interrupt; 19 CNInterrupt — Change Notification Interrupt; 20 INT1Interrupt — INT1 - External Interrupt 1; 27 T4Interrupt — T4 - Timer4; 28 T5Interrupt — T5 - Timer5; 29 INT2Interrupt — INT2 - External Interrupt 2; 37 IC3Interrupt — Input Capture 3; 57 PWM1Interrupt — PWM1 - PWM1 Period Match; 62 RTCCInterrupt — RTCC - Real-Time Clock and Calendar; 63 FLTA1Interrupt — FLTA1 - PWM1 Fault A; 64 FLTB1Interrupt — FLTB1 - PWM1 Fault B; 65 U1ErrInterrupt — U1E - UART1 Error; 77 CTMUInterrupt — CTMU - Interrupt
