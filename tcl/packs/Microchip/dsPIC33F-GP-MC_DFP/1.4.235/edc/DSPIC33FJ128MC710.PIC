# DSPIC33FJ128MC710 register map
Vendor: Microchip
Architecture 33xxxx. Special function registers and configuration words.
Registers are 16-bit, read-write, reset 0x0 unless marked. A register's access mark holds for its fields unless they carry their own. Addresses are absolute, and some are shared; only a register's first bit layout is shown; lines under a group give offsets from that group; [hi:lo] are bit positions; {n}, {i} and the like mark numbered series; 'fields as' and 'values as' point back to an identical list; <NAME> marks a mode.

## Further device data
pins=1: COFS/RG15; 2: Vdd; 3: PWM3H/RE5; 4: PWM4L/RE6; 5: PWM4H/RE7; 6: AN16/T2CK/T7CK/RC1; 7: AN17/T3CK/T6CK/RC2; 8: AN18/T4CK/T9CK/RC3; 9: AN19/T5CK/T8CK/RC4; 10: SCK2/CN8/RG6; 11: SDI2/CN9/RG7; 12: SDO2/CN10/RG8; 13: MCLR; 14: SS2/CN11/RG9; 15: Vss; 16: Vdd; 17: TMS/RA0; 18: AN20/FLTA/INT1/RE8; 19: AN21/FLTB/INT2/RE9; 20: AN5/QEB/CN7/RB5; 21: AN4/QEA/CN6/RB4; 22: AN3/INDX/CN5/RB3; 23: AN2/SS1/CN4/RB2; 24: PGC3/EMUC3/AN1/CN3/RB1; 25: PGD3/EMUD3/AN0/CN2/RB0; 26: PGC1/EMUC1/AN6/OCFA/RB6; 27: PGD1/EMUD1/AN7/RB7; 28: Vref-/RA9; 29: Vref+/RA10; 30: AVdd; 31: AVss; 32: AN8/RB8; 33: AN9/RB9; 34: AN10/RB10; 35: AN11/RB11; 36: Vss; 37: Vdd; 38: TCK/RA1; 39: U2RTS/RF13; 40: U2CTS/RF12; 41: AN12/RB12; 42: AN13/RB13; 43: AN14/RB14; 44: AN15/OCFB/CN12/RB15; 45: Vss; 46: Vdd; 47: IC7/U1CTS/CN20/RD14; 48: IC8/U1RTS/CN21/RD15; 49: U2RX/CN17/RF4; 50: U2TX/CN18/RF5; 51: U1TX/RF3; 52: U1RX/RF2; 53: SDO1/RF8; 54: SDI1/RF7; 55: SCK1/INT0/RF6; 56: SDA1/RG3; 57: SCL1/RG2; 58: SCL2/RA2; 59: SDA2/RA3; 60: TDI/RA4; 61: TDO/RA5; 62: Vdd; 63: OSC1/CLKIN/RC12; 64: OSC2/CLKO/RC15; 65: Vss; 66: INT3/RA14; 67: INT4/RA15; 68: IC1/RD8; 69: IC2/RD9; 70: IC3/RD10; 71: IC4/RD11; 72: OC1/RD0; 73: PGD2/EMUD2/SOSCI/CN1/RC13; 74: PGC2/EMUC2/SOSCO/T1CK/CN0/RC14; 75: Vss; 76: OC2/RD1; 77: OC3/RD2; 78: OC4/RD3; 79: IC5/RD12; 80: IC6/CN19/RD13; 81: OC5/CN13/RD4; 82: OC6/CN14/RD5; 83: OC7/CN15/RD6; 84: OC8/UPDN/CN16/RD7; 85: Vddcore; 86: Vdd; 87: C1RX/RF0; 88: C1TX/RF1; 89: C2TX/RG1; 90: C2RX/RG0; 91: AN22/CN22/RA6; 92: AN23/CN23/RA7; 93: PWM1L/RE0; 94: PWM1H/RE1; 95: CSCK/RG14; 96: CSDI/RG12; 97: CSDO/RG13; 98: PWM2L/RE2; 99: PWM2H/RE3; 100: PWM3L/RE4, interrupts=0 INT0Interrupt — INT0 - External Interrupt 0; 1 IC1Interrupt — IC1 - Input Compare 1; 2 OC1Interrupt — OC1 - Output Compare 1; 3 T1Interrupt — T1 - Timer1; 4 DMA0Interrupt — DMA0 - DMA Channel 0; 5 IC2Interrupt — IC2 - Input Capture 2; 6 OC2Interrupt — OC2 - Output Compare 2; 7 T2Interrupt — T2 - Timer2; 8 T3Interrupt — T3 - Timer3; 9 SPI1ErrInterrupt — SPI1E - SPI1 Error; 10 SPI1Interrupt — SPI1 - SPI1 Transfer Done; 11 U1RXInterrupt — U1RX - UART1 Receiver; 12 U1TXInterrupt — U1TX - UART1 Transmitter; 13 ADC1Interrupt — ADC1 - A/D Converter 1; 14 DMA1Interrupt — DMA1 - DMA Channel 1; 15 Interrupt15 — Reserved; 16 SI2C1Interrupt — SI2C1 - I2C1 Slave Events; 17 MI2C1Interrupt — MI2C1 - I2C1 Master Events; 18 CMPInterrupt — CMP - Comparator Interrupt; 19 CNInterrupt — Change Notification Interrupt; 20 INT1Interrupt — INT1 - External Interrupt 1; 21 ADC2Interrupt — ADC2 - A/D Converter 2; 22 IC7Interrupt — IC7 - Input Capture 7; 23 IC8Interrupt — IC8 - Input Capture 8; 24 DMA2Interrupt — DMA2 - DMA Channel 2; 25 OC3Interrupt — OC3 - Output Compare 3; 26 OC4Interrupt — OC4 - Output Compare 4; 27 T4Interrupt — T4 - Timer4; 28 T5Interrupt — T5 - Timer5; 29 INT2Interrupt — INT2 - External Interrupt 2; 30 U2RXInterrupt — U2RX - UART2 Receiver; 31 U2TXInterrupt — U2TX - UART2 Transmitter; 32 SPI2ErrInterrupt — SPI2E - SPI2 Error; 33 SPI2Interrupt — SPI2 - SPI2 Transfer Done; 34 C1RxRdyInterrupt — C1RX - ECAN1 Receive Data Ready; 35 C1Interrupt — C1 - ECAN1 Event; 36 DMA3Interrupt — DMA3 - DMA Channel 3; 37 IC3Interrupt — IC3 - Input Capture 3; 38 IC4Interrupt — IC4 - Input Capture 4; 39 IC5Interrupt — IC5 - Input Capture 5; 40 IC6Interrupt — IC6 - Input Capture 6; 41 OC5Interrupt — OC5 - Output Compare 5; 42 OC6Interrupt — OC6 - Output Compare 6; 43 OC7Interrupt — OC7 - Output Compare 7; 44 OC8Interrupt — OC8 - Output Compare 8; 45 PMPInterrupt — PMP - Parallel Master Port; 46 DMA4Interrupt — DMA4 - DMA Channel 4; 47 T6Interrupt — T6 - Timer6; 48 T7Interrupt — T7 - Timer7; 49 SI2C2Interrupt — SI2C2 - I2C2 Slave Events; 50 MI2C2Interrupt — MI2C2 - I2C2 Master Events; 51 T8Interrupt — T8 - Timer8; 52 T9Interrupt — T9 - Timer9; 53 INT3Interrupt — INT3 - External Interrupt 3; 54 INT4Interrupt — INT4 - External Interrupt 4; 55 C2RxRdyInterrupt — C2RX - ECAN2 Receive Data Ready; 56 C2Interrupt — C2 - ECAN2 Event; 57 PWMInterrupt — PWM - PWM Period Match; 58 QEIInterrupt — QEI - Position Counter Compare; 59 DCIErrInterrupt — DCIE - DCI Error; 60 DCIInterrupt — DCID - DCI Transfer Done; 61 DMA5Interrupt — DMA5 - DMA Channel 5; 62 RTCCInterrupt — RTCC - Real-Time Clock and Calendar; 63 FLTAInterrupt — FLTA - MCPWM Fault A; 64 FLTBInterrupt — FLTB - MCPWM Fault B; 65 U1ErrInterrupt — U1E - UART1 Error; 66 U2ErrInterrupt — U2E - UART2 Error; 67 CRCInterrupt — CRC - Cyclic Redunancy Check; 68 DMA6Interrupt — DMA6 - DMA Channel 6; 69 DMA7Interrupt — DMA7 - DMA Channel 7; 70 C1TxReqInterrupt — ECAN1 Transmit Data Request; 71 C2TxReqInterrupt — ECAN2 Transmit Data Request; 72 Interrupt72 — Reserved; 73 Interrupt73 — Reserved; 74 Interrupt74 — Reserved; 75 Interrupt75 — Reserved; 76 Interrupt76 — Reserved; 77 Interrupt77 — Reserved; 78 DAC1RInterrupt — DAC1 - Right Data Request; 79 DAC1LInterrupt — DAC1 - Left Data Request
