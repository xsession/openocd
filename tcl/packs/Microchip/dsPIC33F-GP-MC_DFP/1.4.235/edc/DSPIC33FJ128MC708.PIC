# DSPIC33FJ128MC708 register map
Vendor: Microchip
Architecture 33xxxx. Special function registers and configuration words.
Registers are 16-bit, read-write, reset 0x0 unless marked. A register's access mark holds for its fields unless they carry their own. Addresses are absolute, and some are shared; only a register's first bit layout is shown; lines under a group give offsets from that group; [hi:lo] are bit positions; {n}, {i} and the like mark numbered series; 'fields as' and 'values as' point back to an identical list; <NAME> marks a mode.

## Further device data
pins=1: PWM3H/RE5; 2: PWM4L/RE6; 3: PWM4H/RE7; 4: AN16/T2CK/T7CK/RC1; 5: AN17/T3CK/T6CK/RC2; 6: SCK2/CN8/RG6; 7: SDI2/CN9/RG7; 8: SDO2/CN10/RG8; 9: MCLR; 10: SS2/CN11/RG9; 11: Vss; 12: Vdd; 13: TMS/FLTA/INT1/RE8; 14: TDO/FLTB/INT2/RE9; 15: AN5/QEB/CN7/RB5; 16: AN4/QEA/CN6/RB4; 17: AN3/INDX/CN5/RB3; 18: AN2/SS1/CN4/RB2; 19: PGEC3/AN1/CN3/RB1; 20: PGED3/AN0/CN2/RB0; 21: PGEC1/AN6/OCFA/RB6; 22: PGED1/AN7/RB7; 23: Vref-/RA9; 24: Vref+/RA10; 25: AVdd; 26: AVss; 27: U2CTS/AN8/RB8; 28: AN9/RB9; 29: AN10/RB10; 30: AN11/RB11; 31: Vss; 32: Vdd; 33: TCK/AN12/RB12; 34: TDI/AN13/RB13; 35: U2RTS/AN14/RB14; 36: AN15/OCFB/CN12/RB15; 37: IC7/U1CTS/CN20/RD14; 38: IC8/U1RTS/CN21/RD15; 39: U2RX/CN17/RF4; 40: U2TX/CN18/RF5; 41: U1TX/RF3; 42: U1RX/RF2; 43: SDO1/RF8; 44: SDI1/RF7; 45: SCK1/INT0/RF6; 46: SDA1/RG3; 47: SCL1/RG2; 48: Vdd; 49: OSC1/CLKIN/RC12; 50: OSC2/CLKO/RC15; 51: Vss; 52: SCL2/INT3/RA2; 53: SDA2/INT4/RA3; 54: IC1/RD8; 55: IC2/RD9; 56: IC3/RD10; 57: IC4/RD11; 58: OC1/RD0; 59: PGED2/SOSCI/CN1/RC13; 60: PGEC2/SOSCO/T1CK/CN0/RC14; 61: OC2/RD1; 62: OC3/RD2; 63: OC4/RD3; 64: IC5/RD12; 65: IC6/CN19/RD13; 66: OC5/CN13/RD4; 67: OC6/CN14/RD5; 68: OC7/CN15/RD6; 69: OC8/CN16/UPDN/RD7; 70: Vcap/Vddcore; 71: Vdd; 72: C1RX/RF0; 73: C1TX/RF1; 74: C2TX/RG1; 75: CRX2/RG0; 76: PWM1L/RE0; 77: PWM1H/RE1; 78: PWM2L/RE2; 79: PWM2H/RE3; 80: PWM3L/RE4, interrupts=0 INT0Interrupt — INT0 - External Interrupt 0; 1 IC1Interrupt — IC1 - Input Compare 1; 2 OC1Interrupt — OC1 - Output Compare 1; 3 T1Interrupt — T1 - Timer1; 4 DMA0Interrupt — DMA0 - DMA Channel 0; 5 IC2Interrupt — IC2 - Input Capture 2; 6 OC2Interrupt — OC2 - Output Compare 2; 7 T2Interrupt — T2 - Timer2; 8 T3Interrupt — T3 - Timer3; 9 SPI1ErrInterrupt — SPI1E - SPI1 Error; 10 SPI1Interrupt — SPI1 - SPI1 Transfer Done; 11 U1RXInterrupt — U1RX - UART1 Receiver; 12 U1TXInterrupt — U1TX - UART1 Transmitter; 13 ADC1Interrupt — ADC1 - A/D Converter 1; 14 DMA1Interrupt — DMA1 - DMA Channel 1; 15 Interrupt15 — Reserved; 16 SI2C1Interrupt — SI2C1 - I2C1 Slave Events; 17 MI2C1Interrupt — MI2C1 - I2C1 Master Events; 18 CMPInterrupt — CMP - Comparator Interrupt; 19 CNInterrupt — Change Notification Interrupt; 20 INT1Interrupt — INT1 - External Interrupt 1; 21 ADC2Interrupt — ADC2 - A/D Converter 2; 22 IC7Interrupt — IC7 - Input Capture 7; 23 IC8Interrupt — IC8 - Input Capture 8; 24 DMA2Interrupt — DMA2 - DMA Channel 2; 25 OC3Interrupt — OC3 - Output Compare 3; 26 OC4Interrupt — OC4 - Output Compare 4; 27 T4Interrupt — T4 - Timer4; 28 T5Interrupt — T5 - Timer5; 29 INT2Interrupt — INT2 - External Interrupt 2; 30 U2RXInterrupt — U2RX - UART2 Receiver; 31 U2TXInterrupt — U2TX - UART2 Transmitter; 32 SPI2ErrInterrupt — SPI2E - SPI2 Error; 33 SPI2Interrupt — SPI2 - SPI2 Transfer Done; 34 C1RxRdyInterrupt — C1RX - ECAN1 Receive Data Ready; 35 C1Interrupt — C1 - ECAN1 Event; 36 DMA3Interrupt — DMA3 - DMA Channel 3; 37 IC3Interrupt — IC3 - Input Capture 3; 38 IC4Interrupt — IC4 - Input Capture 4; 39 IC5Interrupt — IC5 - Input Capture 5; 40 IC6Interrupt — IC6 - Input Capture 6; 41 OC5Interrupt — OC5 - Output Compare 5; 42 OC6Interrupt — OC6 - Output Compare 6; 43 OC7Interrupt — OC7 - Output Compare 7; 44 OC8Interrupt — OC8 - Output Compare 8; 45 PMPInterrupt — PMP - Parallel Master Port; 46 DMA4Interrupt — DMA4 - DMA Channel 4; 47 T6Interrupt — T6 - Timer6; 48 T7Interrupt — T7 - Timer7; 49 SI2C2Interrupt — SI2C2 - I2C2 Slave Events; 50 MI2C2Interrupt — MI2C2 - I2C2 Master Events; 51 T8Interrupt — T8 - Timer8; 52 T9Interrupt — T9 - Timer9; 53 INT3Interrupt — INT3 - External Interrupt 3; 54 INT4Interrupt — INT4 - External Interrupt 4; 55 C2RxRdyInterrupt — C2RX - ECAN2 Receive Data Ready; 56 C2Interrupt — C2 - ECAN2 Event; 57 PWMInterrupt — PWM - PWM Interrupt; 58 QEIInterrupt — QEI - QEI Interrupt; 59 DCIErrInterrupt — DCIE - DCI Error; 60 DCIInterrupt — DCID - DCI Transfer Done; 61 DMA5Interrupt — DMA5 - DMA Channel 5; 62 RTCCInterrupt — RTCC - Real-Time Clock and Calendar; 63 FLTAInterrupt — FLTA - FLTA Interrupt; 64 FLTBInterrupt — FLTB - FLTB Interrupt; 65 U1ErrInterrupt — U1E - UART1 Error; 66 U2ErrInterrupt — U2E - UART2 Error; 67 CRCInterrupt — CRC - Cyclic Redunancy Check; 68 DMA6Interrupt — DMA6 - DMA Channel 6; 69 DMA7Interrupt — DMA7 - DMA Channel 7; 70 C1TxReqInterrupt — ECAN1 Transmit Data Request; 71 C2TxReqInterrupt — ECAN2 Transmit Data Request; 72 Interrupt72 — Reserved; 73 Interrupt73 — Reserved; 74 Interrupt74 — Reserved; 75 Interrupt75 — Reserved; 76 Interrupt76 — Reserved; 77 Interrupt77 — Reserved; 78 DAC1RInterrupt — DAC1 - Right Data Request; 79 DAC1LInterrupt — DAC1 - Left Data Request
