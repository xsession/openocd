# PIC24HJ16GP304 register map
Vendor: Microchip
Architecture 24xxxx. Special function registers and configuration words.
Registers are 16-bit, read-write, reset 0x0 unless marked. A register's access mark holds for its fields unless they carry their own. Addresses are absolute, and some are shared; only a register's first bit layout is shown; lines under a group give offsets from that group; [hi:lo] are bit positions; {n}, {i} and the like mark numbered series; 'fields as' and 'values as' point back to an identical list; <NAME> marks a mode.

## Further device data
pins=1: SDA1/RP9/CN21/RB9; 2: RP22/CN18/RC6; 3: RP23/CN17/RC7; 4: RP24/CN20/RC8; 5: RP25/CN19/RC9; 6: Vss; 7: Vcap; 8: PGED2/RP10/CN16/RB10; 9: PGEC2/RP11/CN15/RB11; 10: AN12/RP12/CN14/RB12; 11: AN11/RP13/CN13/RB13; 12: TMS/RA10; 13: TCK/RA7; 14: AN10/RP14/CN12/RB14; 15: AN9/RP15/CN11/RB15; 16: AVss; 17: AVdd; 18: MCLR; 19: AN0/Vref+/CN2/RA0; 20: AN1/Vref-/CN3/RA1; 21: PGED1/AN2/C2IN-/RP0/CN4/RB0; 22: PGEC1/AN3/C2IN+/RP1/CN5/RB1; 23: AN4/RP2/CN6/RB2; 24: AN5/RP3/CN7/RB3; 25: AN6/RP16/CN8/RC0; 26: AN7/RP17/CN9/RC1; 27: AN8/RP18/CN10/RC2; 28: Vdd; 29: Vss; 30: OSC1/CLKI/CN30/RA2; 31: OSC2/CLKO/CN29/RA3; 32: TDO/RA8; 33: SOSCI/RP4/CN1/RB4; 34: SOSCO/T1CK/CN0/RA4; 35: TDI/RA9; 36: RP19/CN28/RC3; 37: RP20/CN25/RC4; 38: RP21/CN26/RC5; 39: Vss; 40: Vdd; 41: PGED3/ASDA1/RP5/CN27/RB5; 42: PGEC3/ASCL1/RP6/CN24/RB6; 43: INT0/RP7/CN23/RB7; 44: SCL1/RP8/CN22/RB8, interrupts=0 INT0Interrupt — INT0 - External Interrupt 0; 1 IC1Interrupt — IC1 - Input Compare 1; 2 OC1Interrupt — OC1 - Output Compare 1; 3 T1Interrupt — T1 - Timer1; 4 DMA0Interrupt — DMA0 - DMA Channel 0; 5 IC2Interrupt — IC2 - Input Capture 2; 6 OC2Interrupt — OC2 - Output Compare 2; 7 T2Interrupt — T2 - Timer2; 8 T3Interrupt — T3 - Timer3; 9 SPI1ErrInterrupt — SPI1E - SPI1 Error; 10 SPI1Interrupt — SPI1 - SPI1 Transfer Done; 11 U1RXInterrupt — U1RX - UART1 Receiver; 12 U1TXInterrupt — U1TX - UART1 Transmitter; 13 ADC1Interrupt — ADC1 - A/D Converter 1; 14 DMA1Interrupt — DMA1 - DMA Channel 1; 15 Interrupt15 — Reserved; 16 SI2C1Interrupt — SI2C1 - I2C1 Slave Events; 17 MI2C1Interrupt — MI2C1 - I2C1 Master Events; 18 CMPInterrupt — CMP - Comparator Interrupt; 19 CNInterrupt — Change Notification Interrupt; 20 INT1Interrupt — INT1 - External Interrupt 1; 21 ADC2Interrupt — ADC2 - A/D Converter 2; 22 IC7Interrupt — IC7 - Input Capture 7; 23 IC8Interrupt — IC8 - Input Capture 8; 29 INT2Interrupt — INT2 - External Interrupt 2; 65 U1ErrInterrupt — U1E - UART1 Error
