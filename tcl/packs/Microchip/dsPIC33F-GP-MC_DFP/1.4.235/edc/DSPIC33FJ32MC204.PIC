# DSPIC33FJ32MC204 register map
Vendor: Microchip
Architecture 33xxxx. Special function registers and configuration words.
Registers are 16-bit, read-write, reset 0x0 unless marked. A register's access mark holds for its fields unless they carry their own. Addresses are absolute, and some are shared; only a register's first bit layout is shown; lines under a group give offsets from that group; [hi:lo] are bit positions; {n}, {i} and the like mark numbered series; 'fields as' and 'values as' point back to an identical list; <NAME> marks a mode.

## Further device data
pins=1: SDA1/RP9/CN21/RB9; 2: PWM2H1/RP22/CN18/RC6; 3: PWM2L1/RP23/CN17/RC7; 4: RP24/CN20/RC8; 5: RP25/CN19/RC9; 6: Vss; 7: Vcap; 8: PGED2/EMUD2/PWM1H3/RP10/CN16/RB10; 9: PGEC2/EMUC2/PWM1L3/RP11/CN15/RB11; 10: PWM1H2/RP12/CN14/RB12; 11: PWM1L2/RP13/CN13/RB13; 12: TMS/RA10; 13: TCK/RA7; 14: PWM1H1/RP14/CN12/RB14; 15: PWM1L1/RP15/CN11/RB15; 16: AVss; 17: AVdd; 18: MCLR; 19: AN0/Vref+/CN2/RA0; 20: AN1/Vref-/CN3/RA1; 21: PGED1/EMUD1/AN2/C2IN-/RP0/CN4/RB0; 22: PGEC1/EMUC1/AN3/C2IN+/RP1/CN5/RB1; 23: AN4/RP2/CN6/RB2; 24: AN5/RP3/CN7/RB3; 25: AN6/RP16/CN8/RC0; 26: AN7/RP17/CN9/RC1; 27: AN8/RP18/CN10/RC2; 28: Vdd; 29: Vss; 30: OSC1/CLKI/CN30/RA2; 31: OSC2/CLKO/CN29/RA3; 32: TDO/RA8; 33: SOSCI/RP4/CN1/RB4; 34: SOSCO/T1CK/CN0/RA4; 35: TDI/RA9; 36: RP19/CN28/RC3; 37: RP20/CN25/RC4; 38: RP21/CN26/RC5; 39: Vss; 40: Vdd; 41: PGED3/EMUD3/ASDA1/RP5/CN27/RB5; 42: PGEC3/EMUC3/ASCL1/RP6/CN24/RB6; 43: INT0/RP7/CN23/RB7; 44: SCL1/RP8/CN22/RB8, interrupts=0 INT0Interrupt — INT0 - External Interrupt 0; 1 IC1Interrupt — IC1 - Input Compare 1; 2 OC1Interrupt — OC1 - Output Compare 1; 3 T1Interrupt — T1 - Timer1; 4 Interrupt4 — Reserved; 5 IC2Interrupt — IC2 - Input Capture 2; 6 OC2Interrupt — OC2 - Output Compare 2; 7 T2Interrupt — T2 - Timer2; 8 T3Interrupt — T3 - Timer3; 9 SPI1ErrInterrupt — SPI1E - SPI1 Error; 10 SPI1Interrupt — SPI1 - SPI1 Transfer Done; 11 U1RXInterrupt — U1RX - UART1 Receiver; 12 U1TXInterrupt — U1TX - UART1 Transmitter; 13 ADC1Interrupt — ADC1 - A/D Converter 1; 14 Interrupt14 — Reserved; 15 Interrupt15 — Reserved; 16 SI2C1Interrupt — SI2C1 - I2C1 Slave Events; 17 MI2C1Interrupt — MI2C1 - I2C1 Master Events; 18 Interrupt18 — Reserved; 19 CNInterrupt — Change Notification Interrupt; 20 INT1Interrupt — INT1 - External Interrupt 1; 21 Interrupt21 — Reserved; 22 IC7Interrupt — IC7 - Input Capture 7; 23 IC8Interrupt — IC8 - Input Capture 8; 24 Interrupt24 — Reserved; 25 Interrupt25 — Reserved; 26 Interrupt26 — Reserved; 27 Interrupt27 — Reserved; 28 Interrupt28 — Reserved; 29 INT2Interrupt — INT2 - External Interrupt 2; 30 Interrupt30 — Reserved; 31 Interrupt31 — Reserved; 32 Interrupt32 — Reserved; 33 Interrupt33 — Reserved; 34 Interrupt34 — Reserved; 35 Interrupt35 — Reserved; 36 Interrupt36 — Reserved; 37 Interrupt37 — Reserved; 38 Interrupt38 — Reserved; 39 Interrupt39 — Reserved; 40 Interrupt40 — Reserved; 41 Interrupt41 — Reserved; 42 Interrupt42 — Reserved; 43 Interrupt43 — Reserved; 44 Interrupt44 — Reserved; 45 Interrupt45 — Reserved; 46 Interrupt46 — Reserved; 47 Interrupt47 — Reserved; 48 Interrupt48 — Reserved; 49 Interrupt49 — Reserved; 50 Interrupt50 — Reserved; 51 Interrupt51 — Reserved; 52 Interrupt52 — Reserved; 53 Interrupt53 — Reserved; 54 Interrupt54 — Reserved; 55 Interrupt55 — Reserved; 56 Interrupt56 — Reserved; 57 MPWM1Interrupt — MPWM1 - MPWM1 Period Match; 58 QEIInterrupt — QEI - Positiono Counter Match; 59 Interrupt59 — Reserved; 60 Interrupt60 — Reserved; 61 Interrupt61 — Reserved; 62 Interrupt62 — Reserved; 63 FLTA1Interrupt — FLTA1 - MPWM1 Fault A; 64 Interrupt64 — Reserved; 65 U1ErrInterrupt — U1E - UART1 Error; 66 Interrupt66 — Reserved; 67 Interrupt67 — Reserved; 68 Interrupt68 — Reserved; 69 Interrupt69 — Reserved; 70 Interrupt70 — Reserved; 71 Interrupt71 — Reserved; 72 Interrupt72 — Reserved; 73 MPWM2Interrupt — MPWM2 - MPWM2 Period Match; 74 FLTA2Interrupt — FLTA2 - MPWM2 Fault A
