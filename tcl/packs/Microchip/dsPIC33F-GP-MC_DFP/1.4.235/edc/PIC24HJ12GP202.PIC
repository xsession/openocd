# PIC24HJ12GP202 register map
Vendor: Microchip
Architecture 24xxxx. Special function registers and configuration words.
Registers are 16-bit, read-write, reset 0x0 unless marked. A register's access mark holds for its fields unless they carry their own. Addresses are absolute, and some are shared; only a register's first bit layout is shown; lines under a group give offsets from that group; [hi:lo] are bit positions; {n}, {i} and the like mark numbered series; 'fields as' and 'values as' point back to an identical list; <NAME> marks a mode.

## Further device data
pins=1: MCLR; 2: PGED2/AN0/VREF+/CN2/RA0; 3: PGEC2/AN1/VREF-/CN3/RA1; 4: PGED1/AN2/RP0/CN4/RB0; 5: PGEC1/AN3/RP1/CN5/RB1; 6: AN4/RP2/CN6/RB2; 7: AN5/RP3/CN7/RB3; 8: Vss; 9: OSC1/CLKI/CN30/RA2; 10: OSC2/CLKO/CN29/RA3; 11: PGED3/SOSCI/RP4/CN1/RB4; 12: PGEC3/SOSCO/T1CK/CN0/RA4; 13: Vdd; 14: ASDA1/RP5/CN27/RB5; 15: ASCL1/RP6/CN24/RB6; 16: INT0/RP7/CN23/RB7; 17: TCK/SCL1/RP8/CN22/RB8; 18: TDO/SDA1/RP9/CN21/RB9; 19: Vss; 20: Vcap/Vddcore; 21: TDI/RP10/CN16/RB10; 22: TMS/RP11/CN15/RB11; 23: AN9/RP12/CN14/RB12; 24: AN8/RP13/CN13/RB13; 25: AN7/RP14/CN12/RB14; 26: AN6/RP15/CN11/RB15; 27: AVss; 28: AVdd, interrupts=0 INT0Interrupt — INT0 - External Interrupt 0; 1 IC1Interrupt — IC1 - Input Compare 1; 2 OC1Interrupt — OC1 - Output Compare 1; 3 T1Interrupt — T1 - Timer1; 5 IC2Interrupt — IC2 - Input Capture 2; 6 OC2Interrupt — OC2 - Output Compare 2; 7 T2Interrupt — T2 - Timer2; 8 T3Interrupt — T3 - Timer3; 9 SPI1ErrInterrupt — SPI1E - SPI1 Error; 10 SPI1Interrupt — SPI1 - SPI1 Transfer Done; 11 U1RXInterrupt — U1RX - UART1 Receiver; 12 U1TXInterrupt — U1TX - UART1 Transmitter; 13 ADC1Interrupt — ADC1 - A/D Converter 1; 16 SI2C1Interrupt — SI2C1 - I2C1 Slave Events; 17 MI2C1Interrupt — MI2C1 - I2C1 Master Events; 19 CNInterrupt — Change Notification Interrupt; 20 INT1Interrupt — INT1 - External Interrupt 1; 22 IC7Interrupt — IC7 - Input Capture 7; 23 IC8Interrupt — IC8 - Input Capture 8; 29 INT2Interrupt — INT2 - External Interrupt 2; 65 U1ErrInterrupt — U1E - UART1 Error
