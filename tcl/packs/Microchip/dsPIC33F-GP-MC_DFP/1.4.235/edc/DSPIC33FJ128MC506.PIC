# DSPIC33FJ128MC506 register map
Vendor: Microchip
Architecture 33xxxx. Special function registers and configuration words.
Registers are 16-bit, read-write, reset 0x0 unless marked. A register's access mark holds for its fields unless they carry their own. Addresses are absolute, and some are shared; only a register's first bit layout is shown; lines under a group give offsets from that group; [hi:lo] are bit positions; {n}, {i} and the like mark numbered series; 'fields as' and 'values as' point back to an identical list; <NAME> marks a mode.

## Further device data
pins=1: PWM3H/RE5; 2: PWM4L/RE6; 3: PWM4H/RE7; 4: SCK2/CN8/RG6; 5: SDI2/CN9/RG7; 6: SDO2/CN10/RG8; 7: MCLR; 8: SS2/CN11/RG9; 9: Vss; 10: Vdd; 11: AN5/QEB/IC8/CN7/RB5; 12: AN4/QEA/IC7/CN6/RB4; 13: AN3/INDX/CN5/RB3; 14: AN2/SS1/CN4/RB2; 15: PGEC3/AN1/Vref-/CN3/RB1; 16: PGED3/AN0/Vref+/CN2/RB0; 17: PGEC1/AN6/OCFA/RB6; 18: PGED1/AN7/RB7; 19: AVdd; 20: AVss; 21: U2CTS/AN8/RB8; 22: AN9/RB9; 23: TMS/AN10/RB10; 24: TDO/AN11/RB11; 25: Vss; 26: Vdd; 27: TCK/AN12/RB12; 28: TDI/AN13/RB13; 29: U2RTS/AN14/RB14; 30: AN15/OCFB/CN12/RB15; 31: U2RX/SDA2/CN17/RF4; 32: U2TX/SCL2/CN18/RF5; 33: U1TX/SDO1/RF3; 34: U1RX/SDI1/RF2; 35: U1RTS/SCK1/INT0/RF6; 36: SDA1/RG3; 37: SCL1/RG2; 38: Vdd; 39: OSC1/CLKIN/RC12; 40: OSC2/CLKO/RC15; 41: Vss; 42: IC1/FLTA/INT1/RD8; 43: IC2/U1CTS/FLTB/INT2/RD9; 44: IC3/INT3/RD10; 45: IC4/INT4/RD11; 46: OC1/RD0; 47: PGED2/SOSCI/T4CK/CN1/RC13; 48: PGEC2/SOSCO/T1CK/CN0/RC14; 49: OC2/RD1; 50: OC3/RD2; 51: OC4/RD3; 52: OC5/IC5/CN13/RD4; 53: OC6/IC6/CN14/RD5; 54: OC7/CN15/RD6; 55: OC8/UPDN/CN16/RD7; 56: Vcap/Vddcore; 57: Vdd; 58: C1RX/RF0; 59: C1TX/RF1; 60: PWM1L/RE0; 61: PWM1H/RE1; 62: PWM2L/RE2; 63: PWM2H/RE3; 64: PWM3L/RE4, interrupts=0 INT0Interrupt — INT0 - External Interrupt 0; 1 IC1Interrupt — IC1 - Input Compare 1; 2 OC1Interrupt — OC1 - Output Compare 1; 3 T1Interrupt — T1 - Timer1; 4 DMA0Interrupt — DMA0 - DMA Channel 0; 5 IC2Interrupt — IC2 - Input Capture 2; 6 OC2Interrupt — OC2 - Output Compare 2; 7 T2Interrupt — T2 - Timer2; 8 T3Interrupt — T3 - Timer3; 9 SPI1ErrInterrupt — SPI1E - SPI1 Error; 10 SPI1Interrupt — SPI1 - SPI1 Transfer Done; 11 U1RXInterrupt — U1RX - UART1 Receiver; 12 U1TXInterrupt — U1TX - UART1 Transmitter; 13 ADC1Interrupt — ADC1 - A/D Converter 1; 14 DMA1Interrupt — DMA1 - DMA Channel 1; 15 Interrupt15 — Reserved; 16 SI2C1Interrupt — SI2C1 - I2C1 Slave Events; 17 MI2C1Interrupt — MI2C1 - I2C1 Master Events; 18 CMPInterrupt — CMP - Comparator Interrupt; 19 CNInterrupt — Change Notification Interrupt; 20 INT1Interrupt — INT1 - External Interrupt 1; 21 ADC2Interrupt — ADC2 - A/D Converter 2; 22 IC7Interrupt — IC7 - Input Capture 7; 23 IC8Interrupt — IC8 - Input Capture 8; 24 DMA2Interrupt — DMA2 - DMA Channel 2; 25 OC3Interrupt — OC3 - Output Compare 3; 26 OC4Interrupt — OC4 - Output Compare 4; 27 T4Interrupt — T4 - Timer4; 28 T5Interrupt — T5 - Timer5; 29 INT2Interrupt — INT2 - External Interrupt 2; 30 U2RXInterrupt — U2RX - UART2 Receiver; 31 U2TXInterrupt — U2TX - UART2 Transmitter; 32 SPI2ErrInterrupt — SPI2E - SPI2 Error; 33 SPI2Interrupt — SPI2 - SPI2 Transfer Done; 34 C1RxRdyInterrupt — C1RX - ECAN1 Receive Data Ready; 35 C1Interrupt — C1 - ECAN1 Event; 36 DMA3Interrupt — DMA3 - DMA Channel 3; 37 IC3Interrupt — IC3 - Input Capture 3; 38 IC4Interrupt — IC4 - Input Capture 4; 39 IC5Interrupt — IC5 - Input Capture 5; 40 IC6Interrupt — IC6 - Input Capture 6; 41 OC5Interrupt — OC5 - Output Compare 5; 42 OC6Interrupt — OC6 - Output Compare 6; 43 OC7Interrupt — OC7 - Output Compare 7; 44 OC8Interrupt — OC8 - Output Compare 8; 45 PMPInterrupt — PMP - Parallel Master Port; 46 DMA4Interrupt — DMA4 - DMA Channel 4; 47 T6Interrupt — T6 - Timer6; 48 T7Interrupt — T7 - Timer7; 49 SI2C2Interrupt — SI2C2 - I2C2 Slave Events; 50 MI2C2Interrupt — MI2C2 - I2C2 Master Events; 51 T8Interrupt — T8 - Timer8; 52 T9Interrupt — T9 - Timer9; 53 INT3Interrupt — INT3 - External Interrupt 3; 54 INT4Interrupt — INT4 - External Interrupt 4; 55 C2RxRdyInterrupt — C2RX - ECAN2 Receive Data Ready; 56 C2Interrupt — C2 - ECAN2 Event; 57 PWMInterrupt — PWM - PWM Interrupt; 58 QEIInterrupt — QEI - QEI Interrupt; 59 DCIErrInterrupt — DCIE - DCI Error; 60 DCIInterrupt — DCID - DCI Transfer Done; 61 DMA5Interrupt — DMA5 - DMA Channel 5; 62 RTCCInterrupt — RTCC - Real-Time Clock and Calendar; 63 FLTAInterrupt — FLTA - FLTA Interrupt; 64 FLTBInterrupt — FLTB - FLTB Interrupt; 65 U1ErrInterrupt — U1E - UART1 Error; 66 U2ErrInterrupt — U2E - UART2 Error; 67 CRCInterrupt — CRC - Cyclic Redunancy Check; 68 DMA6Interrupt — DMA6 - DMA Channel 6; 69 DMA7Interrupt — DMA7 - DMA Channel 7; 70 C1TxReqInterrupt — ECAN1 Transmit Data Request; 71 C2TxReqInterrupt — ECAN2 Transmit Data Request; 72 Interrupt72 — Reserved; 73 Interrupt73 — Reserved; 74 Interrupt74 — Reserved; 75 Interrupt75 — Reserved; 76 Interrupt76 — Reserved; 77 Interrupt77 — Reserved; 78 DAC1RInterrupt — DAC1 - Right Data Request; 79 DAC1LInterrupt — DAC1 - Left Data Request
