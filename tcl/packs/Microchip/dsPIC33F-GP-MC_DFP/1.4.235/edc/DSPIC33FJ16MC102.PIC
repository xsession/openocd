# DSPIC33FJ16MC102 register map
Vendor: Microchip
Architecture 33xxxx. Special function registers and configuration words.
Registers are 16-bit, read-write, reset 0x0 unless marked. A register's access mark holds for its fields unless they carry their own. Addresses are absolute, and some are shared; only a register's first bit layout is shown; lines under a group give offsets from that group; [hi:lo] are bit positions; {n}, {i} and the like mark numbered series; 'fields as' and 'values as' point back to an identical list; <NAME> marks a mode.

## Further device data
pins=1: MCLR; 2: PGED2/AN0/C3INB/C1INA/CTED1/CN2/RA0; 3: PGEC2/AN1/C3INA/C1INB/CTED2/CN3/RA1; 4: PGED1/AN2/C2INA/C1INC/CTCMP/RP0/CN4/RB0; 5: PGEC1/AN3/CVrefin/CVrefout/C2INB/C1IND/RP1/CN5/RB1; 6: AN4/C3INC/C2INC/RP2/CN6/RB2; 7: AN5/C3IND/C2IND/RP3/CN7/RB3; 8: Vss; 9: OSCI/CLKI/CN30/RA2; 10: OSCO/CLKO/CN29/RA3; 11: PGED3/SOSCI/RP4/CN1/RB4; 12: PGEC3/SOSCO/T1CK/CN0/RA4; 13: Vdd; 14: FLTB1/ASDA1/RP5/CN27/RB5; 15: FLTA1/ASCL1/RP6/CN24/RB6; 16: SCK1/INT0/RP7/CN23/RB7; 17: TCK/SCL1/SDO1/RP8/CN22/RB8; 18: TDO/SDA1/SDI1/RP9/CN21/RB9; 19: Vss; 20: Vcap; 21: TDI/PWM1H3/RP10/CN16/RB10; 22: TMS/PWM1L3/RP11/CN15/RB11; 23: PWM1H2/RP12/CN14/RB12; 24: PWM1L2/RP13/CN13/RB13; 25: PWM1H1/RTCC/RP14/CN12/RB14; 26: PWM1L1/RP15/CN11/RB15; 27: AVss; 28: AVdd, interrupts=0 INT0Interrupt — INT0 - External Interrupt 0; 1 IC1Interrupt — IC1 - Input Compare 1; 2 OC1Interrupt — OC1 - Output Compare 1; 3 T1Interrupt — T1 - Timer1; 5 IC2Interrupt — IC2 - Input Capture 2; 6 OC2Interrupt — OC2 - Output Compare 2; 7 T2Interrupt — T2 - Timer2; 8 T3Interrupt — T3 - Timer3; 9 SPI1ErrInterrupt — SPI1E - SPI1 Error; 10 SPI1Interrupt — SPI1 - SPI1 Transfer Done; 11 U1RXInterrupt — U1RX - UART1 Receiver; 12 U1TXInterrupt — U1TX - UART1 Transmitter; 13 ADC1Interrupt — ADC1 - A/D Converter 1; 16 SI2C1Interrupt — SI2C1 - I2C1 Slave Events; 17 MI2C1Interrupt — MI2C1 - I2C1 Master Events; 18 CompInterrupt — Analog Comparator Interrupt; 19 CNInterrupt — Change Notification Interrupt; 20 INT1Interrupt — INT1 - External Interrupt 1; 29 INT2Interrupt — INT2 - External Interrupt 2; 37 IC3Interrupt — Input Capture 3; 57 MPWM1Interrupt — MPWM1 - MPWM1 Period Match; 62 RTCCInterrupt — RTCC - Real-Time Clock and Calendar; 63 FLTA1Interrupt — FLTA1 - MPWM1 Fault A; 64 FLTB1Interrupt — FLTB1 - MPWM1 Fault B; 65 U1ErrInterrupt — U1E - UART1 Error; 77 CTMUInterrupt — CTMU - Interrupt
