# TMS320F28M35x_C28x register map
Vendor: Texas Instruments; Series: C2000 Concerto F28M35x; File version: 0.2.0-generated
Registers are 32-bit, read-write, reset 0x0 unless marked. A register's access mark holds for its fields unless they carry their own. Offsets are from the block's base; [hi:lo] are bit positions; {n}, {i} and the like mark numbered series.

## EPI0 — EPI REGS Registers
Base 0x801A0000
0x00 EPICFG — EPI Configuration
0x08 EPIBAUD — EPI Main Baud Rate
0x10 EPIBAUD2 — EPI Baud Rate 2
0x20 GPCFG — EPI General Purpose Configuration
0x20 HB16CFG — EPI Host-Bus 16 Configuration
0x20 HB8CFG — EPI Host-Bus 8 Configuration
0x20 SDRAMCFG — EPI SDRAM Configuration
0x28 GPCFG2 — EPI General Purpose Configuration 2
0x28 HB16CFG2 — EPI Host-Bus 16 Configuration 2
0x28 HB8CFG2 — EPI Host-Bus 8 Configuration 2
0x38 EPIADDRMAP — EPI Address Map
0x40 EPIRSIZE0 — EPI Read Size 0
0x48 EPIRADDR0 — EPI Read Address 0
0x50 EPIRPSTD0 — EPI Non-Blocking Read Data 0
0x60 EPIRSIZE1 — EPI Read Size 1
0x68 EPIRADDR1 — EPI Read Address 1
0x70 EPIRPSTD1 — EPI Non-Blocking Read Data 1
0xC0 EPISTAT — EPI Status
0xD8 EPIRFIFOCNT — EPI Read FIFO Count
0xE0 EPIREADFIFO
{0xE0+8i} EPIREADFIFO{i} (i=1..7) — EPI Read FIFO Alias {i}
0x400 EPIFIFOLVL — EPI FIFO Level Selects
0x408 EPIWFIFOCNT — EPI Write FIFO Count
0x410 EPIDMATXCNT — EPI DMA Transmit Count
0x420 EPIIM — EPI Interrupt Mask
0x428 EPIRIS — EPI Raw Interrupt Status
0x430 EPIMIS — EPI Masked Interrupt Status
0x438 EPIEISC — EPI Error Interrupt Status and Clear
0x610 HB16CFG3 — EPI Host-Bus 16 Configuration 3
0x610 HB8CFG3 — EPI Host-Bus 8 Configuration 3
0x618 HB16CFG4 — EPI Host-Bus 16 Configuration 4
0x618 HB8CFG4 — EPI Host-Bus 8 Configuration 4
0x620 HB16TIME — EPI Host-Bus 16 Timing Extension
0x620 HB8TIME — EPI Host-Bus 8 Timing Extension
{0x618+8i} HB16TIME{i} (i=2..4) — EPI Host-Bus 16 Timing Extension {i}
{0x618+8i} HB8TIME{i} (i=2..4) — EPI Host-Bus 8 Timing Extension {i}

## FLASH_CONTROL — FLASH REGS Registers
Base 0x801F4000
0x00 FRDCNTL — Flash Read Control Register
0x78 FBAC — Flash Bank Access Control Register
0x80 FBFALLBACK — Flash Bank Fallback Power Register
0x88 FBPRDY — Flash Bank Pump Ready Register
0x90 FPAC1 — Flash Pump Access Control Register 1
0x98 FPAC2 — Flash Pump Access Control Register 2
0xA0 FMAC — Flash Module Access Control Register
0xA8 FMSTAT — Flash Module Status Register
0x600 FRD_INTF_CTRL — Flash Read Interface Control Register

## FLASH_ERROR — FLASH ERR REGS Registers
Base 0x801F4C00
0x00 ECC_ENABLE
0x08 SINGLE_ERR_ADDR — Single Error Address Register
0x10 UNC_ERR_ADDR — Uncorrectable Error Address Register
0x18 ERR_STATUS — Error Status Register
0x20 ERR_POS — Error Position Register
0x28 ERR_STATUS_CLR — Error Status Clear Register
0x30 ERR_CNT — Error Count Register
0x38 ERR_THRESHOLD — Error Threshold Register
0x40 ERR_INTFLG — Error Interrupt Flag Register
0x48 ERR_INTCLR — Error Interrupt Clear Register
0x50 FDATAH_TEST — Test Data High Register
0x58 FDATAL_TEST — Test Data Low Register
0x60 FADDR_TEST — Test Data Address Register
0x68 FECC_TEST — Test Data ECC Register
0x70 FECC_CTRL — ECC Test Control Register
0x78 FECC_FOUTH_TEST — Test Data Out High Register
0x80 FECC_FOUTL_TEST — Test Data Out Low Register
0x88 FECC_STATUS — Test Status Register

## RAM_CONFIG — RAM CONFIG REGS Registers
Base 0x801F6400
0x00 CXDRCR1 — Cx DEDRAM Config Register 1
0x10 CXSRCR1 — Cx SHRAM Config Register 1
0x20 MSXMSEL — Sx SHRAM Master Select Register
0x28 MSXSRCR1 — M3 Sx SHRAM Config Register 1
0x30 MSXSRCR2 — M3 Sx SHRAM Config Register 2
0x48 MTOCMSGRCR — M3TOC28_MSG_RAM Config Register
0x68 CXRTESTINIT1 — Cx RAM_TEST and INIT Register 1
0x88 MSXRTESTINIT1 — M3 Sx RAM_TEST and INIT Register 1
0xA8 MTOCRTESTINIT — M3 To Cx Message TEST and INIT Register
0xC8 CXRINITDONE1 — Cx RAM_ INIT_DONE Register 1
0xD8 MSXRINITDONE1 — M3 Sx RAM_INIT_DONE Register
0xF8 MTOCRINITDONE — M3 To Cx Message RAM Init Done
