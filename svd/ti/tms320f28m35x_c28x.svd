# TMS320F28M35x_C28x register map
Vendor: Texas Instruments; Series: C2000 Concerto F28M35x; File version: 0.2.0-generated
Registers are 32-bit, read-write, reset 0x0 unless marked. A register's access mark holds for its fields unless they carry their own. Offsets are from the block's base; [hi:lo] are bit positions; {n}, {i} and the like mark numbered series.

## I2CA — I2C Registers
Base 0x0000F200
0x00 I2COAR 16-bit — I2C own address register
0x02 I2CIER 16-bit — I2C interrupt enable register
0x04 I2CSTR 16-bit — I2C status register
0x06 I2CCLKL 16-bit — I2C clock low-time divider register
0x08 I2CCLKH 16-bit — I2C clock high-time divider register
0x0A I2CCNT 16-bit — I2C data count register
0x0C I2CDRR 16-bit — I2C data receive register
0x0E I2CSAR 16-bit — I2C slave address register
0x10 I2CDXR 16-bit — I2C data transmit register
0x12 I2CMDR 16-bit — I2C mode register
0x14 I2CISRC 16-bit — I2C interrupt source register
0x18 I2CPSC 16-bit — I2C prescaler register
0x40 I2CFFTX 16-bit — I2C FIFO transmit register
0x42 I2CFFRX 16-bit — I2C FIFO receive register

## WDT0 — WDT REGS Registers
Base 0x80000000
Same registers: WDT1 0x80002000
0x00 WDTLOAD — Watchdog Load
0x08 WDTVALUE — Watchdog Value
0x10 WDTCTL — Watchdog Control
0x18 WDTICR — Watchdog Interrupt Clear
0x20 WDTRIS — Watchdog Raw Interrupt Status
0x28 WDTMIS — Watchdog Masked Interrupt Status
0x830 WDTTEST — Watchdog Test
0x1800 WDTLOCK — Watchdog Lock
{0x1F80+8i} WDTPERIPHID{i} (i=4..7) — Watchdog Peripheral Identification {i}
{0x1FC0+8i} WDTPERIPHID{i} (i=0..3) — Watchdog Peripheral Identification {i}
{0x1FE0+8i} WDTPCELLID{i} (i=0..3) — Watchdog PrimeCell Identification {i}

## GPIO_PORTA — GPIO REGS Registers
Base 0x80008000
Same registers: GPIO_PORTB 0x8000A000, GPIO_PORTC 0x8000C000, GPIO_PORTD 0x8000E000, GPIO_PORTE 0x80048000, GPIO_PORTF 0x8004A000, GPIO_PORTG 0x8004C000, GPIO_PORTH 0x8004E000, GPIO_PORTJ 0x8007A000, GPIO_PORTA_AHB 0x800B0000, GPIO_PORTB_AHB 0x800B2000, GPIO_PORTC_AHB 0x800B4000, GPIO_PORTD_AHB 0x800B6000, GPIO_PORTE_AHB 0x800B8000, GPIO_PORTF_AHB 0x800BA000, GPIO_PORTG_AHB 0x800BC000, GPIO_PORTH_AHB 0x800BE000, GPIO_PORTJ_AHB 0x800C0000
0x7F8 GPIODATA
0x800 GPIODIR — GPIO Direction
0x808 GPIOIS — GPIO Interrupt Sense
0x810 GPIOIBE — GPIO Interrupt Both Edges
0x818 GPIOIEV — GPIO Interrupt Event
0x820 GPIOIM — GPIO Interrupt Mask
0x828 GPIORIS — GPIO Raw Interrupt Status
0x830 GPIOMIS — GPIO Masked Interrupt Status
0x838 GPIOICR — GPIO Interrupt Clear
0x840 GPIOAFSEL — GPIO Alternate Function Select
0xA18 GPIOODR — GPIO Open Drain Select
0xA20 GPIOPUR — GPIO Pull-Up Select
0xA38 GPIODEN — GPIO Digital Enable
0xA40 GPIOLOCK
0xA48 GPIOCR — GPIO Commit
0xA50 GPIOAMSEL — GPIO Analog Mode Select
0xA58 GPIOPCTL — GPIO Port Control
0xA60 GPIOAPSEL — GPIO Alternate Port Select
0xA68 GPIOCSEL — GPIO Core Select
{0x1F80+8i} GPIOPERIPHID{i} (i=4..7) — GPIO Peripheral Identification {i}
{0x1FC0+8i} GPIOPERIPHID{i} (i=0..3) — GPIO Peripheral Identification {i}
{0x1FE0+8i} GPIOCELLID{i} (i=0..3) — GPIO PrimeCell Identification {i}

## SSI0 — SSI REGS Registers
Base 0x80010000
Same registers: SSI1 0x80012000, SSI2 0x80014000, SSI3 0x80016000
0x00 SSICR0 — SSI Control 0
0x08 SSICR1 — SSI Control 1
0x10 SSIDR — SSI Data
0x18 SSISR — SSI Status
0x20 SSICPSR — SSI Clock Prescale
0x28 SSIIM — SSI Interrupt Mask
0x30 SSIRIS — SSI Raw Interrupt Status
0x38 SSIMIS — SSI Masked Interrupt Status
0x40 SSIICR — SSI Interrupt Clear
0x48 SSIDMACTL — SSI DMA Control
{0x1F80+8i} SSIPERIPHID{i} (i=4..7) — SSI Peripheral Identification {i}
{0x1FC0+8i} SSIPERIPHID{i} (i=0..3) — SSI Peripheral Identification {i}
{0x1FE0+8i} SSIPCELLID{i} (i=0..3) — SSI PrimeCell Identification {i}

## UART0 — UART REGS Registers
Base 0x80018000
Same registers: UART1 0x8001A000, UART2 0x8001C000, UART3 0x8001E000, UART4 0x80020000
0x00 UARTDR — UART Data
0x08 UARTRSR_TECR — UART Receive Status / Error Clear
0x30 UARTFR — UART Flag
0x40 UARTILPR — UART IrDA Low-Power Register
0x48 UARTIBRD — UART Integer Baud-Rate Divisor
0x50 UARTFBRD — UART Fractional Baud-Rate Divisor
0x58 UARTLCRH — UART Line Control
0x60 UARTCTL — UART Control
0x68 UARTIFLS — UART Interrupt FIFO Level Select
0x70 UARTIM — UART Interrupt Mask
0x78 UARTRIS — UART Raw Interrupt Status
0x80 UARTMIS — UART Masked Interrupt Status
0x88 UARTICR — UART Interrupt Clear
0x90 UARTDMACTL — UART DMA Control
0x120 UARTLCTL — UART LIN Control
0x128 UARTLSS — UART LIN Snap Shot
0x130 UARTLTIM — UART LIN Timer
{0x1F80+8i} UARTPERIPHID{i} (i=4..7) — UART Peripheral Identification {i}
{0x1FC0+8i} UARTPERIPHID{i} (i=0..3) — UART Peripheral Identification {i}
{0x1FE0+8i} UARTPCELLID{i} (i=0..3) — UART PrimeCell Identification {i}
