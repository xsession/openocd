# TMS320F28M35x_C28x register map
Vendor: Texas Instruments; Series: C2000 Concerto F28M35x; File version: 0.2.0-generated
Registers are 32-bit, read-write, reset 0x0 unless marked. A register's access mark holds for its fields unless they carry their own. Offsets are from the block's base; [hi:lo] are bit positions; {n}, {i} and the like mark numbered series.

## VCU — VCU Registers
Base 0x00002400
{0x0+4i} VR{i} (i=0..8) — General Purpose 32-bit registers
0x24 VT0 — Transition Bit register
0x28 VT1 — Transition Bit register
0x40 VSTATUS — VCU Status Register
0x44 VCRC — CRC Result register for un-secured memories

## FLASHCTRL — FLASH CTRL REGS Registers
Base 0x00008000
0x00 FRDCNTL — Flash Read Control Register
0x3C FBAC — Flash Bank Access Control Register
0x40 FBFALLBACK — Flash Bank Fallback Power Register
0x44 FBPRDY — Flash Bank Pump Ready Register
0x48 FPAC1 — Flash Pump Access Control Register 1
0x4C FPAC2 — Flash Pump Access Control Register 2
0x50 FMAC — Flash Module Access Control Register
0x54 FMSTAT — Flash Module Status Register
0x2FC FRD_INTF_CTRL — Flash Read Interface Control Register

## FLASHECC — FLASH ECC REGS Registers
Base 0x00008600
0x00 ECC_ENABLE
0x04 SINGLE_ERR_ADDR — Single Error Address
0x08 UNC_ERR_ADDR — Uncorrectable Error Address
0x0C ERR_STATUS — Error Status
0x10 ERR_POS — Error Position
0x14 ERR_STATUS_CLR — Error Status Clear
0x18 ERR_CNT — Error Control
0x1C ERR_THRESHOLD — Error Threshold
0x20 ERR_INTFLG — Error Interrupt Flag
0x24 ERR_INTCLR — Error Interrupt Flag Clear
0x28 FDATAH_TEST — Data High Test
0x2C FDATAL_TEST — Data Low Test
0x30 FADDR_TEST — ECC Test Address
0x34 FECC_TEST — ECC Test Address
0x38 FECC_CTRL — ECC Control
0x3C FOUTH_TEST — Test Data Out High
0x40 FOUTL_TEST — Test Data Out Low
0x44 FECC_STATUS — ECC Status

## EPI — EPI REGS Registers
Base 0x00008860
0x00 CEPIRTWCFG — Real Time Window Configure Register
0x04 CEPIRTWCNT — Real Time Window Counter Register
0x08 CEPIRTWPRD — Real Time Window Period Register
0x14 CEPISTATUS — EPI Status Register

## IPC — CTOM IPC REGS Registers
Base 0x00009C00
0x00 CTOMIPCSET — C28 to M3 core IPC interrupt request set register
0x04 CTOMIPCCLR — C28 to M3 core IPC interrupt request clear register
0x08 CTOMIPCFLG — C28 to M3 core IPC interrupt status register
0x0C MTOCIPCACK — M3 to C28 core IPC interrupt request clear (acknowledge) register
0x10 MTOCIPCSTS — M3 to C28 core IPC interrupt status flag register
0x18 MIPCCOUNTERL — IPC Counter Low Register
0x1C MIPCCOUNTERH — IPC Counter High Register
0x20 CTOMIPCCOM — C28 To M3 IPC Command Register (read/write to C28)
0x24 CTOMIPCADDR — C28 To M3 IPC Address Register (read/write to C28)
0x28 CTOMIPCDATAW — C28 To M3 IPC Data Write Register (read/write to C28)
0x2C CTOMIPCDATAR — C28 To M3 IPC Data Read Register (read only to C28)
0x30 MTOCIPCCOM — M3 To C28 IPC Command Register (read only to C28)
0x34 MTOCIPCADDR — M3 To C28 IPC Address Register (read only to C28)
0x38 MTOCIPCDATAW — M3 To C28 IPC Data Write Register (read only to C28)
0x3C MTOCIPCDATAR — M3 To C28 IPC Data Read Register (read/write to C28)
0x40 CTOMIPCBOOTSTS — IPC Boot Status Register (read only to C28)
0x44 MTOCIPCBOOTMODE — IPC Boot Mode Register (read only to C28)
0x48 CPUMPREQUEST — Flash programming semaphore PUMP request register
0x4C CCLKREQUEST — Clock configuration semaphore C28 request register

## MCBSPA — Multi-Channel Buffered Serial Port Registers
Base 0x0000A000
0x00 DRR2 16-bit — McBSP Data Receive Register 2
0x02 DRR1 16-bit — McBSP Data Receive Register 1
0x04 DXR2 16-bit — McBSP Data Transmit Register 2
0x06 DXR1 16-bit — McBSP Data Transmit Register 1
0x08 SPCR2 16-bit — McBSP Serial Port Control Register 2
0x0A SPCR1 16-bit — McBSP Serial Port Control Register 1
0x0C RCR2 16-bit — McBSP Receive Control Register 2
0x0E RCR1 16-bit — McBSP Receive Control Register 1
0x10 XCR2 16-bit — McBSP Transmit Control Register 2
0x12 XCR1 16-bit — McBSP Transmit Control Register 1
0x14 SRGR2 16-bit — McBSP Sample Rate Generator Register 2
0x16 SRGR1 16-bit — McBSP Sample Rate Generator Register 1
0x18 MCR2 16-bit — McBSP Multichannel Register 2
0x1A MCR1 16-bit — McBSP Multichannel Register 1
0x1C RCERA 16-bit — McBSP Receive Channel Enable Register Partition A
0x1E RCERB 16-bit — McBSP Receive Channel Enable Register Partition B
0x20 XCERA 16-bit — McBSP Transmit Channel Enable Register Partition A
0x22 XCERB 16-bit — McBSP Transmit Channel Enable Register Partition B
0x24 PCR 16-bit — McBSP Pin Control Register
0x26 RCERC 16-bit — McBSP Receive Channel Enable Register Partition C
0x28 RCERD 16-bit — McBSP Receive Channel Enable Register Partition D
0x2A XCERC 16-bit — McBSP Transmit Channel Enable Register Partition C
0x2C XCERD 16-bit — McBSP Transmit Channel Enable Register Partition D
0x2E RCERE 16-bit — McBSP Receive Channel Enable Register Partition E
0x30 RCERF 16-bit — McBSP Receive Channel Enable Register Partition F
0x32 XCERE 16-bit — McBSP Transmit Channel Enable Register Partition E
0x34 XCERF 16-bit — McBSP Transmit Channel Enable Register Partition F
0x36 RCERG 16-bit — McBSP Receive Channel Enable Register Partition G
0x38 RCERH 16-bit — McBSP Receive Channel Enable Register Partition H
0x3A XCERG 16-bit — McBSP Transmit Channel Enable Register Partition G
0x3C XCERH 16-bit — McBSP Transmit Channel Enable Register Partition H
0x46 MFFINT 16-bit — McBSP Interrupt Enable Register
