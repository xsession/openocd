# TMS320F28M35x_C28x register map
Vendor: Texas Instruments; Series: C2000 Concerto F28M35x; File version: 0.2.0-generated
Registers are 32-bit, read-write, reset 0x0 unless marked. A register's access mark holds for its fields unless they carry their own. Offsets are from the block's base; [hi:lo] are bit positions; {n}, {i} and the like mark numbered series.

## EPWM1 — EPWM REGS Registers
Base 0x0000A200
Same registers: EPWM{n} {0xA100+0x100*n} (n=2..9)
0x00 TBCTL 16-bit — Time Base Control Register
0x02 TBSTS 16-bit — Time Base Status Register
0x04 TBPHSHR 16-bit — Time Base Phase High Resolution Register
0x06 TBPHS 16-bit — Time Base Phase Register
0x08 TBCTR 16-bit — Time Base Counter Register
0x0A TBPRD 16-bit — Time Base Period Register
0x0C TBPRDHR 16-bit — Time Base Period High Resolution Register
0x0E CMPCTL 16-bit — Counter Compare Control Register
0x10 CMPAHR 16-bit — Counter Compare A High Resolution Register
0x12 CMPA 16-bit — Counter Compare A Register
0x14 CMPB 16-bit — Counter Compare B Register
0x16 AQCTLA 16-bit — Action Qualifier Control Register For Output A
0x18 AQCTLB 16-bit — Action Qualifier Control Register For Output B
0x1A AQSFRC 16-bit — Action Qualifier Software Force Register
0x1C AQCSFRC 16-bit — Action Qualifier Continuous S/W Force Register
0x1E DBCTL 16-bit — Dead-Band Generator Control Register
0x20 DBRED 16-bit — Dead-Band Generator Rising Edge Delay Count Register
0x22 DBFED 16-bit — Dead-Band Generator Falling Edge Delay Count Register
0x24 TZSEL 16-bit — Trip Zone Select Register
0x26 TZDCSEL 16-bit — Trip Zone Digital Comparator Select Register
0x28 TZCTL 16-bit — Trip Zone Control Register
0x2A TZEINT 16-bit — Trip Zone Enable Interrupt Register
0x2C TZFLG 16-bit — Trip Zone Flag Register
0x2E TZCLR 16-bit — Trip Zone Clear Register
0x30 TZFRC 16-bit — Trip Zone Force Register
0x32 ETSEL 16-bit — Event Trigger Selection Register
0x34 ETPS 16-bit — Event Trigger Pre-Scale Register
0x36 ETFLG 16-bit — Event Trigger Flag Register
0x38 ETCLR 16-bit — Event Trigger Clear Register
0x3A ETFRC 16-bit — Event Trigger Force Register
0x3C PCCTL 16-bit — PWM Chopper Control Register
0x40 HRCNFG 16-bit — HRPWM Configuration Register
0x42 HRPWR 16-bit — HRPWM Power Register
0x4E HRCNFG2 16-bit — HRPWM Configuration 2 Register
0x50 HRPCTL 16-bit — High Resolution Period Control Register
0x54 TBPRDHRM 16-bit — Time Base Period High Resolution Mirror Register
0x56 TBPRDM 16-bit — Time Base Period Mirror Register
0x58 CMPAHRM 16-bit — Compare A High Resolution Mirror Register
0x5A CMPAM 16-bit — Compare A Mirror Register
0x60 DCTRIPSEL 16-bit — Digital Compare Trip Select Register
0x62 DCACTL 16-bit — Digital Compare A Control Register
0x64 DCBCTL 16-bit — Digital Compare B Control Register
0x66 DCFCTL 16-bit — Digital Compare Filter Control Register
0x68 DCCAPCTL 16-bit — Digital Compare Capture Control Register
0x6A DCFOFFSET 16-bit — Digital Compare Filter Offset Register
0x6C DCFOFFSETCNT 16-bit — Digital Compare Filter Offset Counter Register
0x6E DCFWINDOW 16-bit — Digital Compare Filter Window Register
0x70 DCFWINDOWCNT 16-bit — Digital Compare Filter Window Counter Register
0x72 DCCAP 16-bit — Digital Compare Counter Capture Register
0x80 TBCTL2 16-bit — Time Base Control Register 2
0x82 CMPCTL2 16-bit — Counter Compare Control Register 2
0x8E AQCTLR 16-bit — Action Qualifier Control Register
0x94 CMPBHR 16-bit — Compare B High Resolution Register
0x98 DCAHTRIPSEL 16-bit — Digital Compare AH Trip Select
0x9A DCALTRIPSEL 16-bit — Digital Compare AL Trip Select
0x9C DCBHTRIPSEL 16-bit — Digital Compare BH Trip Select
0x9E DCBLTRIPSEL 16-bit — Digital Compare BL Trip Select
0xA0 ETINTPS 16-bit — Event-Trigger Interrupt Pre-Scale Register
0xA2 ETSOCPS 16-bit — Event-Trigger SOC Pre-Scale Register
0xA4 ETCNTINITCTL 16-bit — Event-Trigger Counter Initialization Control Register
0xA6 ETCNTINIT 16-bit — Event-Trigger Counter Initialization Register
0xBC EPWMXLINK
0xC0 TBPHSHRM 16-bit — Time Base Phase High Resolution Mirror Register
0xC2 TBPHSM 16-bit — Time Base Phase Mirror Register
0xC4 TBPRDHRM2 16-bit — Time Base Period High Resolution Mirror 2 Register
0xC6 TBPRDM2 16-bit — Time Base Period Mirror 2 Register
0xC8 CMPAHRM2 16-bit — Counter Compare A High Resolution Mirror 2 Register
0xCA CMPAM2 16-bit — Counter Compare A Mirror 2 Register
0xCC CMPBHRM 16-bit — Counter Compare B Mirror High Resolution Register
0xCE CMPBM 16-bit — Counter Compare B Mirror Register
0xD2 CMPC 16-bit — Counter Compare C Register
0xD6 CMPD 16-bit — Counter Compare D Register
0xD8 DBREDHR 16-bit — Dead-Band Generator Rising Edge Delay High Resolution Mirror Register
0xDA DBREDM 16-bit — Dead-Band Generator Rising Edge Delay Count Mirror Register
0xDC DBFEDHR 16-bit — Dead-Band Generator Falling Edge Delay High Resolution Register
0xDE DBFEDM 16-bit — Dead-Band Generator Falling Edge Delay Count Register
0xE0 ETCLRM 16-bit — Event Trigger Clear Register
0xE2 TZCLRM 16-bit — Trip Zone Clear Register
0xE6 AQCTLAM 16-bit — Action Qualifier Control Register For Output A
0xE8 AQCTLBM 16-bit — Action Qualifier Control Register For Output B
0xEA AQSFRCM 16-bit — Action Qualifier Software Force Register
0xEC AQCSFRCM 16-bit — Action Qualifier Continuous S/W Force Register
