# TMS320F28M35x_C28x register map
Vendor: Texas Instruments; Series: C2000 Concerto F28M35x; File version: 0.2.0-generated
Registers are 32-bit, read-write, reset 0x0 unless marked. A register's access mark holds for its fields unless they carry their own. Offsets are from the block's base; [hi:lo] are bit positions; {n}, {i} and the like mark numbered series.

## I2C0_MASTER — I2C MASTER REGS Registers
Base 0x80040000
Same registers: I2C1_MASTER 0x80042000
0x00 I2CMSA — I2C Master Slave Address
0x08 I2CMCS — I2C Master Control/Status
0x10 I2CMDR — I2C Master Data
0x18 I2CMTPR — I2C Master Timer Period
0x20 I2CMIMR — I2C Master Interrupt Mask
0x28 I2CMRIS — I2C Master Raw Interrupt Status
0x30 I2CMMIS — I2C Master Masked Interrupt Status
0x38 I2CMICR — I2C Master Interrupt Clear
0x40 I2CMCR — I2C Master Configuration

## I2C0_SLAVE — I2C SLAVE REGS Registers
Base 0x80041000
Same registers: I2C1_SLAVE 0x80043000
0x00 I2CSOAR — I2C Slave Own Address
0x08 I2CSCSR — I2C Slave Control/Status
0x10 I2CSDR — I2C Slave Data
0x18 I2CSIMR — I2C Slave Interrupt Mask
0x20 I2CSRIS — I2C Slave Raw Interrupt Status
0x28 I2CSMIS — I2C Slave Masked Interrupt Status
0x30 I2CSICR — I2C Slave Interrupt Clear

## TIMER0 — GPTM REGS Registers
Base 0x80060000
Same registers: TIMER1 0x80062000, TIMER2 0x80064000, TIMER3 0x80066000
0x00 GPTMCFG — GPTM Configuration
0x08 GPTMTAMR — GPTM Timer A Mode
0x10 GPTMTBMR — GPTM Timer B Mode
0x18 GPTMCTL — GPTM Control
0x30 GPTMIMR — GPTM Interrupt Mask
0x38 GPTMRIS — GPTM Raw Interrupt Status
0x40 GPTMMIS — GPTM Masked Interrupt Status
0x48 GPTMICR — GPTM Interrupt Clear
0x50 GPTMTAILR — GPTM Timer A Interval Load
0x58 GPTMTBILR — GPTM Timer B Interval Load
0x60 GPTMTAMATCHR — GPTM Timer A Match
0x68 GPTMTBMATCHR — GPTM Timer B Match
0x70 GPTMTAPR — GPTM Timer A Prescale
0x78 GPTMTBPR — GPTM Timer B Prescale
0x80 GPTMTAPMR — GPTM TimerA Prescale Match
0x88 GPTMTBPMR — GPTM TimerB Prescale Match
0x90 GPTMTAR — GPTM Timer A
0x98 GPTMTBR — GPTM Timer B
0xA0 GPTMTAV — GPTM Timer A Value
0xA8 GPTMTBV — GPTM Timer B Value

## EMAC0 — EMAC REGS Registers
Base 0x80090000
0x00 MACRIS_ACK — EMAC Raw Interrupt Status \ Acknowledge
0x08 MACIM — EMAC Interrupt Mask
0x10 MACRCTL — EMAC Receive Control
0x18 MACTCTL — EMAC Transmit Control
0x20 MACDATA — EMAC Data
0x28 MACIA0 — EMAC Individual Adddress 0
0x30 MACIA1 — EMAC Individual Adddress 1
0x38 MACTHR — EMAC Threshold
0x40 MACMCTL — EMAC Management Control
0x48 MACMDV — EMAC Management Divider
0x58 MACMTXD — EMAC Management Transmit Data
0x60 MACMRXD — EMAC Management Receive Data
0x68 MACNP — EMAC Number of Packets
0x70 MACTR — EMAC Transmission Request
0x78 MACTS — EMAC Timer Support

## CAN0 — CAN REGS Registers
Base 0x800E0000
Same registers: CAN1 0x800E8000
0x00 CAN_CTL — CAN Control Register
0x08 CAN_ES — CAN Error and Status Register
0x10 CAN_ERRC — CAN Error Counter Register
0x18 CAN_BTR — CAN Bit Timing Register
0x20 CAN_INT — CAN Interrupt Register
0x28 CAN_TEST
0x38 CAN_PERR — CAN Parity Error Code Register
0x100 CAN_ABOTR — CAN Auto-bus-on Time Register
0x110 CAN_TXRQ — CAN Transmission Request 2_1 Register
0x138 CAN_NWDAT — CAN New Data 2_1 Register
0x160 CAN_INTPND — CAN Interrupt Pending 2_1 Register
0x188 CAN_MSGVAL — CAN Message Valid 2_1 Register
0x1B0 CAN_INTMUX — CAN Interrupt Multiplexer 2_1 Register
0x200 CAN_IF1CMD — CAN Interface 1 Command Register
{0x1C8+0x40*i} CAN_IF{i}MSK (i=1..3) — CAN Interface {i} Mask Register
{0x1D0+0x40*i} CAN_IF{i}ARB (i=1..3) — CAN Interface {i} Arbitration Register
{0x1D8+0x40*i} CAN_IF{i}MCTL (i=1..3) — CAN Interface {i} Message Control Register
{0x1E0+0x40*i} CAN_IF{i}DATA (i=1..3) — CAN Interface {i} DATA A2_A1 Register
{0x1E8+0x40*i} CAN_IF{i}DATB (i=1..3) — CAN Interface {i} DATA B2_B1 Register
0x240 CAN_IF2CMD — CAN Interface 2 Command Register
0x280 CAN_IF3OBS — CAN Interface 3 Observation Register
0x2C0 CAN_IF3UPD — CAN Interface 3 Update Enable 2_1 Register
