# TMS320F28M35x_C28x register map
Vendor: Texas Instruments; Series: C2000 Concerto F28M35x; File version: 0.2.0-generated
Registers are 32-bit, read-write, reset 0x0 unless marked. A register's access mark holds for its fields unless they carry their own. Offsets are from the block's base; [hi:lo] are bit positions; {n}, {i} and the like mark numbered series.

## ECAP1 — eCAP Control and Status Registers
Base 0x0000B400
Same registers: ECAP2 0x0000B440, ECAP3 0x0000B480, ECAP4 0x0000B4C0, ECAP5 0x0000B500, ECAP6 0x0000B540
0x00 TSCTR — eCAP Time-Stamp Counter
0x04 CTRPHS — eCAP Counter Phase Offset Value Register
{0x4+4i} CAP{i} (i=1..4) — eCAP Capture {i} Register
0x28 ECCTL1 16-bit — eCAP Capture Control Register 1
0x2A ECCTL2 16-bit — eCAP Capture Control Register 2
0x2C ECEINT 16-bit — eCAP Capture Interrupt Enable Register
0x2E ECFLG 16-bit — eCAP Capture Interrupt Flag Register
0x30 ECCLR 16-bit — eCAP Capture Interrupt Clear Register
0x32 ECFRC 16-bit — eCAP Capture Interrupt Force Register

## EQEP1 — eQEP Control and Status Registers
Base 0x0000B600
Same registers: EQEP2 0x0000B680, EQEP3 0x0000B700
0x00 QPOSCNT — eQEP Position Counter
0x04 QPOSINIT — eQEP Initialization Position Count
0x08 QPOSMAX — eQEP Maximum Position Count
0x0C QPOSCMP — eQEP Position-compare
0x10 QPOSILAT — eQEP Index Position Latch
0x14 QPOSSLAT — eQEP Strobe Position Latch
0x18 QPOSLAT — eQEP Position Latch
0x1C QUTMR — eQEP Unit Timer
0x20 QUPRD — eQEP Unit Period Register
0x24 QWDTMR 16-bit — eQEP Watchdog Timer
0x26 QWDPRD 16-bit — eQEP Watchdog Period Register
0x28 QDECCTL 16-bit — eQEP Decoder Control Register
0x2A QEPCTL 16-bit — eQEP Control Register
0x2C QCAPCTL 16-bit — eQEP Capture Control Register
0x2E QPOSCTL 16-bit — eQEP Position-compare Control Register
0x30 QEINT 16-bit — eQEP Interrupt Enable Register
0x32 QFLG 16-bit — eQEP Interrupt Flag Register
0x34 QCLR 16-bit — eQEP Interrupt Clear Register
0x36 QFRC 16-bit — eQEP Interrupt Force Register
0x38 QEPSTS 16-bit — eQEP Status Register
0x3A QCTMR 16-bit — eQEP Capture Timer
0x3C QCPRD 16-bit — eQEP Capture Period Register
0x3E QCTMRLAT 16-bit — eQEP Capture Timer Latch
0x40 QCPRDLAT 16-bit — eQEP Capture Period Latch

## GPIOG1CTRL — GPIOG1 CTRL REGS Registers
Base 0x0000BF00
0x00 GPACTRL — GPIO A Control Register (GPIO0 to 31)
0x04 GPAQSEL1 — GPIO A Qualifier Select 1 Register (GPIO0 to 15)
0x08 GPAQSEL2 — GPIO A Qualifier Select 2 Register (GPIO16 to 31)
0x0C GPAMUX1 — GPIO A Mux 1 Register (GPIO0 to 15)
0x10 GPAMUX2 — GPIO A Mux 2 Register (GPIO16 to 31)
0x14 GPADIR — GPIO A Direction Register (GPIO0 to 31) )
0x20 GPBCTRL — GPIO B Control Register (GPIO32 to 63)
0x24 GPBQSEL1 — GPIO B Qualifier Select 1 Register (GPIO32 to 47)
0x28 GPBQSEL2 — GPIO B Qualifier Select 2 Register (GPIO48 to 63)
0x2C GPBMUX1 — GPIO B Mux 1 Register (GPIO32 to 47)
0x30 GPBMUX2 — GPIO B Mux 2 Register (GPIO48 to 63)
0x34 GPBDIR — GPIO B Direction Register (GPIO32 to 63)
0x40 GPCCTRL — GPIO C Control Register (GPIO68 to 71)
0x44 GPCQSEL1 — GPIO C Qualifier Select 1 Register (GPIO68 to 71)
0x4C GPCMUX1 — GPIO C Mux 1 Register (GPIO68 to 71)
0x54 GPCDIR — GPIO C Direction Register (GPIO68 to 71)

## GPIOG1DAT — GPIOG1 DATA REGS Registers
Base 0x0000BF80
0x00 GPADAT — GPIO A Data Register (GPIO0 to 31)
0x04 GPASET — GPIO A Data Set Register (GPIO0 to 31)
0x08 GPACLEAR — GPIO A Data Clear Register (GPIO0 to 31)
0x0C GPATOGGLE — GPIO A Data Toggle Register (GPIO0 to 31)
0x10 GPBDAT — GPIO B Data Register (GPIO32 to 63)
0x14 GPBSET — GPIO B Data Set Register (GPIO32 to 63)
0x18 GPBCLEAR — GPIO B Data Clear Register (GPIO32 to 63)
0x1C GPBTOGGLE — GPIO B Data Toggle Register (GPIO32 to 63)
0x20 GPCDAT — GPIO C Data Register (GPIO68 to 71)
0x24 GPCSET — GPIO C Data Set Register (GPIO68 to 71)
0x28 GPCCLEAR — GPIO C Data Clear Register (GPIO32 to 63)
0x2C GPCTOGGLE — GPIO C Data Toggle Register (GPIO32 to 63)

## GPIOG1TRIP — GPIOG1 TRIP REGS Registers
Base 0x0000BFC0
0x00 GPTRIP1SEL 16-bit — GPTRIP1 (TZ1n) Input Select Register (GPIO0 to 63)
0x02 GPTRIP2SEL 16-bit — GPTRIP2 (TZ2n) Input Select Register (GPIO0 to 63)
0x04 GPTRIP3SEL 16-bit — GPTRIP3 (TZ3n) Input Select Register (GPIO0 to 63)
0x06 GPTRIP4SEL 16-bit — GPTRIP4 (XINT1) Input Select Register (GPIO0 to 63)
0x08 GPTRIP5SEL 16-bit — GPTRIP5 (XINT2) Input Select Register (GPIO0 to 63)
0x0A GPTRIP6SEL 16-bit — GPTRIP6 (XINT3 and SYNCIN) Input Select Register (GPIO0 to 63)
0x0C GPTRIP7SEL 16-bit — GPTRIP7 (ECAP1) Input Select Register (GPIO0 to 63)
0x0E GPTRIP8SEL 16-bit — GPTRIP8 (ECAP2) Input Select Register (GPIO0 to 63)
0x10 GPIOLPMSEL1 — C28 LPM GPIO Select 1 Register (GPIO0 to 31)
0x14 GPIOLPMSEL2 — C28 LPM GPIO Select 2 Register (GPIO32 to 63)
{0xE+2i} GPTRIP{i}SEL 16-bit (i=9..12) — GPTRIP{i} (ECAP{i-6}) Input Select Register (GPIO0 to 63)
