# TMS320F28M35x_C28x register map
Vendor: Texas Instruments; Series: C2000 Concerto F28M35x; File version: 0.2.0-generated
Registers are 32-bit, read-write, reset 0x0 unless marked. A register's access mark holds for its fields unless they carry their own. Offsets are from the block's base; [hi:lo] are bit positions; {n}, {i} and the like mark numbered series.

## COMP1 — COMP REGS Registers
Base 0x0000C800
Same registers: COMP2 0x0000C840, COMP3 0x0000C880, COMP4 0x0000C8C0, COMP5 0x0000C900, COMP6 0x0000C940
0x00 COMPCTL 16-bit — Comparator Control
0x04 COMPSTS 16-bit — Compare Output States
0x0C DACVAL 16-bit — 10-bit DAV Value

## GPIOG2CTRL — GPIOG2 CTRL REGS Registers
Base 0x0000DF00
0x00 GPECTRL — GPIO E Control Register (GPIO128 to 135)
0x04 GPEQSEL1 — GPIO E Qualifier Select 1 Register (GPIO128 to 135)
0x0C GPEMUX1 — GPIO E Mux 1 Register (GPIO128 to 135)
0x14 GPEDIR — GPIO E Direction Register (GPIO128 to 135 )
0x18 GPEPUD — GPEPUD register for (GPIO128 to 135)
0x6C AIOMUX1 — Analog IO Mux 1 Register (AIO0-15)
0x70 AIOMUX2 — Analog IO Mux 2 Register (AIO16-31)
0x74 AIODIR — Analog IO Direction Register (AIO0-31)

## GPIOG2DAT — GPIOG2 DATA REGS Registers
Base 0x0000DF80
0x00 GPEDAT — GPIO E Data Register (GPIO128 to 135)
0x04 GPESET — GPIO E Data Set Register (GPIO128 to 135)
0x08 GPECLEAR — GPIO E Data Clear Register (GPIO128 to 135)
0x0C GPETOGGLE — GPIO E Data Toggle Register (GPIO128 to 135)
0x30 AIODAT — Analog IO Data Register (AIO0 to 31)
0x34 AIOSET — Analog IO Data Set Register (AIO0 to 31)
0x38 AIOCLEAR — Analog IO Data Clear Register (AIO0 to 31)
0x3C AIOTOGGLE — Analog IO Data Toggle Register (AIO0 to 31)

## SYSCTRL — SYS CTRL REGS Registers
Base 0x0000E020
0x04 CLKCTL 16-bit — CPU Timer 2 Clock Configuration Register
0x12 PCLKCR2 16-bit — Peripheral Clock Control Register2
0x14 HISPCP 16-bit — High Speed Clock Prescaler
0x16 LOSPCP 16-bit — Low Speed Clock Prescaler
0x18 PCLKCR0 16-bit — Peripheral Clock Control Register0
0x1A PCLKCR1 16-bit — Peripheral Clock Control Register1
0x1C LPMCR0 16-bit — C28 LPM Control Register0
0x20 PCLKCR3 16-bit — Peripheral Clock Control Register3
0x36 CWIR 16-bit — Control subsystem Wait-in-Reset Register

## SPIA — Serial Peripheral Interface Registers
Base 0x0000E080
0x00 SPICCR 16-bit — SPI Configuration Control Register
0x02 SPICTL 16-bit — SPI Operation Control Register
0x04 SPISTS 16-bit — SPI Status Register
0x08 SPIBRR 16-bit — SPI Baud Rate Register
0x0C SPIRXEMU 16-bit — SPI Receive Emulation Buffer Register
0x0E SPIRXBUF 16-bit — SPI Serial Input Buffer Register
0x10 SPITXBUF 16-bit — SPI Serial Output Buffer Register
0x12 SPIDAT 16-bit — SPI Serial Data Register
0x14 SPIFFTX 16-bit — SPI FIFO Transmit Register
0x16 SPIFFRX 16-bit — SPI FIFO Receive Register
0x18 SPIFFCT 16-bit — SPI FIFO Control Register
0x1E SPIPRI 16-bit — SPI Priority Control Register

## NMI — NMI INTRUPT REGS Registers
Base 0x0000E0C0
0x00 NMICFG 16-bit — C28 NMI Configuration Register
0x02 NMIFLG 16-bit — C28 NMI Flag Register
0x04 NMIFLGCLR 16-bit — C28 NMI Flag Clear Register
0x06 NMIFLGFRC 16-bit — C28 NMI Flag Force Register
0x08 NMIWDCNT 16-bit — C28 NMI Watchdog Counter Register
0x0A NMIWDPRD 16-bit — C28 NMI Watchdog Period Register

## XINT — External Interrupt Registers
Base 0x0000E0E0
0x00 XINT1CR 16-bit — XINT1 configuration register
0x02 XINT2CR 16-bit — XINT2 configuration register
0x04 XINT3CR 16-bit — XINT3 configuration register
0x10 XINT1CTR 16-bit — XINT1 counter register
0x12 XINT2CTR 16-bit — XINT2 counter register
0x12 XINT3CTR 16-bit — XINT3 counter register

## ADC1 — ADC Registers
Base 0x0000E200
Same registers: ADC2 0x0000E300
0x00 ADCCTL1 16-bit — ADC Control 1
0x02 ADCCTL2 16-bit — ADC Control 2
0x08 ADCINTFLG 16-bit — ADC Interrupt Flag
0x0A ADCINTFLGCLR 16-bit — ADC Interrupt Flag Clear
0x0C ADCINTOVF 16-bit — ADC Interrupt Overflow
0x0E ADCINTOVFCLR 16-bit — ADC Interrupt Overflow Clear
0x10 INTSEL1N2 16-bit — ADC Interrupt 1 and 2 Selection
0x12 INTSEL3N4 16-bit — ADC Interrupt 3 and 4 Selection
0x14 INTSEL5N6 16-bit — ADC Interrupt 5 and 6 Selection
0x16 INTSEL7N8 16-bit — ADC Interrupt 7 and 8 Selection
0x18 INTSEL9N10 16-bit — ADC Interrupt 9 and 10 Selection
0x20 SOCPRICTL 16-bit — ADC SOC Priority Control
0x24 ADCSAMPLEMODE 16-bit — ADC Sampling Mode
0x28 ADCINTSOCSEL1 16-bit — ADC Interrupt SOC Selection 1
0x2A ADCINTSOCSEL2 16-bit — ADC Interrupt SOC Selection 2
0x30 ADCSOCFLG1 16-bit — ADC SOC Flag 1
0x34 ADCSOCFRC1 16-bit — ADC SOC Flag Force 1
0x38 ADCSOCOVF1 16-bit — ADC SOC Overflow 1
0x3C ADCSOCOVFCLR1 16-bit — ADC SOC Overflow Clear 1
{0x40+2i} ADCSOC{i}CTL 16-bit (i=0..15) — ADC SOC{i} Control
0x80 ADCREFTRIM 16-bit — Reference Trim Register
0x82 ADCOFFTRIM 16-bit — Offset Trim Register
0x98 COMPHYSTCTL 16-bit — Comparator Hysteresis Control Register
