# TMS320F28M35x_C28x register map
Vendor: Texas Instruments; Series: C2000 Concerto F28M35x; File version: 0.2.0-generated
Generated from TI CCS targetdb file f28m35m52c1.xml. Review against the TI technical reference manual before production use.
Registers are 32-bit, read-write, reset 0x0 unless marked. A register's access mark holds for its fields unless they carry their own. Offsets are from the block's base; lines under a group give offsets from that group; [hi:lo] are bit positions; {n}, {i} and the like mark numbered series; 'fields as' and 'values as' point back to an identical list; <NAME> marks a mode.

## Memory map
0x00001100 DEVEMU — DEV EMU REGS Registers
0x000015C0 CSM — DCSM REGS Registers
0x00001600 ADC1RESULT — ADC Mirror Registers
0x00001680 ADC2RESULT — ADC Mirror Registers
0x00001800 CPUTIMER — CPU Timer Registers
0x000019C0 PIECTRL — Peripheral Interrupt Expansion Registers
0x00001E00 FPU — Floating-Point Unit Single Precision Registers
0x00002000 DMA — DMA Registers
0x00002400 VCU — VCU Registers
0x00008000 FLASHCTRL — FLASH CTRL REGS Registers
0x00008600 FLASHECC — FLASH ECC REGS Registers
0x00008860 EPI — EPI REGS Registers
0x00009C00 IPC — CTOM IPC REGS Registers
0x0000A000 MCBSPA — Multi-Channel Buffered Serial Port Registers
{0xA100+0x100*n} EPWM{n} (n=1..9) — EPWM REGS Registers
0x0000B400 ECAP1 — eCAP Control and Status Registers
0x0000B440 ECAP2 — eCAP Control and Status Registers
0x0000B480 ECAP3 — eCAP Control and Status Registers
0x0000B4C0 ECAP4 — eCAP Control and Status Registers
0x0000B500 ECAP5 — eCAP Control and Status Registers
0x0000B540 ECAP6 — eCAP Control and Status Registers
0x0000B600 EQEP1 — eQEP Control and Status Registers
0x0000B680 EQEP2 — eQEP Control and Status Registers
0x0000B700 EQEP3 — eQEP Control and Status Registers
0x0000BF00 GPIOG1CTRL — GPIOG1 CTRL REGS Registers
0x0000BF80 GPIOG1DAT — GPIOG1 DATA REGS Registers
0x0000BFC0 GPIOG1TRIP — GPIOG1 TRIP REGS Registers
0x0000C800 COMP1 — COMP REGS Registers
0x0000C840 COMP2 — COMP REGS Registers
0x0000C880 COMP3 — COMP REGS Registers
0x0000C8C0 COMP4 — COMP REGS Registers
0x0000C900 COMP5 — COMP REGS Registers
0x0000C940 COMP6 — COMP REGS Registers
0x0000DF00 GPIOG2CTRL — GPIOG2 CTRL REGS Registers
0x0000DF80 GPIOG2DAT — GPIOG2 DATA REGS Registers
0x0000E020 SYSCTRL — SYS CTRL REGS Registers
0x0000E080 SPIA — Serial Peripheral Interface Registers
0x0000E0A0 SCIA — SCI Registers
0x0000E0C0 NMI — NMI INTRUPT REGS Registers
0x0000E0E0 XINT — External Interrupt Registers
0x0000E200 ADC1 — ADC Registers
0x0000E300 ADC2 — ADC Registers
0x0000F200 I2CA — I2C Registers
0x80000000 WDT0 — WDT REGS Registers
0x80002000 WDT1 — WDT REGS Registers
0x80008000 GPIO_PORTA — GPIO REGS Registers
0x8000A000 GPIO_PORTB — GPIO REGS Registers
0x8000C000 GPIO_PORTC — GPIO REGS Registers
0x8000E000 GPIO_PORTD — GPIO REGS Registers
0x80010000 SSI0 — SSI REGS Registers
0x80012000 SSI1 — SSI REGS Registers
0x80014000 SSI2 — SSI REGS Registers
0x80016000 SSI3 — SSI REGS Registers
0x80018000 UART0 — UART REGS Registers
0x8001A000 UART1 — UART REGS Registers
0x8001C000 UART2 — UART REGS Registers
0x8001E000 UART3 — UART REGS Registers
0x80020000 UART4 — UART REGS Registers
0x80040000 I2C0_MASTER — I2C MASTER REGS Registers
0x80041000 I2C0_SLAVE — I2C SLAVE REGS Registers
0x80042000 I2C1_MASTER — I2C MASTER REGS Registers
0x80043000 I2C1_SLAVE — I2C SLAVE REGS Registers
0x80048000 GPIO_PORTE — GPIO REGS Registers
0x8004A000 GPIO_PORTF — GPIO REGS Registers
0x8004C000 GPIO_PORTG — GPIO REGS Registers
0x8004E000 GPIO_PORTH — GPIO REGS Registers
0x80060000 TIMER0 — GPTM REGS Registers
0x80062000 TIMER1 — GPTM REGS Registers
0x80064000 TIMER2 — GPTM REGS Registers
0x80066000 TIMER3 — GPTM REGS Registers
0x8007A000 GPIO_PORTJ — GPIO REGS Registers
0x80090000 EMAC0 — EMAC REGS Registers
0x800A0000 USB0 — Univeral Serial Bus register offsets
0x800B0000 GPIO_PORTA_AHB — GPIO REGS Registers
0x800B2000 GPIO_PORTB_AHB — GPIO REGS Registers
0x800B4000 GPIO_PORTC_AHB — GPIO REGS Registers
0x800B6000 GPIO_PORTD_AHB — GPIO REGS Registers
0x800B8000 GPIO_PORTE_AHB — GPIO REGS Registers
0x800BA000 GPIO_PORTF_AHB — GPIO REGS Registers
0x800BC000 GPIO_PORTG_AHB — GPIO REGS Registers
0x800BE000 GPIO_PORTH_AHB — GPIO REGS Registers
0x800C0000 GPIO_PORTJ_AHB — GPIO REGS Registers
0x800E0000 CAN0 — CAN REGS Registers
0x800E8000 CAN1 — CAN REGS Registers
0x801A0000 EPI0 — EPI REGS Registers
0x801F4000 FLASH_CONTROL — FLASH REGS Registers
0x801F4C00 FLASH_ERROR — FLASH ERR REGS Registers
0x801F6400 RAM_CONFIG — RAM CONFIG REGS Registers
0x801F6600 RAM_ERROR — RAM ERR REGS Registers
0x801F6800 DCSM — DCSM REGS Registers
0x801F6C00 UCRC — UCRCREGS Registers
0x801F7000 SYSCTL — SYSCTL REGS Registers
0x801FE000 UDMA — UDMA REGS Registers
0x1C001C000 COREPERIPH — M3 CORE PERIPHERALS Registers

## Further device data
tiCore=C28X, tiAddressScale=2, tiCortexDebugCompatible=false, tiProcessorName=c28x, tiGenerator=ti-c2000-toolchain

## Licence text in the file
Generated metadata follows the license of the source TI files. Generator code is MIT licensed.
