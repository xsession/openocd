# TMS320F28M35x_C28x register map
Vendor: Texas Instruments; Series: C2000 Concerto F28M35x; File version: 0.2.0-generated
Registers are 32-bit, read-write, reset 0x0 unless marked. A register's access mark holds for its fields unless they carry their own. Offsets are from the block's base; [hi:lo] are bit positions; {n}, {i} and the like mark numbered series.

## RAM_ERROR — RAM ERR REGS Registers
Base 0x801F6600
0x00 MCUNCWEADDR — M3 CPU Uncorrectable Write Error Address Register
0x08 MDUNCWEADDR — M3 μDMA Uncorrectable Write Error Address Register
0x10 MCUNCREADDR — M3 CPU Uncorrectable Read Error Address Register
0x18 MDUNCREADDR — M3 μDMA Uncorrectable Read Error Address Register
0x20 MCPUCREADDR — M3 CPU Corrected Read Error Address Register
0x28 MDMACREADDR — M3 μDMA Corrected Read Error Address Register
0x40 MUEFLG — M3 Uncorrectable Error Flag Register
0x48 MUEFRC — M3 Uncorrectable Error Force Register
0x50 MUECLR — M3 Uncorrectable Error Flag Clear Register
0x58 MCECNTR — M3 Corrected Error Counter Register
0x60 MCETRES — M3 Corrected Error Threshold Register
0x70 MCEFLG — M3 Corrected Error Threshold Exceeded Flag Register
0x78 MCEFRC — M3 Corrected Error Threshold Exceeded Force Register
0x80 MCECLR — M3 Corrected Error Threshold Exceeded Flag Clear Register
0x88 MCEIE — M3 Single Error Interrupt Enable Register
0xA0 MNMAVFLG — Non-Master Access Violation Flag Register
0xB0 MNMAVCLR — Non-Master Access Violation Flag Clear Register
0xC0 MMAVFLG — Master Access Violation Flag Register
0xD0 MMAVCLR — Master Access Violation Flag Clear Register
0xE0 MNMWRAVADDR — Non-Master CPU Write Access Violation Address Register
0xE8 MNMDMAWRAVADDR — Non-Master DMA Write Access Violation Address Register
0xF0 MNMFAVADDR — Non-Master CPU Fetch Access Violation Address Register
0x100 MMWRAVADDR — Master CPU Write Access Violation Address Register
0x108 MMDMAWRAVADDR — Master DMA Write Access Violation Address Register
0x110 MMFAVADDR — Master CPU Fetch Access Violation Address Register

## DCSM — DCSM REGS Registers
Base 0x801F6800
{0x0+8i} Z1_CSMKEY{i} (i=0..3) — CSMKEY Register for M3-Zone-1 security Zone
0x20 Z1_ECSLKEY0 — ECSLKEY Register for M3-Zone-1 security Zone
0x28 Z1_ECSLKEY1 — ECSLKEY Register for M3-Zone-1 security Zone
{0x30+8i} Z2_CSMKEY{i} (i=0..3) — CSMKEY Register for M3-Zone-2 security Zone
0x50 Z2_ECSLKEY0 — ECSLKEY Register for M3-Zone-2 security Zone
0x58 Z2_ECSLKEY1 — ECSLKEY Register for M3-Zone-2 security Zone
0xC0 Z1_CSMLOCKSR — Locked Status Register for CSM passwords of M3-Zone-1 security Zone
0xC8 Z1_ECSLLOCKSR — Locked Status Register for ECSL passwords of M3-Zone-1 security Zone
0xD0 Z2_CSMLOCKSR — Locked Status Register for CSM passwords of M3-Zone-2 security Zone
0xD8 Z2_ECSLLOCKSR — Locked Status Register for ECSL passwords of M3-Zone-2 security Zone
0x100 Z1_CR — Status and Control Register for M3-Zone-1 security Zone
0x108 Z2_CR — Status and Control Register for M3-Zone-2 security Zone
0x120 Z1_GRABSECTR — Grab Flash-Sectors Register for M3-Zone-1 security Zone
0x128 Z1_GRABRAMR — Grab RAM-blocks Register for M3-Zone-1 security Zone
0x130 Z2_GRABSECTR — Grab Flash-Sectors Register for M3-Zone-2 security Zone
0x138 Z2_GRABRAMR — Grab RAM-blocks Register for M3-Zone-2 security Zone
0x160 Z1_EXEONLYR — Execute-Only Select Register for flash sectors mapped to M3-Zone-1 security Zone
0x168 Z2_EXEONLYR — Execute-Only Select Register for flash sectors mapped to M3-Zone-2 security Zone

## UCRC — UCRCREGS Registers
Base 0x801F6C00
0x00 UCRCCONFIG — uCRC Configuration Register
0x08 UCRCCONTROL
0x10 UCRCRES — uCRC Result Register

## SYSCTL — SYSCTL REGS Registers
Base 0x801F7000
0x00 SYSPLLCTL — System PLL Configuration Register
0x08 SYSPLLMULT — System PLL Multiplier
0x10 SYSPLLSTS — System PLL lock status
0x18 SYSDIVSEL — System clock divider
0x20 M3SSDIVSEL — M3 Sub system clock divider
0x40 UPLLCTL — USB PLL config register
0x48 UPLLMULT — USB PLL Multiplier
0x50 UPLLSTS — USB PLL lock status
0x60 MCLKSTS — Missing clock status register
0x68 MCLKCTL — Missing clock configuration register
0x70 MCLKFRCCLR — Missing clock force register
0x78 MCLKEN — Missing clock enable register
0x80 MREFCLKLIM — Missing clock reference limit registers
0xA0 XPLLCLKCFG — XPLL clkout control register
0xC0 CCLKOFF — C28 clock disable register
0xE0 CAN0BCLKSEL — Bit clock source selection for CAN0
0xE8 CAN1BCLKSEL — Bit clock source selection for CAN1
0x100 CLPMSTAT — C28 Low Power Mode Status
0x180 CRESCNF — C28 Reset Configuration
0x188 CRESSTS — C28 Reset Status
0x190 FUSEERR — Efuse Error Status
0x198 MWIR — WIR Decode Latch Register
0x200 MCNF — M3 Sub System Configuration
0x210 SERPLOOP — Serial Port Loop Back Control
0x218 MCIBSTATUS — Analog System Status Register
{0x220+8i} CCNF{i} (i=0..4) — C28 Peripheral Configuration {i}
0x260 MEMCNF — M3 Memory Configuration
0x300 MWRALLOW — M3 Configuration Write Allow
0x308 MLOCK — M3 Configuration Lock Register
0x5000 DID0 — Device ID 0
0x5008 DID1 — Device ID 1
0x5020 DC1 — Device Capabilities 1
0x5028 DC2 — Device Capabilities 2
0x5038 DC4 — Device Capabilities 4
0x5048 DC6 — Device Capabilities 6
0x5050 DC7 — Device Capabilities 7
{0x5080+8i} SRCR{i} (i=0..3) — Software Reset Control {i}
0x50B8 RESC — M3 Reset Cause
0x50C0 RCC — Run Mode Clock
0x50D8 GPIOHBCTL — GPIO High Performance Bus Control
{0x5200+8i} RCGC{i} (i=0..3) — Run Mode Clock Gating Control - Register {i}
{0x5220+8i} SCGC{i} (i=0..3) — Sleep Mode Clock Gating Control - Register {i}
{0x5240+8i} DCGC{i} (i=0..3) — Deep Sleep Mode Clock Gating Control - Register {i}
0x5288 DSLPCLKCFG — Deep Sleep Clock Configuration
0x5328 DC10 — Device Configuration 10
0x5340 NVMSTAT — Non-Volatile Memory Status

## UDMA — UDMA REGS Registers
Base 0x801FE000
0x00 DMASTAT — DMA Status
0x08 DMACFG — DMA Configuration
0x10 DMACTLBASE — DMA Channel Control Base Pointer
0x18 DMAALTBASE — DMA Alternate Channel Control Base Pointer
0x20 DMAWAITSTAT — DMA Channel Wait-on-Request Status
0x28 DMASWREQ — DMA Channel Software Request
0x30 DMAUSEBURSTSET — DMA Channel Useburst Set
0x38 DMAUSEBURSTCLR — DMA Channel Useburst Clear
0x40 DMAREQMASKSET — DMA Channel Request Mask Set
0x48 DMAREQMASKCLR — DMA Channel Request Mask Clear
0x50 DMAENASET — DMA Channel Enable Set
0x58 DMAENACLR — DMA Channel Enable Clear
0x60 DMAALTSET — DMA Channel Primary Alternate Set
0x68 DMAALTCLR — DMA Channel Primary Alternate Clear 290
0x70 DMAPRIOSET — DMA Channel Priority Set
0x78 DMAPRIOCLR — DMA Channel Priority Clear
0x98 DMAERRCLR — DMA Bus Error Clear
0xA00 DMACHALTL — DMA Channel Alternate Select
{0xA20+8i} DMACHMAP{i} (i=0..3) — DMA Channel Map Select {i}

## COREPERIPH — M3 CORE PERIPHERALS Registers
Base 0x1C001C000
0x08 NVIC_INT_TYPE — Interrupt Controller Type Reg
0x20 SYSTICK_ST_CTRL — SysTick Control and Status Reg
0x28 SYSTICK_ST_RELOAD — SysTick Reload Value Register
0x30 SYSTICK_ST_CURRENT — SysTick Current Value Register
0x38 SYSTICK_ST_CAL — SysTick Calibration Value Reg
{0x200+8i} NVIC_EN{i} (i=0..3) — IRQ {32i} to {32i+31} Set Enable Register
0x220 NVIC_EN4 — IRQ 128 to 133 Set Enable Register
{0x300+8i} NVIC_DIS{i} (i=0..3) — IRQ {32i} to {32i+31} Clear Enable Reg
0x320 NVIC_DIS4 — IRQ 128 to 133 Clear Enable Reg
0x400 NVIC_PEND0 — IRQ 0 to 31 Set Pending Register
{0x400+8i} NVIC_PEND{i} (i=1..3) — IRQ {32i} to {32i+31} Set Pending Reg
0x420 NVIC_PEND4 — IRQ 128 to 133 Set Pending Reg
{0x500+8i} NVIC_UNPEND{i} (i=0..3) — IRQ {32i} to {32i+31} Clear Pending Reg
0x520 NVIC_UNPEND4 — IRQ 128 to 133 Clear Pending Reg
{0x600+8i} NVIC_ACTIVE{i} (i=0..3) — IRQ {32i} to {32i+31} Active Register
0x620 NVIC_ACTIVE4 — IRQ 128 to 133 Active Register
{0x800+8i} NVIC_PRI{i} (i=0..33) — IRQ {4i} to {4i+3} Priority Register
0x1A00 SCB_CPUID — CPUID Base Register
0x1A08 SCB_INT_CTRL — Interrupt Control State Register
0x1A10 SCB_VTABLE — Vector Table Offset Register
0x1A18 SCB_APINT — App. Int & Reset Control Reg
0x1A20 SCB_SYS_CTRL — System Control Register
0x1A28 SCB_CFG_CTRL — Configuration Control Register
{0x1A28+8i} SCB_SYS_PRI{i} (i=1..3) — Sys. Handlers {4i} to {4i+3} Priority
0x1A48 SCB_SYS_HND_CTRL — System Handler Control and State
0x1A50 SCB_FAULT_STAT — Configurable Fault Status Reg
0x1A58 SCB_HFAULT_STAT — Hard Fault Status Register
0x1A60 DEBUG_STAT — Debug Status Register
0x1A68 SCB_MM_ADDR — Mem Manage Address Register
0x1A70 SCB_FAULT_ADDR — Bus Fault Address Register
0x1B20 MPU_TYPE
0x1B28 MPU_CTRL — MPU Control Register
0x1B30 MPU_NUMBER — MPU Region Number Register
0x1B38 MPU_BASE — MPU Region Base Address Register
0x1B40 MPU_ATTR — MPU Region Attribute & Size Reg
0x1BE0 DEBUG_DBG_CTRL — Debug Control and Status Reg
0x1BE8 DEBUG_DBG_XFER — Debug Core Reg. Transfer Select
0x1BF0 DEBUG_DBG_DATA — Debug Core Register Data
0x1BF8 DEBUG_DBG_INT — Debug Reset Interrupt Control
0x1E00 NVIC_SW_TRIG — Software Trigger Interrupt Reg
