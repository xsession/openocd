# TMS320F28M35x_M3 register map
Vendor: Texas Instruments; Series: C2000 Concerto F28M35x; File version: 0.2.0-generated
CPU: CM3 r2p1, little endian, no MPU, no FPU, 3 interrupt priority bits
Registers are 32-bit, read-write, reset 0x0 unless marked. A register's access mark holds for its fields unless they carry their own. Offsets are from the block's base; [hi:lo] are bit positions; {n}, {i} and the like mark numbered series.

## CAN0 — CAN REGS Registers
Base 0x40070000
Same registers: CAN1 0x40074000
0x00 CAN_CTL — CAN Control Register
0x04 CAN_ES — CAN Error and Status Register
0x08 CAN_ERRC — CAN Error Counter Register
0x0C CAN_BTR — CAN Bit Timing Register
0x10 CAN_INT — CAN Interrupt Register
0x14 CAN_TEST
0x1C CAN_PERR — CAN Parity Error Code Register
0x80 CAN_ABOTR — CAN Auto-bus-on Time Register
0x88 CAN_TXRQ — CAN Transmission Request 2_1 Register
0x9C CAN_NWDAT — CAN New Data 2_1 Register
0xB0 CAN_INTPND — CAN Interrupt Pending 2_1 Register
0xC4 CAN_MSGVAL — CAN Message Valid 2_1 Register
0xD8 CAN_INTMUX — CAN Interrupt Multiplexer 2_1 Register
0x100 CAN_IF1CMD — CAN Interface 1 Command Register
{0xE4+0x20*i} CAN_IF{i}MSK (i=1..3) — CAN Interface {i} Mask Register
{0xE8+0x20*i} CAN_IF{i}ARB (i=1..3) — CAN Interface {i} Arbitration Register
{0xEC+0x20*i} CAN_IF{i}MCTL (i=1..3) — CAN Interface {i} Message Control Register
{0xF0+0x20*i} CAN_IF{i}DATA (i=1..3) — CAN Interface {i} DATA A2_A1 Register
{0xF4+0x20*i} CAN_IF{i}DATB (i=1..3) — CAN Interface {i} DATA B2_B1 Register
0x120 CAN_IF2CMD — CAN Interface 2 Command Register
0x140 CAN_IF3OBS — CAN Interface 3 Observation Register
0x160 CAN_IF3UPD — CAN Interface 3 Update Enable 2_1 Register

## EPI0 — EPI REGS Registers
Base 0x400D0000
0x00 EPICFG — EPI Configuration
0x04 EPIBAUD — EPI Main Baud Rate
0x08 EPIBAUD2 — EPI Baud Rate 2
0x10 GPCFG — EPI General Purpose Configuration
0x10 HB16CFG — EPI Host-Bus 16 Configuration
0x10 HB8CFG — EPI Host-Bus 8 Configuration
0x10 SDRAMCFG — EPI SDRAM Configuration
0x14 GPCFG2 — EPI General Purpose Configuration 2
0x14 HB16CFG2 — EPI Host-Bus 16 Configuration 2
0x14 HB8CFG2 — EPI Host-Bus 8 Configuration 2
0x1C EPIADDRMAP — EPI Address Map
0x20 EPIRSIZE0 — EPI Read Size 0
0x24 EPIRADDR0 — EPI Read Address 0
0x28 EPIRPSTD0 — EPI Non-Blocking Read Data 0
0x30 EPIRSIZE1 — EPI Read Size 1
0x34 EPIRADDR1 — EPI Read Address 1
0x38 EPIRPSTD1 — EPI Non-Blocking Read Data 1
0x60 EPISTAT — EPI Status
0x6C EPIRFIFOCNT — EPI Read FIFO Count
0x70 EPIREADFIFO
{0x70+4i} EPIREADFIFO{i} (i=1..7) — EPI Read FIFO Alias {i}
0x200 EPIFIFOLVL — EPI FIFO Level Selects
0x204 EPIWFIFOCNT — EPI Write FIFO Count
0x208 EPIDMATXCNT — EPI DMA Transmit Count
0x210 EPIIM — EPI Interrupt Mask
0x214 EPIRIS — EPI Raw Interrupt Status
0x218 EPIMIS — EPI Masked Interrupt Status
0x21C EPIEISC — EPI Error Interrupt Status and Clear
0x308 HB16CFG3 — EPI Host-Bus 16 Configuration 3
0x308 HB8CFG3 — EPI Host-Bus 8 Configuration 3
0x30C HB16CFG4 — EPI Host-Bus 16 Configuration 4
0x30C HB8CFG4 — EPI Host-Bus 8 Configuration 4
0x310 HB16TIME — EPI Host-Bus 16 Timing Extension
0x310 HB8TIME — EPI Host-Bus 8 Timing Extension
{0x30C+4i} HB16TIME{i} (i=2..4) — EPI Host-Bus 16 Timing Extension {i}
{0x30C+4i} HB8TIME{i} (i=2..4) — EPI Host-Bus 8 Timing Extension {i}

## FLASH_CONTROL — FLASH REGS Registers
Base 0x400FA000
0x00 FRDCNTL — Flash Read Control Register
0x3C FBAC — Flash Bank Access Control Register
0x40 FBFALLBACK — Flash Bank Fallback Power Register
0x44 FBPRDY — Flash Bank Pump Ready Register
0x48 FPAC1 — Flash Pump Access Control Register 1
0x4C FPAC2 — Flash Pump Access Control Register 2
0x50 FMAC — Flash Module Access Control Register
0x54 FMSTAT — Flash Module Status Register
0x300 FRD_INTF_CTRL — Flash Read Interface Control Register

## FLASH_ERROR — FLASH ERR REGS Registers
Base 0x400FA600
0x00 ECC_ENABLE
0x04 SINGLE_ERR_ADDR — Single Error Address Register
0x08 UNC_ERR_ADDR — Uncorrectable Error Address Register
0x0C ERR_STATUS — Error Status Register
0x10 ERR_POS — Error Position Register
0x14 ERR_STATUS_CLR — Error Status Clear Register
0x18 ERR_CNT — Error Count Register
0x1C ERR_THRESHOLD — Error Threshold Register
0x20 ERR_INTFLG — Error Interrupt Flag Register
0x24 ERR_INTCLR — Error Interrupt Clear Register
0x28 FDATAH_TEST — Test Data High Register
0x2C FDATAL_TEST — Test Data Low Register
0x30 FADDR_TEST — Test Data Address Register
0x34 FECC_TEST — Test Data ECC Register
0x38 FECC_CTRL — ECC Test Control Register
0x3C FECC_FOUTH_TEST — Test Data Out High Register
0x40 FECC_FOUTL_TEST — Test Data Out Low Register
0x44 FECC_STATUS — Test Status Register
