# TMS320F28M35x_M3 register map
Vendor: Texas Instruments; Series: C2000 Concerto F28M35x; File version: 0.2.0-generated
CPU: CM3 r2p1, little endian, no MPU, no FPU, 3 interrupt priority bits
Registers are 32-bit, read-write, reset 0x0 unless marked. A register's access mark holds for its fields unless they carry their own. Offsets are from the block's base; [hi:lo] are bit positions; {n}, {i} and the like mark numbered series.

## ADC1 — ADC Registers
Base 0x00007100
Same registers: ADC2 0x00007180
0x00 ADCCTL1 16-bit — ADC Control 1
0x01 ADCCTL2 16-bit — ADC Control 2
0x04 ADCINTFLG 16-bit — ADC Interrupt Flag
0x05 ADCINTFLGCLR 16-bit — ADC Interrupt Flag Clear
0x06 ADCINTOVF 16-bit — ADC Interrupt Overflow
0x07 ADCINTOVFCLR 16-bit — ADC Interrupt Overflow Clear
0x08 INTSEL1N2 16-bit — ADC Interrupt 1 and 2 Selection
0x09 INTSEL3N4 16-bit — ADC Interrupt 3 and 4 Selection
0x0A INTSEL5N6 16-bit — ADC Interrupt 5 and 6 Selection
0x0B INTSEL7N8 16-bit — ADC Interrupt 7 and 8 Selection
0x0C INTSEL9N10 16-bit — ADC Interrupt 9 and 10 Selection
0x10 SOCPRICTL 16-bit — ADC SOC Priority Control
0x12 ADCSAMPLEMODE 16-bit — ADC Sampling Mode
0x14 ADCINTSOCSEL1 16-bit — ADC Interrupt SOC Selection 1
0x15 ADCINTSOCSEL2 16-bit — ADC Interrupt SOC Selection 2
0x18 ADCSOCFLG1 16-bit — ADC SOC Flag 1
0x1A ADCSOCFRC1 16-bit — ADC SOC Flag Force 1
0x1C ADCSOCOVF1 16-bit — ADC SOC Overflow 1
0x1E ADCSOCOVFCLR1 16-bit — ADC SOC Overflow Clear 1
{0x20+i} ADCSOC{i}CTL 16-bit (i=0..15) — ADC SOC{i} Control
0x40 ADCREFTRIM 16-bit — Reference Trim Register
0x41 ADCOFFTRIM 16-bit — Offset Trim Register
0x4C COMPHYSTCTL 16-bit — Comparator Hysteresis Control Register

## I2CA — I2C Registers
Base 0x00007900
0x00 I2COAR 16-bit — I2C own address register
0x01 I2CIER 16-bit — I2C interrupt enable register
0x02 I2CSTR 16-bit — I2C status register
0x03 I2CCLKL 16-bit — I2C clock low-time divider register
0x04 I2CCLKH 16-bit — I2C clock high-time divider register
0x05 I2CCNT 16-bit — I2C data count register
0x06 I2CDRR 16-bit — I2C data receive register
0x07 I2CSAR 16-bit — I2C slave address register
0x08 I2CDXR 16-bit — I2C data transmit register
0x09 I2CMDR 16-bit — I2C mode register
0x0A I2CISRC 16-bit — I2C interrupt source register
0x0C I2CPSC 16-bit — I2C prescaler register
0x20 I2CFFTX 16-bit — I2C FIFO transmit register
0x21 I2CFFRX 16-bit — I2C FIFO receive register

## WDT0 — WDT REGS Registers
Base 0x40000000
Same registers: WDT1 0x40001000
0x00 WDTLOAD — Watchdog Load
0x04 WDTVALUE — Watchdog Value
0x08 WDTCTL — Watchdog Control
0x0C WDTICR — Watchdog Interrupt Clear
0x10 WDTRIS — Watchdog Raw Interrupt Status
0x14 WDTMIS — Watchdog Masked Interrupt Status
0x418 WDTTEST — Watchdog Test
0xC00 WDTLOCK — Watchdog Lock
{0xFC0+4i} WDTPERIPHID{i} (i=4..7) — Watchdog Peripheral Identification {i}
{0xFE0+4i} WDTPERIPHID{i} (i=0..3) — Watchdog Peripheral Identification {i}
{0xFF0+4i} WDTPCELLID{i} (i=0..3) — Watchdog PrimeCell Identification {i}

## GPIO_PORTA — GPIO REGS Registers
Base 0x40004000
Same registers: GPIO_PORTB 0x40005000, GPIO_PORTC 0x40006000, GPIO_PORTD 0x40007000, GPIO_PORTE 0x40024000, GPIO_PORTF 0x40025000, GPIO_PORTG 0x40026000, GPIO_PORTH 0x40027000, GPIO_PORTJ 0x4003D000, GPIO_PORTA_AHB 0x40058000, GPIO_PORTB_AHB 0x40059000, GPIO_PORTC_AHB 0x4005A000, GPIO_PORTD_AHB 0x4005B000, GPIO_PORTE_AHB 0x4005C000, GPIO_PORTF_AHB 0x4005D000, GPIO_PORTG_AHB 0x4005E000, GPIO_PORTH_AHB 0x4005F000, GPIO_PORTJ_AHB 0x40060000
0x3FC GPIODATA
0x400 GPIODIR — GPIO Direction
0x404 GPIOIS — GPIO Interrupt Sense
0x408 GPIOIBE — GPIO Interrupt Both Edges
0x40C GPIOIEV — GPIO Interrupt Event
0x410 GPIOIM — GPIO Interrupt Mask
0x414 GPIORIS — GPIO Raw Interrupt Status
0x418 GPIOMIS — GPIO Masked Interrupt Status
0x41C GPIOICR — GPIO Interrupt Clear
0x420 GPIOAFSEL — GPIO Alternate Function Select
0x50C GPIOODR — GPIO Open Drain Select
0x510 GPIOPUR — GPIO Pull-Up Select
0x51C GPIODEN — GPIO Digital Enable
0x520 GPIOLOCK
0x524 GPIOCR — GPIO Commit
0x528 GPIOAMSEL — GPIO Analog Mode Select
0x52C GPIOPCTL — GPIO Port Control
0x530 GPIOAPSEL — GPIO Alternate Port Select
0x534 GPIOCSEL — GPIO Core Select
{0xFC0+4i} GPIOPERIPHID{i} (i=4..7) — GPIO Peripheral Identification {i}
{0xFE0+4i} GPIOPERIPHID{i} (i=0..3) — GPIO Peripheral Identification {i}
{0xFF0+4i} GPIOCELLID{i} (i=0..3) — GPIO PrimeCell Identification {i}
