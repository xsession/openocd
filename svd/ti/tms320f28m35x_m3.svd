# TMS320F28M35x_M3 register map
Vendor: Texas Instruments; Series: C2000 Concerto F28M35x; File version: 0.2.0-generated
CPU: CM3 r2p1, little endian, no MPU, no FPU, 3 interrupt priority bits
Registers are 32-bit, read-write, reset 0x0 unless marked. A register's access mark holds for its fields unless they carry their own. Offsets are from the block's base; [hi:lo] are bit positions; {n}, {i} and the like mark numbered series.

## VCU — VCU Registers
Base 0x00001200
{0x0+2i} VR{i} (i=0..8) — General Purpose 32-bit registers
0x12 VT0 — Transition Bit register
0x14 VT1 — Transition Bit register
0x20 VSTATUS — VCU Status Register
0x22 VCRC — CRC Result register for un-secured memories

## FLASHCTRL — FLASH CTRL REGS Registers
Base 0x00004000
0x00 FRDCNTL — Flash Read Control Register
0x1E FBAC — Flash Bank Access Control Register
0x20 FBFALLBACK — Flash Bank Fallback Power Register
0x22 FBPRDY — Flash Bank Pump Ready Register
0x24 FPAC1 — Flash Pump Access Control Register 1
0x26 FPAC2 — Flash Pump Access Control Register 2
0x28 FMAC — Flash Module Access Control Register
0x2A FMSTAT — Flash Module Status Register
0x17E FRD_INTF_CTRL — Flash Read Interface Control Register

## FLASHECC — FLASH ECC REGS Registers
Base 0x00004300
0x00 ECC_ENABLE
0x02 SINGLE_ERR_ADDR — Single Error Address
0x04 UNC_ERR_ADDR — Uncorrectable Error Address
0x06 ERR_STATUS — Error Status
0x08 ERR_POS — Error Position
0x0A ERR_STATUS_CLR — Error Status Clear
0x0C ERR_CNT — Error Control
0x0E ERR_THRESHOLD — Error Threshold
0x10 ERR_INTFLG — Error Interrupt Flag
0x12 ERR_INTCLR — Error Interrupt Flag Clear
0x14 FDATAH_TEST — Data High Test
0x16 FDATAL_TEST — Data Low Test
0x18 FADDR_TEST — ECC Test Address
0x1A FECC_TEST — ECC Test Address
0x1C FECC_CTRL — ECC Control
0x1E FOUTH_TEST — Test Data Out High
0x20 FOUTL_TEST — Test Data Out Low
0x22 FECC_STATUS — ECC Status

## EPI — EPI REGS Registers
Base 0x00004430
0x00 CEPIRTWCFG — Real Time Window Configure Register
0x02 CEPIRTWCNT — Real Time Window Counter Register
0x04 CEPIRTWPRD — Real Time Window Period Register
0x0A CEPISTATUS — EPI Status Register

## MCBSPA — Multi-Channel Buffered Serial Port Registers
Base 0x00005000
0x00 DRR2 16-bit — McBSP Data Receive Register 2
0x01 DRR1 16-bit — McBSP Data Receive Register 1
0x02 DXR2 16-bit — McBSP Data Transmit Register 2
0x03 DXR1 16-bit — McBSP Data Transmit Register 1
0x04 SPCR2 16-bit — McBSP Serial Port Control Register 2
0x05 SPCR1 16-bit — McBSP Serial Port Control Register 1
0x06 RCR2 16-bit — McBSP Receive Control Register 2
0x07 RCR1 16-bit — McBSP Receive Control Register 1
0x08 XCR2 16-bit — McBSP Transmit Control Register 2
0x09 XCR1 16-bit — McBSP Transmit Control Register 1
0x0A SRGR2 16-bit — McBSP Sample Rate Generator Register 2
0x0B SRGR1 16-bit — McBSP Sample Rate Generator Register 1
0x0C MCR2 16-bit — McBSP Multichannel Register 2
0x0D MCR1 16-bit — McBSP Multichannel Register 1
0x0E RCERA 16-bit — McBSP Receive Channel Enable Register Partition A
0x0F RCERB 16-bit — McBSP Receive Channel Enable Register Partition B
0x10 XCERA 16-bit — McBSP Transmit Channel Enable Register Partition A
0x11 XCERB 16-bit — McBSP Transmit Channel Enable Register Partition B
0x12 PCR 16-bit — McBSP Pin Control Register
0x13 RCERC 16-bit — McBSP Receive Channel Enable Register Partition C
0x14 RCERD 16-bit — McBSP Receive Channel Enable Register Partition D
0x15 XCERC 16-bit — McBSP Transmit Channel Enable Register Partition C
0x16 XCERD 16-bit — McBSP Transmit Channel Enable Register Partition D
0x17 RCERE 16-bit — McBSP Receive Channel Enable Register Partition E
0x18 RCERF 16-bit — McBSP Receive Channel Enable Register Partition F
0x19 XCERE 16-bit — McBSP Transmit Channel Enable Register Partition E
0x1A XCERF 16-bit — McBSP Transmit Channel Enable Register Partition F
0x1B RCERG 16-bit — McBSP Receive Channel Enable Register Partition G
0x1C RCERH 16-bit — McBSP Receive Channel Enable Register Partition H
0x1D XCERG 16-bit — McBSP Transmit Channel Enable Register Partition G
0x1E XCERH 16-bit — McBSP Transmit Channel Enable Register Partition H
0x23 MFFINT 16-bit — McBSP Interrupt Enable Register
