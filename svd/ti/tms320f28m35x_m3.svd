# TMS320F28M35x_M3 register map
Vendor: Texas Instruments; Series: C2000 Concerto F28M35x; File version: 0.2.0-generated
CPU: CM3 r2p1, little endian, no MPU, no FPU, 3 interrupt priority bits
Registers are 32-bit, read-write, reset 0x0 unless marked. A register's access mark holds for its fields unless they carry their own. Offsets are from the block's base; [hi:lo] are bit positions; {n}, {i} and the like mark numbered series.

## RAM_CONFIG — RAM CONFIG REGS Registers
Base 0x400FB200
0x00 CXDRCR1 — Cx DEDRAM Config Register 1
0x08 CXSRCR1 — Cx SHRAM Config Register 1
0x10 MSXMSEL — Sx SHRAM Master Select Register
0x14 MSXSRCR1 — M3 Sx SHRAM Config Register 1
0x18 MSXSRCR2 — M3 Sx SHRAM Config Register 2
0x24 MTOCMSGRCR — M3TOC28_MSG_RAM Config Register
0x34 CXRTESTINIT1 — Cx RAM_TEST and INIT Register 1
0x44 MSXRTESTINIT1 — M3 Sx RAM_TEST and INIT Register 1
0x54 MTOCRTESTINIT — M3 To Cx Message TEST and INIT Register
0x64 CXRINITDONE1 — Cx RAM_ INIT_DONE Register 1
0x6C MSXRINITDONE1 — M3 Sx RAM_INIT_DONE Register
0x7C MTOCRINITDONE — M3 To Cx Message RAM Init Done

## RAM_ERROR — RAM ERR REGS Registers
Base 0x400FB300
0x00 MCUNCWEADDR — M3 CPU Uncorrectable Write Error Address Register
0x04 MDUNCWEADDR — M3 μDMA Uncorrectable Write Error Address Register
0x08 MCUNCREADDR — M3 CPU Uncorrectable Read Error Address Register
0x0C MDUNCREADDR — M3 μDMA Uncorrectable Read Error Address Register
0x10 MCPUCREADDR — M3 CPU Corrected Read Error Address Register
0x14 MDMACREADDR — M3 μDMA Corrected Read Error Address Register
0x20 MUEFLG — M3 Uncorrectable Error Flag Register
0x24 MUEFRC — M3 Uncorrectable Error Force Register
0x28 MUECLR — M3 Uncorrectable Error Flag Clear Register
0x2C MCECNTR — M3 Corrected Error Counter Register
0x30 MCETRES — M3 Corrected Error Threshold Register
0x38 MCEFLG — M3 Corrected Error Threshold Exceeded Flag Register
0x3C MCEFRC — M3 Corrected Error Threshold Exceeded Force Register
0x40 MCECLR — M3 Corrected Error Threshold Exceeded Flag Clear Register
0x44 MCEIE — M3 Single Error Interrupt Enable Register
0x50 MNMAVFLG — Non-Master Access Violation Flag Register
0x58 MNMAVCLR — Non-Master Access Violation Flag Clear Register
0x60 MMAVFLG — Master Access Violation Flag Register
0x68 MMAVCLR — Master Access Violation Flag Clear Register
0x70 MNMWRAVADDR — Non-Master CPU Write Access Violation Address Register
0x74 MNMDMAWRAVADDR — Non-Master DMA Write Access Violation Address Register
0x78 MNMFAVADDR — Non-Master CPU Fetch Access Violation Address Register
0x80 MMWRAVADDR — Master CPU Write Access Violation Address Register
0x84 MMDMAWRAVADDR — Master DMA Write Access Violation Address Register
0x88 MMFAVADDR — Master CPU Fetch Access Violation Address Register

## DCSM — DCSM REGS Registers
Base 0x400FB400
{0x0+4i} Z1_CSMKEY{i} (i=0..3) — CSMKEY Register for M3-Zone-1 security Zone
0x10 Z1_ECSLKEY0 — ECSLKEY Register for M3-Zone-1 security Zone
0x14 Z1_ECSLKEY1 — ECSLKEY Register for M3-Zone-1 security Zone
{0x18+4i} Z2_CSMKEY{i} (i=0..3) — CSMKEY Register for M3-Zone-2 security Zone
0x28 Z2_ECSLKEY0 — ECSLKEY Register for M3-Zone-2 security Zone
0x2C Z2_ECSLKEY1 — ECSLKEY Register for M3-Zone-2 security Zone
0x60 Z1_CSMLOCKSR — Locked Status Register for CSM passwords of M3-Zone-1 security Zone
0x64 Z1_ECSLLOCKSR — Locked Status Register for ECSL passwords of M3-Zone-1 security Zone
0x68 Z2_CSMLOCKSR — Locked Status Register for CSM passwords of M3-Zone-2 security Zone
0x6C Z2_ECSLLOCKSR — Locked Status Register for ECSL passwords of M3-Zone-2 security Zone
0x80 Z1_CR — Status and Control Register for M3-Zone-1 security Zone
0x84 Z2_CR — Status and Control Register for M3-Zone-2 security Zone
0x90 Z1_GRABSECTR — Grab Flash-Sectors Register for M3-Zone-1 security Zone
0x94 Z1_GRABRAMR — Grab RAM-blocks Register for M3-Zone-1 security Zone
0x98 Z2_GRABSECTR — Grab Flash-Sectors Register for M3-Zone-2 security Zone
0x9C Z2_GRABRAMR — Grab RAM-blocks Register for M3-Zone-2 security Zone
0xB0 Z1_EXEONLYR — Execute-Only Select Register for flash sectors mapped to M3-Zone-1 security Zone
0xB4 Z2_EXEONLYR — Execute-Only Select Register for flash sectors mapped to M3-Zone-2 security Zone
