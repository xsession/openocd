# TMS320F28M35x_M3 register map
Vendor: Texas Instruments; Series: C2000 Concerto F28M35x; File version: 0.2.0-generated
CPU: CM3 r2p1, little endian, no MPU, no FPU, 3 interrupt priority bits
Registers are 32-bit, read-write, reset 0x0 unless marked. A register's access mark holds for its fields unless they carry their own. Offsets are from the block's base; [hi:lo] are bit positions; {n}, {i} and the like mark numbered series.

## ECAP1 — eCAP Control and Status Registers
Base 0x00005A00
Same registers: ECAP2 0x00005A20, ECAP3 0x00005A40, ECAP4 0x00005A60, ECAP5 0x00005A80, ECAP6 0x00005AA0
0x00 TSCTR — eCAP Time-Stamp Counter
0x02 CTRPHS — eCAP Counter Phase Offset Value Register
{0x2+2i} CAP{i} (i=1..4) — eCAP Capture {i} Register
0x14 ECCTL1 16-bit — eCAP Capture Control Register 1
0x15 ECCTL2 16-bit — eCAP Capture Control Register 2
0x16 ECEINT 16-bit — eCAP Capture Interrupt Enable Register
0x17 ECFLG 16-bit — eCAP Capture Interrupt Flag Register
0x18 ECCLR 16-bit — eCAP Capture Interrupt Clear Register
0x19 ECFRC 16-bit — eCAP Capture Interrupt Force Register

## EQEP1 — eQEP Control and Status Registers
Base 0x00005B00
Same registers: EQEP2 0x00005B40, EQEP3 0x00005B80
0x00 QPOSCNT — eQEP Position Counter
0x02 QPOSINIT — eQEP Initialization Position Count
0x04 QPOSMAX — eQEP Maximum Position Count
0x06 QPOSCMP — eQEP Position-compare
0x08 QPOSILAT — eQEP Index Position Latch
0x0A QPOSSLAT — eQEP Strobe Position Latch
0x0C QPOSLAT — eQEP Position Latch
0x0E QUTMR — eQEP Unit Timer
0x10 QUPRD — eQEP Unit Period Register
0x12 QWDTMR 16-bit — eQEP Watchdog Timer
0x13 QWDPRD 16-bit — eQEP Watchdog Period Register
0x14 QDECCTL 16-bit — eQEP Decoder Control Register
0x15 QEPCTL 16-bit — eQEP Control Register
0x16 QCAPCTL 16-bit — eQEP Capture Control Register
0x17 QPOSCTL 16-bit — eQEP Position-compare Control Register
0x18 QEINT 16-bit — eQEP Interrupt Enable Register
0x19 QFLG 16-bit — eQEP Interrupt Flag Register
0x1A QCLR 16-bit — eQEP Interrupt Clear Register
0x1B QFRC 16-bit — eQEP Interrupt Force Register
0x1C QEPSTS 16-bit — eQEP Status Register
0x1D QCTMR 16-bit — eQEP Capture Timer
0x1E QCPRD 16-bit — eQEP Capture Period Register
0x1F QCTMRLAT 16-bit — eQEP Capture Timer Latch
0x20 QCPRDLAT 16-bit — eQEP Capture Period Latch

## GPIOG1CTRL — GPIOG1 CTRL REGS Registers
Base 0x00005F80
0x00 GPACTRL — GPIO A Control Register (GPIO0 to 31)
0x02 GPAQSEL1 — GPIO A Qualifier Select 1 Register (GPIO0 to 15)
0x04 GPAQSEL2 — GPIO A Qualifier Select 2 Register (GPIO16 to 31)
0x06 GPAMUX1 — GPIO A Mux 1 Register (GPIO0 to 15)
0x08 GPAMUX2 — GPIO A Mux 2 Register (GPIO16 to 31)
0x0A GPADIR — GPIO A Direction Register (GPIO0 to 31) )
0x10 GPBCTRL — GPIO B Control Register (GPIO32 to 63)
0x12 GPBQSEL1 — GPIO B Qualifier Select 1 Register (GPIO32 to 47)
0x14 GPBQSEL2 — GPIO B Qualifier Select 2 Register (GPIO48 to 63)
0x16 GPBMUX1 — GPIO B Mux 1 Register (GPIO32 to 47)
0x18 GPBMUX2 — GPIO B Mux 2 Register (GPIO48 to 63)
0x1A GPBDIR — GPIO B Direction Register (GPIO32 to 63)
0x20 GPCCTRL — GPIO C Control Register (GPIO68 to 71)
0x22 GPCQSEL1 — GPIO C Qualifier Select 1 Register (GPIO68 to 71)
0x26 GPCMUX1 — GPIO C Mux 1 Register (GPIO68 to 71)
0x2A GPCDIR — GPIO C Direction Register (GPIO68 to 71)

## GPIOG1DAT — GPIOG1 DATA REGS Registers
Base 0x00005FC0
0x00 GPADAT — GPIO A Data Register (GPIO0 to 31)
0x02 GPASET — GPIO A Data Set Register (GPIO0 to 31)
0x04 GPACLEAR — GPIO A Data Clear Register (GPIO0 to 31)
0x06 GPATOGGLE — GPIO A Data Toggle Register (GPIO0 to 31)
0x08 GPBDAT — GPIO B Data Register (GPIO32 to 63)
0x0A GPBSET — GPIO B Data Set Register (GPIO32 to 63)
0x0C GPBCLEAR — GPIO B Data Clear Register (GPIO32 to 63)
0x0E GPBTOGGLE — GPIO B Data Toggle Register (GPIO32 to 63)
0x10 GPCDAT — GPIO C Data Register (GPIO68 to 71)
0x12 GPCSET — GPIO C Data Set Register (GPIO68 to 71)
0x14 GPCCLEAR — GPIO C Data Clear Register (GPIO32 to 63)
0x16 GPCTOGGLE — GPIO C Data Toggle Register (GPIO32 to 63)
