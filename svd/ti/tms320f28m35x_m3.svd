# TMS320F28M35x_M3 register map
Vendor: Texas Instruments; Series: C2000 Concerto F28M35x; File version: 0.2.0-generated
CPU: CM3 r2p1, little endian, no MPU, no FPU, 3 interrupt priority bits
Registers are 32-bit, read-write, reset 0x0 unless marked. A register's access mark holds for its fields unless they carry their own. Offsets are from the block's base; [hi:lo] are bit positions; {n}, {i} and the like mark numbered series.

## EPWM1 — EPWM REGS Registers
Base 0x00005100
Same registers: EPWM{n} {0x5080+0x80*n} (n=2..9)
0x00 TBCTL 16-bit — Time Base Control Register
0x01 TBSTS 16-bit — Time Base Status Register
0x02 TBPHSHR 16-bit — Time Base Phase High Resolution Register
0x03 TBPHS 16-bit — Time Base Phase Register
0x04 TBCTR 16-bit — Time Base Counter Register
0x05 TBPRD 16-bit — Time Base Period Register
0x06 TBPRDHR 16-bit — Time Base Period High Resolution Register
0x07 CMPCTL 16-bit — Counter Compare Control Register
0x08 CMPAHR 16-bit — Counter Compare A High Resolution Register
0x09 CMPA 16-bit — Counter Compare A Register
0x0A CMPB 16-bit — Counter Compare B Register
0x0B AQCTLA 16-bit — Action Qualifier Control Register For Output A
0x0C AQCTLB 16-bit — Action Qualifier Control Register For Output B
0x0D AQSFRC 16-bit — Action Qualifier Software Force Register
0x0E AQCSFRC 16-bit — Action Qualifier Continuous S/W Force Register
0x0F DBCTL 16-bit — Dead-Band Generator Control Register
0x10 DBRED 16-bit — Dead-Band Generator Rising Edge Delay Count Register
0x11 DBFED 16-bit — Dead-Band Generator Falling Edge Delay Count Register
0x12 TZSEL 16-bit — Trip Zone Select Register
0x13 TZDCSEL 16-bit — Trip Zone Digital Comparator Select Register
0x14 TZCTL 16-bit — Trip Zone Control Register
0x15 TZEINT 16-bit — Trip Zone Enable Interrupt Register
0x16 TZFLG 16-bit — Trip Zone Flag Register
0x17 TZCLR 16-bit — Trip Zone Clear Register
0x18 TZFRC 16-bit — Trip Zone Force Register
0x19 ETSEL 16-bit — Event Trigger Selection Register
0x1A ETPS 16-bit — Event Trigger Pre-Scale Register
0x1B ETFLG 16-bit — Event Trigger Flag Register
0x1C ETCLR 16-bit — Event Trigger Clear Register
0x1D ETFRC 16-bit — Event Trigger Force Register
0x1E PCCTL 16-bit — PWM Chopper Control Register
0x20 HRCNFG 16-bit — HRPWM Configuration Register
0x21 HRPWR 16-bit — HRPWM Power Register
0x27 HRCNFG2 16-bit — HRPWM Configuration 2 Register
0x28 HRPCTL 16-bit — High Resolution Period Control Register
0x2A TBPRDHRM 16-bit — Time Base Period High Resolution Mirror Register
0x2B TBPRDM 16-bit — Time Base Period Mirror Register
0x2C CMPAHRM 16-bit — Compare A High Resolution Mirror Register
0x2D CMPAM 16-bit — Compare A Mirror Register
0x30 DCTRIPSEL 16-bit — Digital Compare Trip Select Register
0x31 DCACTL 16-bit — Digital Compare A Control Register
0x32 DCBCTL 16-bit — Digital Compare B Control Register
0x33 DCFCTL 16-bit — Digital Compare Filter Control Register
0x34 DCCAPCTL 16-bit — Digital Compare Capture Control Register
0x35 DCFOFFSET 16-bit — Digital Compare Filter Offset Register
0x36 DCFOFFSETCNT 16-bit — Digital Compare Filter Offset Counter Register
0x37 DCFWINDOW 16-bit — Digital Compare Filter Window Register
0x38 DCFWINDOWCNT 16-bit — Digital Compare Filter Window Counter Register
0x39 DCCAP 16-bit — Digital Compare Counter Capture Register
0x40 TBCTL2 16-bit — Time Base Control Register 2
0x41 CMPCTL2 16-bit — Counter Compare Control Register 2
0x47 AQCTLR 16-bit — Action Qualifier Control Register
0x4A CMPBHR 16-bit — Compare B High Resolution Register
0x4C DCAHTRIPSEL 16-bit — Digital Compare AH Trip Select
0x4D DCALTRIPSEL 16-bit — Digital Compare AL Trip Select
0x4E DCBHTRIPSEL 16-bit — Digital Compare BH Trip Select
0x4F DCBLTRIPSEL 16-bit — Digital Compare BL Trip Select
0x50 ETINTPS 16-bit — Event-Trigger Interrupt Pre-Scale Register
0x51 ETSOCPS 16-bit — Event-Trigger SOC Pre-Scale Register
0x52 ETCNTINITCTL 16-bit — Event-Trigger Counter Initialization Control Register
0x53 ETCNTINIT 16-bit — Event-Trigger Counter Initialization Register
0x5E EPWMXLINK
0x60 TBPHSHRM 16-bit — Time Base Phase High Resolution Mirror Register
0x61 TBPHSM 16-bit — Time Base Phase Mirror Register
0x62 TBPRDHRM2 16-bit — Time Base Period High Resolution Mirror 2 Register
0x63 TBPRDM2 16-bit — Time Base Period Mirror 2 Register
0x64 CMPAHRM2 16-bit — Counter Compare A High Resolution Mirror 2 Register
0x65 CMPAM2 16-bit — Counter Compare A Mirror 2 Register
0x66 CMPBHRM 16-bit — Counter Compare B Mirror High Resolution Register
0x67 CMPBM 16-bit — Counter Compare B Mirror Register
0x69 CMPC 16-bit — Counter Compare C Register
0x6B CMPD 16-bit — Counter Compare D Register
0x6C DBREDHR 16-bit — Dead-Band Generator Rising Edge Delay High Resolution Mirror Register
0x6D DBREDM 16-bit — Dead-Band Generator Rising Edge Delay Count Mirror Register
0x6E DBFEDHR 16-bit — Dead-Band Generator Falling Edge Delay High Resolution Register
0x6F DBFEDM 16-bit — Dead-Band Generator Falling Edge Delay Count Register
0x70 ETCLRM 16-bit — Event Trigger Clear Register
0x71 TZCLRM 16-bit — Trip Zone Clear Register
0x73 AQCTLAM 16-bit — Action Qualifier Control Register For Output A
0x74 AQCTLBM 16-bit — Action Qualifier Control Register For Output B
0x75 AQSFRCM 16-bit — Action Qualifier Software Force Register
0x76 AQCSFRCM 16-bit — Action Qualifier Continuous S/W Force Register
