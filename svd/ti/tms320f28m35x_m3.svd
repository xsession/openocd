# TMS320F28M35x_M3 register map
Vendor: Texas Instruments; Series: C2000 Concerto F28M35x; File version: 0.2.0-generated
Generated from TI CCS targetdb file f28m35m52c1.xml. Review against the TI technical reference manual before production use.
CPU: CM3 r2p1, little endian, no MPU, no FPU, 3 interrupt priority bits
Registers are 32-bit, read-write, reset 0x0 unless marked. A register's access mark holds for its fields unless they carry their own. Offsets are from the block's base; lines under a group give offsets from that group; [hi:lo] are bit positions; {n}, {i} and the like mark numbered series; 'fields as' and 'values as' point back to an identical list; <NAME> marks a mode.

## Memory map
0x00000880 DEVEMU — DEV EMU REGS Registers
0x00000AE0 CSM — DCSM REGS Registers
0x00000C00 CPUTIMER — CPU Timer Registers
0x00000CE0 PIECTRL — Peripheral Interrupt Expansion Registers
0x00000F00 FPU — Floating-Point Unit Single Precision Registers
0x00001000 DMA — DMA Registers
0x00001200 VCU — VCU Registers
0x00004000 FLASHCTRL — FLASH CTRL REGS Registers
0x00004300 FLASHECC — FLASH ECC REGS Registers
0x00004430 EPI — EPI REGS Registers
0x00005000 MCBSPA — Multi-Channel Buffered Serial Port Registers
{0x5080+0x80*n} EPWM{n} (n=1..9) — EPWM REGS Registers
0x00005A00 ECAP1 — eCAP Control and Status Registers
0x00005A20 ECAP2 — eCAP Control and Status Registers
0x00005A40 ECAP3 — eCAP Control and Status Registers
0x00005A60 ECAP4 — eCAP Control and Status Registers
0x00005A80 ECAP5 — eCAP Control and Status Registers
0x00005AA0 ECAP6 — eCAP Control and Status Registers
0x00005B00 EQEP1 — eQEP Control and Status Registers
0x00005B40 EQEP2 — eQEP Control and Status Registers
0x00005B80 EQEP3 — eQEP Control and Status Registers
0x00005F80 GPIOG1CTRL — GPIOG1 CTRL REGS Registers
0x00005FC0 GPIOG1DAT — GPIOG1 DATA REGS Registers
0x00005FE0 GPIOG1TRIP — GPIOG1 TRIP REGS Registers
0x00006400 COMP1 — COMP REGS Registers
0x00006420 COMP2 — COMP REGS Registers
0x00006440 COMP3 — COMP REGS Registers
0x00006460 COMP4 — COMP REGS Registers
0x00006480 COMP5 — COMP REGS Registers
0x000064A0 COMP6 — COMP REGS Registers
0x00006F80 GPIOG2CTRL — GPIOG2 CTRL REGS Registers
0x00006FC0 GPIOG2DAT — GPIOG2 DATA REGS Registers
0x00007010 SYSCTRL — SYS CTRL REGS Registers
0x00007040 SPIA — Serial Peripheral Interface Registers
0x00007050 SCIA — SCI Registers
0x00007070 XINT — External Interrupt Registers
0x00007100 ADC1 — ADC Registers
0x00007180 ADC2 — ADC Registers
0x00007900 I2CA — I2C Registers
0x40000000 WDT0 — WDT REGS Registers
0x40001000 WDT1 — WDT REGS Registers
0x40004000 GPIO_PORTA — GPIO REGS Registers
0x40005000 GPIO_PORTB — GPIO REGS Registers
0x40006000 GPIO_PORTC — GPIO REGS Registers
0x40007000 GPIO_PORTD — GPIO REGS Registers
0x40008000 SSI0 — SSI REGS Registers
0x40009000 SSI1 — SSI REGS Registers
0x4000A000 SSI2 — SSI REGS Registers
0x4000B000 SSI3 — SSI REGS Registers
0x4000C000 UART0 — UART REGS Registers
0x4000D000 UART1 — UART REGS Registers
0x4000E000 UART2 — UART REGS Registers
0x4000F000 UART3 — UART REGS Registers
0x40010000 UART4 — UART REGS Registers
0x40020000 I2C0_MASTER — I2C MASTER REGS Registers
0x40020800 I2C0_SLAVE — I2C SLAVE REGS Registers
0x40021000 I2C1_MASTER — I2C MASTER REGS Registers
0x40021800 I2C1_SLAVE — I2C SLAVE REGS Registers
0x40024000 GPIO_PORTE — GPIO REGS Registers
0x40025000 GPIO_PORTF — GPIO REGS Registers
0x40026000 GPIO_PORTG — GPIO REGS Registers
0x40027000 GPIO_PORTH — GPIO REGS Registers
0x40030000 TIMER0 — GPTM REGS Registers
0x40031000 TIMER1 — GPTM REGS Registers
0x40032000 TIMER2 — GPTM REGS Registers
0x40033000 TIMER3 — GPTM REGS Registers
0x4003D000 GPIO_PORTJ — GPIO REGS Registers
0x40048000 EMAC0 — EMAC REGS Registers
0x40050000 USB0 — Univeral Serial Bus register offsets
0x40058000 GPIO_PORTA_AHB — GPIO REGS Registers
0x40059000 GPIO_PORTB_AHB — GPIO REGS Registers
0x4005A000 GPIO_PORTC_AHB — GPIO REGS Registers
0x4005B000 GPIO_PORTD_AHB — GPIO REGS Registers
0x4005C000 GPIO_PORTE_AHB — GPIO REGS Registers
0x4005D000 GPIO_PORTF_AHB — GPIO REGS Registers
0x4005E000 GPIO_PORTG_AHB — GPIO REGS Registers
0x4005F000 GPIO_PORTH_AHB — GPIO REGS Registers
0x40060000 GPIO_PORTJ_AHB — GPIO REGS Registers
0x40070000 CAN0 — CAN REGS Registers
0x40074000 CAN1 — CAN REGS Registers
0x400D0000 EPI0 — EPI REGS Registers
0x400FA000 FLASH_CONTROL — FLASH REGS Registers
0x400FA600 FLASH_ERROR — FLASH ERR REGS Registers
0x400FB200 RAM_CONFIG — RAM CONFIG REGS Registers
0x400FB300 RAM_ERROR — RAM ERR REGS Registers
0x400FB400 DCSM — DCSM REGS Registers
0x400FB600 UCRC — UCRCREGS Registers
0x400FB700 IPC — IPC REGS Registers
0x400FB800 SYSCTL — SYSCTL REGS Registers
0x400FBA00 NMI — NMI REGS Registers
0x400FF000 UDMA — UDMA REGS Registers
0x50001600 ADC1RESULT — ADC RESULT REGS Registers
0x50001640 ADC2RESULT — ADC RESULT REGS Registers
0xE000E000 COREPERIPH — M3 CORE PERIPHERALS Registers

## Further device data
tiCore=CM3, tiAddressScale=1, tiCortexDebugCompatible=true, tiProcessorName=cm3, tiGenerator=ti-c2000-toolchain

## Licence text in the file
Generated metadata follows the license of the source TI files. Generator code is MIT licensed.
