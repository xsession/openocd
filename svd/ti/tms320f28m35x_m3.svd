# TMS320F28M35x_M3 register map
Vendor: Texas Instruments; Series: C2000 Concerto F28M35x; File version: 0.2.0-generated
CPU: CM3 r2p1, little endian, no MPU, no FPU, 3 interrupt priority bits
Registers are 32-bit, read-write, reset 0x0 unless marked. A register's access mark holds for its fields unless they carry their own. Offsets are from the block's base; [hi:lo] are bit positions; {n}, {i} and the like mark numbered series.

## SSI0 — SSI REGS Registers
Base 0x40008000
Same registers: SSI1 0x40009000, SSI2 0x4000A000, SSI3 0x4000B000
0x00 SSICR0 — SSI Control 0
0x04 SSICR1 — SSI Control 1
0x08 SSIDR — SSI Data
0x0C SSISR — SSI Status
0x10 SSICPSR — SSI Clock Prescale
0x14 SSIIM — SSI Interrupt Mask
0x18 SSIRIS — SSI Raw Interrupt Status
0x1C SSIMIS — SSI Masked Interrupt Status
0x20 SSIICR — SSI Interrupt Clear
0x24 SSIDMACTL — SSI DMA Control
{0xFC0+4i} SSIPERIPHID{i} (i=4..7) — SSI Peripheral Identification {i}
{0xFE0+4i} SSIPERIPHID{i} (i=0..3) — SSI Peripheral Identification {i}
{0xFF0+4i} SSIPCELLID{i} (i=0..3) — SSI PrimeCell Identification {i}

## UART0 — UART REGS Registers
Base 0x4000C000
Same registers: UART1 0x4000D000, UART2 0x4000E000, UART3 0x4000F000, UART4 0x40010000
0x00 UARTDR — UART Data
0x04 UARTRSR_TECR — UART Receive Status / Error Clear
0x18 UARTFR — UART Flag
0x20 UARTILPR — UART IrDA Low-Power Register
0x24 UARTIBRD — UART Integer Baud-Rate Divisor
0x28 UARTFBRD — UART Fractional Baud-Rate Divisor
0x2C UARTLCRH — UART Line Control
0x30 UARTCTL — UART Control
0x34 UARTIFLS — UART Interrupt FIFO Level Select
0x38 UARTIM — UART Interrupt Mask
0x3C UARTRIS — UART Raw Interrupt Status
0x40 UARTMIS — UART Masked Interrupt Status
0x44 UARTICR — UART Interrupt Clear
0x48 UARTDMACTL — UART DMA Control
0x90 UARTLCTL — UART LIN Control
0x94 UARTLSS — UART LIN Snap Shot
0x98 UARTLTIM — UART LIN Timer
{0xFC0+4i} UARTPERIPHID{i} (i=4..7) — UART Peripheral Identification {i}
{0xFE0+4i} UARTPERIPHID{i} (i=0..3) — UART Peripheral Identification {i}
{0xFF0+4i} UARTPCELLID{i} (i=0..3) — UART PrimeCell Identification {i}

## I2C0_MASTER — I2C MASTER REGS Registers
Base 0x40020000
Same registers: I2C1_MASTER 0x40021000
0x00 I2CMSA — I2C Master Slave Address
0x04 I2CMCS — I2C Master Control/Status
0x08 I2CMDR — I2C Master Data
0x0C I2CMTPR — I2C Master Timer Period
0x10 I2CMIMR — I2C Master Interrupt Mask
0x14 I2CMRIS — I2C Master Raw Interrupt Status
0x18 I2CMMIS — I2C Master Masked Interrupt Status
0x1C I2CMICR — I2C Master Interrupt Clear
0x20 I2CMCR — I2C Master Configuration

## I2C0_SLAVE — I2C SLAVE REGS Registers
Base 0x40020800
Same registers: I2C1_SLAVE 0x40021800
0x00 I2CSOAR — I2C Slave Own Address
0x04 I2CSCSR — I2C Slave Control/Status
0x08 I2CSDR — I2C Slave Data
0x0C I2CSIMR — I2C Slave Interrupt Mask
0x10 I2CSRIS — I2C Slave Raw Interrupt Status
0x14 I2CSMIS — I2C Slave Masked Interrupt Status
0x18 I2CSICR — I2C Slave Interrupt Clear

## TIMER0 — GPTM REGS Registers
Base 0x40030000
Same registers: TIMER1 0x40031000, TIMER2 0x40032000, TIMER3 0x40033000
0x00 GPTMCFG — GPTM Configuration
0x04 GPTMTAMR — GPTM Timer A Mode
0x08 GPTMTBMR — GPTM Timer B Mode
0x0C GPTMCTL — GPTM Control
0x18 GPTMIMR — GPTM Interrupt Mask
0x1C GPTMRIS — GPTM Raw Interrupt Status
0x20 GPTMMIS — GPTM Masked Interrupt Status
0x24 GPTMICR — GPTM Interrupt Clear
0x28 GPTMTAILR — GPTM Timer A Interval Load
0x2C GPTMTBILR — GPTM Timer B Interval Load
0x30 GPTMTAMATCHR — GPTM Timer A Match
0x34 GPTMTBMATCHR — GPTM Timer B Match
0x38 GPTMTAPR — GPTM Timer A Prescale
0x3C GPTMTBPR — GPTM Timer B Prescale
0x40 GPTMTAPMR — GPTM TimerA Prescale Match
0x44 GPTMTBPMR — GPTM TimerB Prescale Match
0x48 GPTMTAR — GPTM Timer A
0x4C GPTMTBR — GPTM Timer B
0x50 GPTMTAV — GPTM Timer A Value
0x54 GPTMTBV — GPTM Timer B Value

## EMAC0 — EMAC REGS Registers
Base 0x40048000
0x00 MACRIS_ACK — EMAC Raw Interrupt Status \ Acknowledge
0x04 MACIM — EMAC Interrupt Mask
0x08 MACRCTL — EMAC Receive Control
0x0C MACTCTL — EMAC Transmit Control
0x10 MACDATA — EMAC Data
0x14 MACIA0 — EMAC Individual Adddress 0
0x18 MACIA1 — EMAC Individual Adddress 1
0x1C MACTHR — EMAC Threshold
0x20 MACMCTL — EMAC Management Control
0x24 MACMDV — EMAC Management Divider
0x2C MACMTXD — EMAC Management Transmit Data
0x30 MACMRXD — EMAC Management Receive Data
0x34 MACNP — EMAC Number of Packets
0x38 MACTR — EMAC Transmission Request
0x3C MACTS — EMAC Timer Support
