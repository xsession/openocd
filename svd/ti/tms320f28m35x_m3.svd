# TMS320F28M35x_M3 register map
Vendor: Texas Instruments; Series: C2000 Concerto F28M35x; File version: 0.2.0-generated
CPU: CM3 r2p1, little endian, no MPU, no FPU, 3 interrupt priority bits
Registers are 32-bit, read-write, reset 0x0 unless marked. A register's access mark holds for its fields unless they carry their own. Offsets are from the block's base; [hi:lo] are bit positions; {n}, {i} and the like mark numbered series.

## GPIOG1TRIP — GPIOG1 TRIP REGS Registers
Base 0x00005FE0
0x00 GPTRIP1SEL 16-bit — GPTRIP1 (TZ1n) Input Select Register (GPIO0 to 63)
0x01 GPTRIP2SEL 16-bit — GPTRIP2 (TZ2n) Input Select Register (GPIO0 to 63)
0x02 GPTRIP3SEL 16-bit — GPTRIP3 (TZ3n) Input Select Register (GPIO0 to 63)
0x03 GPTRIP4SEL 16-bit — GPTRIP4 (XINT1) Input Select Register (GPIO0 to 63)
0x04 GPTRIP5SEL 16-bit — GPTRIP5 (XINT2) Input Select Register (GPIO0 to 63)
0x05 GPTRIP6SEL 16-bit — GPTRIP6 (XINT3 and SYNCIN) Input Select Register (GPIO0 to 63)
0x06 GPTRIP7SEL 16-bit — GPTRIP7 (ECAP1) Input Select Register (GPIO0 to 63)
0x07 GPTRIP8SEL 16-bit — GPTRIP8 (ECAP2) Input Select Register (GPIO0 to 63)
0x08 GPIOLPMSEL1 — C28 LPM GPIO Select 1 Register (GPIO0 to 31)
0x0A GPIOLPMSEL2 — C28 LPM GPIO Select 2 Register (GPIO32 to 63)
{0x7+i} GPTRIP{i}SEL 16-bit (i=9..12) — GPTRIP{i} (ECAP{i-6}) Input Select Register (GPIO0 to 63)

## COMP1 — COMP REGS Registers
Base 0x00006400
Same registers: COMP2 0x00006420, COMP3 0x00006440, COMP4 0x00006460, COMP5 0x00006480, COMP6 0x000064A0
0x00 COMPCTL 16-bit — Comparator Control
0x02 COMPSTS 16-bit — Compare Output States
0x06 DACVAL 16-bit — 10-bit DAV Value

## GPIOG2CTRL — GPIOG2 CTRL REGS Registers
Base 0x00006F80
0x00 GPECTRL — GPIO E Control Register (GPIO128 to 135)
0x02 GPEQSEL1 — GPIO E Qualifier Select 1 Register (GPIO128 to 135)
0x06 GPEMUX1 — GPIO E Mux 1 Register (GPIO128 to 135)
0x0A GPEDIR — GPIO E Direction Register (GPIO128 to 135 )
0x0C GPEPUD — GPEPUD register for (GPIO128 to 135)
0x36 AIOMUX1 — Analog IO Mux 1 Register (AIO0-15)
0x38 AIOMUX2 — Analog IO Mux 2 Register (AIO16-31)
0x3A AIODIR — Analog IO Direction Register (AIO0-31)

## GPIOG2DAT — GPIOG2 DATA REGS Registers
Base 0x00006FC0
0x00 GPEDAT — GPIO E Data Register (GPIO128 to 135)
0x02 GPESET — GPIO E Data Set Register (GPIO128 to 135)
0x04 GPECLEAR — GPIO E Data Clear Register (GPIO128 to 135)
0x06 GPETOGGLE — GPIO E Data Toggle Register (GPIO128 to 135)
0x18 AIODAT — Analog IO Data Register (AIO0 to 31)
0x1A AIOSET — Analog IO Data Set Register (AIO0 to 31)
0x1C AIOCLEAR — Analog IO Data Clear Register (AIO0 to 31)
0x1E AIOTOGGLE — Analog IO Data Toggle Register (AIO0 to 31)

## SYSCTRL — SYS CTRL REGS Registers
Base 0x00007010
0x02 CLKCTL 16-bit — CPU Timer 2 Clock Configuration Register
0x09 PCLKCR2 16-bit — Peripheral Clock Control Register2
0x0A HISPCP 16-bit — High Speed Clock Prescaler
0x0B LOSPCP 16-bit — Low Speed Clock Prescaler
0x0C PCLKCR0 16-bit — Peripheral Clock Control Register0
0x0D PCLKCR1 16-bit — Peripheral Clock Control Register1
0x0E LPMCR0 16-bit — C28 LPM Control Register0
0x10 PCLKCR3 16-bit — Peripheral Clock Control Register3
0x1B CWIR 16-bit — Control subsystem Wait-in-Reset Register

## SPIA — Serial Peripheral Interface Registers
Base 0x00007040
0x00 SPICCR 16-bit — SPI Configuration Control Register
0x01 SPICTL 16-bit — SPI Operation Control Register
0x02 SPISTS 16-bit — SPI Status Register
0x04 SPIBRR 16-bit — SPI Baud Rate Register
0x06 SPIRXEMU 16-bit — SPI Receive Emulation Buffer Register
0x07 SPIRXBUF 16-bit — SPI Serial Input Buffer Register
0x08 SPITXBUF 16-bit — SPI Serial Output Buffer Register
0x09 SPIDAT 16-bit — SPI Serial Data Register
0x0A SPIFFTX 16-bit — SPI FIFO Transmit Register
0x0B SPIFFRX 16-bit — SPI FIFO Receive Register
0x0C SPIFFCT 16-bit — SPI FIFO Control Register
0x0F SPIPRI 16-bit — SPI Priority Control Register

## XINT — External Interrupt Registers
Base 0x00007070
0x00 XINT1CR 16-bit — XINT1 configuration register
0x01 XINT2CR 16-bit — XINT2 configuration register
0x02 XINT3CR 16-bit — XINT3 configuration register
0x08 XINT1CTR 16-bit — XINT1 counter register
0x09 XINT2CTR 16-bit — XINT2 counter register
0x09 XINT3CTR 16-bit — XINT3 counter register
