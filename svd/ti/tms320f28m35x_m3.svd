# TMS320F28M35x_M3 register map
Vendor: Texas Instruments; Series: C2000 Concerto F28M35x; File version: 0.2.0-generated
CPU: CM3 r2p1, little endian, no MPU, no FPU, 3 interrupt priority bits
Registers are 32-bit, read-write, reset 0x0 unless marked. A register's access mark holds for its fields unless they carry their own. Offsets are from the block's base; [hi:lo] are bit positions; {n}, {i} and the like mark numbered series.

## UCRC — UCRCREGS Registers
Base 0x400FB600
0x00 UCRCCONFIG — uCRC Configuration Register
0x04 UCRCCONTROL
0x08 UCRCRES — uCRC Result Register

## IPC — IPC REGS Registers
Base 0x400FB700
0x00 CTOMIPCACK — C28 to M3 Interrupt Request Clear
0x04 CTOMIPCSTS — C28 to M3 Interrupt Status
0x08 MTOCIPCSET — M3 to C28 Interrupt Request Set
0x0C MTOCIPCCLR — M3 to C28 Interrupt Request Clear
0x10 MTOCIPCFLG — M3 to C28 Interrupt Status Flag
0x18 MIPCCOUNTERL — IPC Counter Low Register
0x1C MIPCCOUNTERH — IPC Counter High Register
0x20 CTOMIPCCOM — C28 to M3 Command
0x24 CTOMIPCADDR — C28 to M3 Address
0x28 CTOMIPCDATAW — C28 to M3 Data Write
0x2C CTOMIPCDATAR — C28 to M3 Data Read
0x30 MTOCIPCCOM — M3 to C28 Command Register
0x34 MTOCIPCADDR — M3 to C28 Address
0x38 MTOCIPCDATAW — M3 to C28 Data Write
0x3C MTOCIPCDATAR — M3 to C28 Data Read
0x40 CTOMIPCBOOTSTS — IPC Boot Status
0x44 MTOCIPCBOOTMODE — IPC Boot Mode
0x48 MPUMPREQUEST — Flash Programming Semaphore Pump Request
0x4C MCLKREQUEST — Clock Configuratioin Semaphore M3 Request

## SYSCTL — SYSCTL REGS Registers
Base 0x400FB800
0x00 SYSPLLCTL — System PLL Configuration Register
0x04 SYSPLLMULT — System PLL Multiplier
0x08 SYSPLLSTS — System PLL lock status
0x0C SYSDIVSEL — System clock divider
0x10 M3SSDIVSEL — M3 Sub system clock divider
0x20 UPLLCTL — USB PLL config register
0x24 UPLLMULT — USB PLL Multiplier
0x28 UPLLSTS — USB PLL lock status
0x30 MCLKSTS — Missing clock status register
0x34 MCLKCTL — Missing clock configuration register
0x38 MCLKFRCCLR — Missing clock force register
0x3C MCLKEN — Missing clock enable register
0x40 MREFCLKLIM — Missing clock reference limit registers
0x50 XPLLCLKCFG — XPLL clkout control register
0x60 CCLKOFF — C28 clock disable register
0x70 CAN0BCLKSEL — Bit clock source selection for CAN0
0x74 CAN1BCLKSEL — Bit clock source selection for CAN1
0x80 CLPMSTAT — C28 Low Power Mode Status
0xC0 CRESCNF — C28 Reset Configuration
0xC4 CRESSTS — C28 Reset Status
0xC8 FUSEERR — Efuse Error Status
0xCC MWIR — WIR Decode Latch Register
0x100 MCNF — M3 Sub System Configuration
0x108 SERPLOOP — Serial Port Loop Back Control
0x10C MCIBSTATUS — Analog System Status Register
{0x110+4i} CCNF{i} (i=0..4) — C28 Peripheral Configuration {i}
0x130 MEMCNF — M3 Memory Configuration
0x180 MWRALLOW — M3 Configuration Write Allow
0x184 MLOCK — M3 Configuration Lock Register
0x2800 DID0 — Device ID 0
0x2804 DID1 — Device ID 1
0x2810 DC1 — Device Capabilities 1
0x2814 DC2 — Device Capabilities 2
0x281C DC4 — Device Capabilities 4
0x2824 DC6 — Device Capabilities 6
0x2828 DC7 — Device Capabilities 7
{0x2840+4i} SRCR{i} (i=0..3) — Software Reset Control {i}
0x285C RESC — M3 Reset Cause
0x2860 RCC — Run Mode Clock
0x286C GPIOHBCTL — GPIO High Performance Bus Control
{0x2900+4i} RCGC{i} (i=0..3) — Run Mode Clock Gating Control - Register {i}
{0x2910+4i} SCGC{i} (i=0..3) — Sleep Mode Clock Gating Control - Register {i}
{0x2920+4i} DCGC{i} (i=0..3) — Deep Sleep Mode Clock Gating Control - Register {i}
0x2944 DSLPCLKCFG — Deep Sleep Clock Configuration
0x2994 DC10 — Device Configuration 10
0x29A0 NVMSTAT — Non-Volatile Memory Status

## NMI — NMI REGS Registers
Base 0x400FBA00
0x00 NMI_CFG — M3 NMI Configuration Register
0x04 NMI_FLG — M3 NMI Flag Register
0x08 NMI_FLGCLR — M3 NMI Flag Clear Register
0x0C NMI_FLGFRC — M3 NMI Flag Force Register
0x10 NMI_WDCNT — M3 NMI Watchdog Counter Register
0x14 NMI_WDPRD — M3 NMI Watchdog Period Register

## UDMA — UDMA REGS Registers
Base 0x400FF000
0x00 DMASTAT — DMA Status
0x04 DMACFG — DMA Configuration
0x08 DMACTLBASE — DMA Channel Control Base Pointer
0x0C DMAALTBASE — DMA Alternate Channel Control Base Pointer
0x10 DMAWAITSTAT — DMA Channel Wait-on-Request Status
0x14 DMASWREQ — DMA Channel Software Request
0x18 DMAUSEBURSTSET — DMA Channel Useburst Set
0x1C DMAUSEBURSTCLR — DMA Channel Useburst Clear
0x20 DMAREQMASKSET — DMA Channel Request Mask Set
0x24 DMAREQMASKCLR — DMA Channel Request Mask Clear
0x28 DMAENASET — DMA Channel Enable Set
0x2C DMAENACLR — DMA Channel Enable Clear
0x30 DMAALTSET — DMA Channel Primary Alternate Set
0x34 DMAALTCLR — DMA Channel Primary Alternate Clear 290
0x38 DMAPRIOSET — DMA Channel Priority Set
0x3C DMAPRIOCLR — DMA Channel Priority Clear
0x4C DMAERRCLR — DMA Bus Error Clear
0x500 DMACHALTL — DMA Channel Alternate Select
{0x510+4i} DMACHMAP{i} (i=0..3) — DMA Channel Map Select {i}

## ADC1RESULT — ADC RESULT REGS Registers
Base 0x50001600
Same registers: ADC2RESULT 0x50001640
{0x0+2i} ADCRESULT{i} 16-bit (i=0..15) — Conversion Result Buffer {i}

## COREPERIPH — M3 CORE PERIPHERALS Registers
Base 0xE000E000
0x04 NVIC_INT_TYPE — Interrupt Controller Type Reg
0x10 SYSTICK_ST_CTRL — SysTick Control and Status Reg
0x14 SYSTICK_ST_RELOAD — SysTick Reload Value Register
0x18 SYSTICK_ST_CURRENT — SysTick Current Value Register
0x1C SYSTICK_ST_CAL — SysTick Calibration Value Reg
{0x100+4i} NVIC_EN{i} (i=0..3) — IRQ {32i} to {32i+31} Set Enable Register
0x110 NVIC_EN4 — IRQ 128 to 133 Set Enable Register
{0x180+4i} NVIC_DIS{i} (i=0..3) — IRQ {32i} to {32i+31} Clear Enable Reg
0x190 NVIC_DIS4 — IRQ 128 to 133 Clear Enable Reg
0x200 NVIC_PEND0 — IRQ 0 to 31 Set Pending Register
{0x200+4i} NVIC_PEND{i} (i=1..3) — IRQ {32i} to {32i+31} Set Pending Reg
0x210 NVIC_PEND4 — IRQ 128 to 133 Set Pending Reg
{0x280+4i} NVIC_UNPEND{i} (i=0..3) — IRQ {32i} to {32i+31} Clear Pending Reg
0x290 NVIC_UNPEND4 — IRQ 128 to 133 Clear Pending Reg
{0x300+4i} NVIC_ACTIVE{i} (i=0..3) — IRQ {32i} to {32i+31} Active Register
0x310 NVIC_ACTIVE4 — IRQ 128 to 133 Active Register
{0x400+4i} NVIC_PRI{i} (i=0..33) — IRQ {4i} to {4i+3} Priority Register
0xD00 SCB_CPUID — CPUID Base Register
0xD04 SCB_INT_CTRL — Interrupt Control State Register
0xD08 SCB_VTABLE — Vector Table Offset Register
0xD0C SCB_APINT — App. Int & Reset Control Reg
0xD10 SCB_SYS_CTRL — System Control Register
0xD14 SCB_CFG_CTRL — Configuration Control Register
{0xD14+4i} SCB_SYS_PRI{i} (i=1..3) — Sys. Handlers {4i} to {4i+3} Priority
0xD24 SCB_SYS_HND_CTRL — System Handler Control and State
0xD28 SCB_FAULT_STAT — Configurable Fault Status Reg
0xD2C SCB_HFAULT_STAT — Hard Fault Status Register
0xD30 DEBUG_STAT — Debug Status Register
0xD34 SCB_MM_ADDR — Mem Manage Address Register
0xD38 SCB_FAULT_ADDR — Bus Fault Address Register
0xD90 MPU_TYPE
0xD94 MPU_CTRL — MPU Control Register
0xD98 MPU_NUMBER — MPU Region Number Register
0xD9C MPU_BASE — MPU Region Base Address Register
0xDA0 MPU_ATTR — MPU Region Attribute & Size Reg
0xDF0 DEBUG_DBG_CTRL — Debug Control and Status Reg
0xDF4 DEBUG_DBG_XFER — Debug Core Reg. Transfer Select
0xDF8 DEBUG_DBG_DATA — Debug Core Register Data
0xDFC DEBUG_DBG_INT — Debug Reset Interrupt Control
0xF00 NVIC_SW_TRIG — Software Trigger Interrupt Reg
