# TMS320F28069 register map
Vendor: Texas Instruments; Series: C2000 F2806x; File version: 0.2.0-generated
Registers are 16-bit, read-write, reset 0x0 unless marked. A register's access mark holds for its fields unless they carry their own. Offsets are from the block's base; [hi:lo] are bit positions; {n}, {i} and the like mark numbered series.

## SYSCTRL — System Control Registers
Base 0x0000E020
0x00 XCLK — XCLKOUT Control
0x02 PLLSTS — PLL Status Register
0x04 CLKCTL — Clock Control Register
0x06 PLLLOCKPRD — PLL Lock Period Register
0x08 INTOSC1TRIM — Internal Oscillator 1 Trim Register
0x0C INTOSC2TRIM — Internal 32KHz Oscillator 2 Trim Register
0x12 PCLKCR2 — Peripheral Clock Control Register 2
0x16 LOSPCP — Low-Speed Peripheral Clock Pre-Scaler Register
0x18 PCLKCR0 — Peripheral Clock Control Register 0
0x1A PCLKCR1 — Peripheral Clock Control Register 1
0x1C LPMCR0 — Low Power Mode Control Register 0
0x20 PCLKCR3 — Peripheral Clock Control Register 3
0x22 PLLCR — PLL Control Register
0x24 SCSR — System Control and Status Register
0x26 WDCNTR — Watchdog Counter Register
0x2A WDKEY — Watchdog Reset Key Register
0x32 WDCR — Watchdog Control Register
0x34 JTAGDEBUG — JTAG Port Debug Register
0x40 PLL2CTL — PLL2 Configuration Register
0x44 PLL2MULT — PLL2 Multiplier Register
0x48 PLL2STS — PLL2 Lock Status Register
0x4C SYSCLK2CNTR — Sys Clock 2 Counter Register
0x54 EPWMCFG — EPWM DMA/CLA Configuration Register

## SPIA — Serial Peripheral Interface Registers
Base 0x0000E080
0x00 SPICCR — SPI Configuration Control Register
0x02 SPICTL — SPI Operation Control Register
0x04 SPISTS — SPI Status Register
0x08 SPIBRR — SPI Baud Rate Register
0x0C SPIRXEMU — SPI Receive Emulation Buffer Register
0x0E SPIRXBUF — SPI Serial Input Buffer Register
0x10 SPITXBUF — SPI Serial Output Buffer Register
0x12 SPIDAT — SPI Serial Data Register
0x14 SPIFFTX — SPI FIFO Transmit Register
0x16 SPIFFRX — SPI FIFO Receive Register
0x18 SPIFFCT — SPI FIFO Control Register
0x1E SPIPRI — SPI Priority Control Register

## SPIB — Serial Peripheral Interface Registers
Base 0x0000EE80
Registers as SPIA, without SPIBRR; these are added or differ:
0x08 SPIBRR — SPI Baud Rate Register

## NMIINT — NMI Interrupt Registers
Base 0x0000E0C0
0x00 NMICFG
0x02 NMIFLG
0x04 NMIFLGCLR
0x06 NMIFLGFRC
0x08 NMIWDCNT
0x0A NMIWDPRD

## XINT — External Interrupt Registers
Base 0x0000E0E0
0x00 XINT1CR — XINT1 configuration register
0x02 XINT2CR — XINT2 configuration register
0x04 XINT3CR — XINT3 configuration register
{0xE+2i} XINT{i}CTR (i=1..3) — XINT{i} counter register

## ADC — ADC Registers
Base 0x0000E200
0x00 ADCCTL1 — ADC Control 1
0x02 ADCCTL2 — ADC Control 2
0x08 ADCINTFLG — ADC Interrupt Flag
0x0A ADCINTFLGCLR — ADC Interrupt Flag Clear
0x0C ADCINTOVF — ADC Interrupt Overflow
0x0E ADCINTOVFCLR — ADC Interrupt Overflow Clear
0x10 INTSEL1N2 — ADC Interrupt 1 and 2 Selection
0x12 INTSEL3N4 — ADC Interrupt 3 and 4 Selection
0x14 INTSEL5N6 — ADC Interrupt 5 and 6 Selection
0x16 INTSEL7N8 — ADC Interrupt 7 and 8 Selection
0x18 INTSEL9N10 — ADC Interrupt 9 and 10 Selection
0x20 SOCPRICTL — ADC SOC Priority Control
0x24 ADCSAMPLEMODE — ADC Sampling Mode
0x28 ADCINTSOCSEL1 — ADC Interrupt SOC Selection 1
0x2A ADCINTSOCSEL2 — ADC Interrupt SOC Selection 2
0x30 ADCSOCFLG1 — ADC SOC Flag 1
0x34 ADCSOCFRC1 — ADC SOC Flag Force 1
0x38 ADCSOCOVF1 — ADC SOC Overflow 1
0x3C ADCSOCOVFCLR1 — ADC SOC Overflow Clear 1
{0x40+2i} ADCSOC{i}CTL (i=0..15) — ADC SOC{i} Control
0x80 ADCREFTRIM — Reference Trim Register
0x82 ADCOFFTRIM — Offset Trim Register
0x98 COMPHYSTCTL — Comparator Hysteresis Control Register

## I2CA — I2C Registers
Base 0x0000F200
0x00 I2COAR — I2C own address register
0x02 I2CIER — I2C interrupt enable register
0x04 I2CSTR — I2C status register
0x06 I2CCLKL — I2C clock low-time divider register
0x08 I2CCLKH — I2C clock high-time divider register
0x0A I2CCNT — I2C data count register
0x0C I2CDRR — I2C data receive register
0x0E I2CSAR — I2C slave address register
0x10 I2CDXR — I2C data transmit register
0x12 I2CMDR — I2C mode register
0x14 I2CISRC — I2C interrupt source register
0x18 I2CPSC — I2C prescaler register
0x40 I2CFFTX — I2C FIFO transmit register
0x42 I2CFFRX — I2C FIFO receive register

## PWL — PWL Locations
Base 0x007EFFF0
{0x0+2i} PWL{i} (i=0..7) — CSM Password Location {i}
