# TMS320F28069 register map
Vendor: Texas Instruments; Series: C2000 F2806x; File version: 0.2.0-generated
Registers are 16-bit, read-write, reset 0x0 unless marked. A register's access mark holds for its fields unless they carry their own. Offsets are from the block's base; [hi:lo] are bit positions; {n}, {i} and the like mark numbered series.

## ECAP1 — eCAP Control and Status Registers
Base 0x0000D400
Same registers: ECAP2 0x0000D440, ECAP3 0x0000D480
0x00 TSCTR 32-bit — eCAP Time-Stamp Counter
0x04 CTRPHS 32-bit — eCAP Counter Phase Offset Value Register
{0x4+4i} CAP{i} 32-bit (i=1..4) — eCAP Capture {i} Register
0x28 ECCTL1 — eCAP Capture Control Register 1
0x2A ECCTL2 — eCAP Capture Control Register 2
0x2C ECEINT — eCAP Capture Interrupt Enable Register
0x2E ECFLG — eCAP Capture Interrupt Flag Register
0x30 ECCLR — eCAP Capture Interrupt Clear Register
0x32 ECFRC — eCAP Capture Interrupt Force Register

## HRCAP1 — HRCAP1 Registers
Base 0x0000D580
Same registers: HRCAP2 0x0000D5C0, HRCAP3 0x0000D900, HRCAP4 0x0000D940
0x00 HCCTL — HRCAP Control Register
0x02 HCIFR — HRCAP Interrupt Flag Register
0x04 HCICLR — HRCAP Interrupt Clear Register
0x06 HCIFRC — HRCAP Interrupt Force Register
0x08 HCCOUNTER — HRCAP 16-bit Counter Register
0x20 HCCAPCNTRISE0 — HRCAP Capture Counter On Rising Edge 0 Register
0x24 HCCAPCNTFALL0 — HRCAP Capture Counter On Falling Edge 0 Register
0x30 HCCAPCNTRISE1 — HRCAP Capture Counter On Rising Edge 1 Register
0x34 HCCAPCNTFALL1 — HRCAP Capture Counter On Falling Edge 1 Register

## EQEP1 — eQEP Control and Status Registers
Base 0x0000D600
Same registers: EQEP2 0x0000D680
0x00 QPOSCNT 32-bit — eQEP Position Counter
0x04 QPOSINIT 32-bit — eQEP Initialization Position Count
0x08 QPOSMAX 32-bit — eQEP Maximum Position Count
0x0C QPOSCMP 32-bit — eQEP Position-compare
0x10 QPOSILAT 32-bit — eQEP Index Position Latch
0x14 QPOSSLAT 32-bit — eQEP Strobe Position Latch
0x18 QPOSLAT 32-bit — eQEP Position Latch
0x1C QUTMR 32-bit — eQEP Unit Timer
0x20 QUPRD 32-bit — eQEP Unit Period Register
0x24 QWDTMR — eQEP Watchdog Timer
0x26 QWDPRD — eQEP Watchdog Period Register
0x28 QDECCTL — eQEP Decoder Control Register
0x2A QEPCTL — eQEP Control Register
0x2C QCAPCTL — eQEP Capture Control Register
0x2E QPOSCTL — eQEP Position-compare Control Register
0x30 QEINT — eQEP Interrupt Enable Register
0x32 QFLG — eQEP Interrupt Flag Register
0x34 QCLR — eQEP Interrupt Clear Register
0x36 QFRC — eQEP Interrupt Force Register
0x38 QEPSTS — eQEP Status Register
0x3A QCTMR — eQEP Capture Timer
0x3C QCPRD — eQEP Capture Period Register
0x3E QCTMRLAT — eQEP Capture Timer Latch
0x40 QCPRDLAT — eQEP Capture Period Latch

## GPIO — GPIO Control Registers
Base 0x0000DF00
0x00 GPACTRL 32-bit — GPIO A Control Register (GPIO0 to 31)
0x04 GPAQSEL1 32-bit — GPIO A Qualifier Select 1 Register (GPIO0 to 15)
0x08 GPAQSEL2 32-bit — GPIO A Qualifier Select 2 Register (GPIO16 to 31)
0x0C GPAMUX1 32-bit — GPIO A MUX 1 Register (GPIO0 to 15)
0x10 GPAMUX2 32-bit — GPIO A MUX 2 Register (GPIO16 to 31)
0x14 GPADIR 32-bit — GPIO A Direction Register (GPIO0 to 31)
0x18 GPAPUD 32-bit — GPIO A Pull Up Disable Register (GPIO0 to 31)
0x1C GPACTRL2
0x20 GPBCTRL 32-bit — GPIO B Control Register (GPIO32 to 44)
0x24 GPBQSEL1 32-bit — GPIO B Qualifier Select 1 Register (GPIO32 to 44)
0x28 GPBQSEL2 32-bit — GPIO B Qualifier Select 2 Register (GPIO45 to 63)
0x2C GPBMUX1 32-bit — GPIO B MUX 1 Register (GPIO32 to 44)
0x30 GPBMUX2 32-bit — GPIO B MUX 2 Register (GPIO46 to 63)
0x34 GPBDIR 32-bit — GPIO B Direction Register (GPIO32 to 44)
0x38 GPBPUD 32-bit — GPIO B Pull Up Disable Register (GPIO32 to 44)
0x6C AIOMUX1 32-bit — Analog I/O MUX1 Register
0x74 AIODIR 32-bit — Analog I/O Direction Register
0x80 GPADAT 32-bit — GPIO A Data Register (GPIO0 to 31)
0x84 GPASET 32-bit — GPIO A Data Set Register (GPIO0 to 31)
0x88 GPACLEAR 32-bit — GPIO A Data Clear Register (GPIO0 to 31)
0x8C GPATOGGLE 32-bit — GPIO A Data Toggle Register (GPIO0 to 31)
0x90 GPBDAT 32-bit — GPIO B Data Register (GPIO32 to 44)
0x94 GPBSET 32-bit — GPIO B Data Set Register (GPIO32 to 44)
0x98 GPBCLEAR 32-bit — GPIO B Data Clear Register (GPIO32 to 44)
0x9C GPBTOGGLE 32-bit — GPIO B Data Toggle Register (GPIO32 to 44)
0xB0 AIODAT 32-bit — Analog I/O Data Register
0xB4 AIOSET 32-bit — Analog I/O Data Set Register
0xB8 AIOCLEAR 32-bit — Analog I/O Data Clear Register
0xBC AIOTOGGLE 32-bit — Analog I/O Data Toggle Register
{0xBE+2i} GPIOXINT{i}SEL (i=1..3) — XINT{i} GPIO Input Select Register (GPIO0 to 31)
0xD0 GPIOLPMSEL 32-bit — LPM GPIO Select Register (GPIO0 to 31)
