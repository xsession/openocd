# TMS320F28069 register map
Vendor: Texas Instruments; Series: C2000 F2806x; File version: 0.2.0-generated
Registers are 16-bit, read-write, reset 0x0 unless marked. A register's access mark holds for its fields unless they carry their own. Offsets are from the block's base; [hi:lo] are bit positions; {n}, {i} and the like mark numbered series.

## ECANA — eCAN Control and Status Registers
Base 0x0000C000
0x00 CANME 32-bit — eCAN Mailbox Enable
0x04 CANMD 32-bit — eCAN Mailbox Direction
0x08 CANTRS 32-bit — eCAN Transmission Request Set
0x0C CANTRR 32-bit — eCAN Transmission Request Reset
0x10 CANTA 32-bit — eCAN Transmission Acknowledge
0x14 CANAA 32-bit — eCAN Abort Acknowledge
0x18 CANRMP 32-bit — eCAN Received Message Pending
0x1C CANRML 32-bit — eCAN Received Message Lost
0x20 CANRFP 32-bit — eCAN Received Frame Pending
0x24 CANGAM 32-bit — eCAN Global Acceptance Mask
0x28 CANMC 32-bit — eCAN Master Control
0x2C CANBTC 32-bit — eCAN Bit-Timing Configuration
0x30 CANES 32-bit — eCAN Error and Status
0x34 CANTEC 32-bit — eCAN Transmit Error Counter
0x38 CANREC 32-bit — eCAN Receive Error Counter
0x3C CANGIF0 32-bit — eCAN Global Interrupt Flag 0
0x40 CANGIM 32-bit — eCAN Global Interrupt Mask
0x44 CANGIF1 32-bit — eCAN Global Interrupt Flag 1
0x48 CANMIM 32-bit — eCAN Mailbox Interrupt Mask
0x4C CANMIL 32-bit — eCAN Mailbox Interrupt Level
0x50 CANOPC 32-bit — eCAN Overwrite Protection Control
0x54 CANTIOC 32-bit — eCAN TX I/O Control
0x58 CANRIOC 32-bit — eCAN RX I/O Control
0x5C CANTSC 32-bit — eCAN Time Stamp Counter
0x60 CANTOC 32-bit — eCAN Time-Out Control
0x64 CANTOS 32-bit — eCAN Time-Out Status

## ECANA_LAM — eCAN Local Acceptance Masks
Base 0x0000C080
{0x0+4i} MBX{i}_LAM 32-bit (i=0..31) — eCAN Mailbox {i} Local Acceptance Mask

## ECANA_MOTS — eCAN Message Object Time Stamps
Base 0x0000C100
{0x0+4i} MBX{i}_MOTS 32-bit (i=0..31) — eCAN Mailbox {i} Message Object Time Stamp

## ECANA_MOTO — eCAN Message Object Time-Outs
Base 0x0000C180
{0x0+4i} MBX{i}_MOTO 32-bit (i=0..31) — eCAN Mailbox {i} Message Object Time-Out

## ECANA_MBX_CONTENT — eCAN Mailbox Content
Base 0x0000C200
{0x0+0x10*i} MBX{i}_MSGID 32-bit (i=0..31) — eCAN Mailbox {i} Message Identifier
{0x4+0x10*i} MBX{i}_MSGCTRL 32-bit (i=0..31) — eCAN Mailbox {i} Message Control
{0x8+0x10*i} MBX{i}_MDL 32-bit (i=0..31) — eCAN Mailbox {i} Message Data Low
{0xC+0x10*i} MBX{i}_MDH 32-bit (i=0..31) — eCAN Mailbox {i} Message Data High

## COMP1 — Comparator Registers
Base 0x0000C800
Same registers: COMP2 0x0000C840, COMP3 0x0000C880
0x00 COMPCTL — Comparator Control Register
0x04 COMPSTS — Comparator Status Register
0x08 DACCTL — DAC Control Register
0x0C DACVAL — DAC Value Register
0x10 RAMPMAXREF_ACTIVE — Ramp Generator Maximum Reference (Active)
0x14 RAMPMAXREF_SHDW — Ramp Generator Maximum Reference (Shadow)
0x18 RAMPDECVAL_ACTIVE — Ramp Generator Decrement Value (Active)
0x1C RAMPDECVAL_SHDW — Ramp Generator Decrement Value (Shadow)
0x20 RAMPSTS — Ramp Generator Status

## EPWM1 — EPWM1 Registers
Base 0x0000D000
0x00 TBCTL — Time Base Control Register
0x02 TBSTS — Time Base Status Register
0x04 TBPHS 32-bit — Union of TBPHS:TBPHSHR
0x08 TBCTR — Time Base Counter
0x0A TBPRD — Time Base Period register set
0x0C TBPRDHR — Time Base Period High Res Register
0x0E CMPCTL — Compare control
0x10 CMPA 32-bit — Union of CMPA:CMPAHR
0x14 CMPB — Compare B reg
0x16 AQCTLA — Action qual output A
0x18 AQCTLB — Action qual output B
0x1A AQSFRC — Action qual SW force
0x1C AQCSFRC — Action qualifier continuous SW force
0x1E DBCTL — Dead-band control
0x20 DBRED — Dead-band rising edge delay
0x22 DBFED — Dead-band falling edge delay
0x24 TZSEL — Trip zone select
0x26 TZDCSEL — Trip zone digital comparator select
0x28 TZCTL — Trip zone control
0x2A TZEINT — Trip zone interrupt enable
0x2C TZFLG — Trip zone interrupt flags
0x2E TZCLR — Trip zone clear
0x30 TZFRC — Trip zone force interrupt
0x32 ETSEL — Event trigger selection
0x34 ETPS — Event trigger pre-scaler
0x36 ETFLG — Event trigger flags
0x38 ETCLR — Event trigger clear
0x3A ETFRC — Event trigger force
0x3C PCCTL — PWM chopper control
0x40 HRCNFG — HRPWM Config Reg
0x42 HRPWR — HRPWM Power Register - N/A on F2806x devices
0x4C HRMSTEP — HRPWM MEP Step Register
0x50 HRPCTL — High Resolution Period Control
0x54 TBPRDM 32-bit — Union of TBPRD:TBPRDHR mirror registers
0x58 CMPAM 32-bit — Union of CMPA:CMPAHR mirror registers
0x60 DCTRIPSEL — Digital Compare Trip Select
0x62 DCACTL — Digital Compare A Control
0x64 DCBCTL — Digital Compare B Control
0x66 DCFCTL — Digital Compare Filter Control
0x68 DCCAPCTL — Digital Compare Capture Control
0x6A DCFOFFSET — Digital Compare Filter Offset
0x6C DCFOFFSETCNT — Digital Compare Filter Offset Counter
0x6E DCFWINDOW — Digital Compare Filter Window
0x70 DCFWINDOWCNT — Digital Compare Filter Window Counter
0x72 DCCAP — Digital Compare Filter Counter Capture

## EPWM2 — EPWMn Registers
Base 0x0000D080
Registers as EPWM1, without HRPWR, HRMSTEP.

## EPWM3 — EPWMn Registers
Base 0x0000D100
Registers as EPWM1, without HRPWR, HRMSTEP.

## EPWM4 — EPWMn Registers
Base 0x0000D180
Registers as EPWM1, without HRPWR, HRMSTEP.

## EPWM5 — EPWMn Registers
Base 0x0000D200
Registers as EPWM1, without HRPWR, HRMSTEP.

## EPWM6 — EPWMn Registers
Base 0x0000D280
Registers as EPWM1, without HRPWR, HRMSTEP.

## EPWM7 — EPWMn Registers
Base 0x0000D300
Registers as EPWM1, without HRPWR, HRMSTEP.

## EPWM8 — EPWMn Registers
Base 0x0000D380
Registers as EPWM1, without HRPWR, HRMSTEP.
