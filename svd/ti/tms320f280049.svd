# TMS320F280049 register map
Vendor: Texas Instruments; Series: C2000 F28004x; File version: 0.2.0-generated
Generated from TI CCS targetdb file f280049.xml. Review against the TI technical reference manual before production use.
Registers are 16-bit, read-write, reset 0x0 unless marked. A register's access mark holds for its fields unless they carry their own. Offsets are from the block's base; lines under a group give offsets from that group; [hi:lo] are bit positions; {n}, {i} and the like mark numbered series; 'fields as' and 'values as' point back to an identical list; <NAME> marks a mode.

## Memory map
0x00001600 ADCARESULTREGS — ADC RESULT Registers
0x00001640 ADCBRESULTREGS — ADC RESULT Registers
0x00001680 ADCCRESULTREGS — ADC RESULT Registers
0x00001800 CLA1ONLYREGS — CLA ONLY Registers
0x00001800 CPUTIMER0REGS — CPUTIMER Registers
0x00001810 CPUTIMER1REGS — CPUTIMER Registers
0x00001820 CPUTIMER2REGS — CPUTIMER Registers
0x000019C0 PIECTRLREGS — PIE CTRL Registers
0x00001E00 FPU — Floating-Point Unit Single Precision Registers
0x00002000 DMAREGS — DMA Registers
0x00002040 DMACH1REGS — DMA CH Registers
0x00002080 DMACH2REGS — DMA CH Registers
0x000020C0 DMACH3REGS — DMA CH Registers
0x00002100 DMACH4REGS — DMA CH Registers
0x00002140 DMACH5REGS — DMA CH Registers
0x00002180 DMACH6REGS — DMA CH Registers
0x00002400 VCU — VCU Registers
0x00002800 CLA1REGS — CLA2 Registers
0x00002800 CLA2NOTVISIBLE
{0x7E00+0x200*n} EPWM{n}REGS (n=1..8) — EPWM Registers
0x0000A200 EQEP1REGS — EQEP Registers
0x0000A280 EQEP2REGS — EQEP Registers
0x0000A400 ECAP1REGS — ECAP Registers
0x0000A480 ECAP2REGS — ECAP Registers
0x0000A500 ECAP3REGS — ECAP Registers
0x0000A580 ECAP4REGS — ECAP Registers
0x0000A600 ECAP5REGS — ECAP Registers
0x0000A680 ECAP6REGS — ECAP Registers
0x0000A6C0 HRCAP6REGS — HRCAP Registers
0x0000A700 ECAP7REGS — ECAP Registers
0x0000A740 HRCAP7REGS — HRCAP Registers
0x0000B600 PGA1REGS — PGA Registers
0x0000B620 PGA2REGS — PGA Registers
0x0000B640 PGA3REGS — PGA Registers
0x0000B660 PGA4REGS — PGA Registers
0x0000B680 PGA5REGS — PGA Registers
0x0000B6A0 PGA6REGS — PGA Registers
0x0000B6C0 PGA7REGS — PGA Registers
0x0000B800 DACAREGS — DAC Registers
0x0000B820 DACBREGS — DAC Registers
0x0000B900 CMPSS1REGS — CMPSS Registers
0x0000B940 CMPSS2REGS — CMPSS Registers
0x0000B980 CMPSS3REGS — CMPSS Registers
0x0000B9C0 CMPSS4REGS — CMPSS Registers
0x0000BA00 CMPSS5REGS — CMPSS Registers
0x0000BA40 CMPSS6REGS — CMPSS Registers
0x0000BA80 CMPSS7REGS — CMPSS Registers
0x0000BC00 SDFM1REGS — SDFM Registers
0x0000C200 SPIAREGS — SPI Registers
0x0000C220 SPIBREGS — SPI Registers
0x0000C380 CLAPROMCRC32 — CLA PROM CRC32 Registers
0x0000C800 PMBUSAREGS — PMBUS Registers
0x0000CC00 FSITXAREGS — FSI TX Registers
0x0000CD00 FSIRXAREGS — FSI RX Registers
0x0000D400 LINAREGS — LIN Registers
0x0000E000 WDREGS — WD Registers
0x0000E0C0 NMIINTRUPTREGS — NMI INTRUPT Registers
0x0000E0E0 XINTREGS — XINT Registers
0x0000E400 SCIAREGS — SCI Registers
0x0000E420 SCIBREGS — SCI Registers
0x0000E600 I2CAREGS — I2C Registers
0x0000E800 ADCAREGS — ADC Registers
0x0000E900 ADCBREGS — ADC Registers
0x0000EA00 ADCCREGS — ADC Registers
0x0000F200 INPUTXBARREGS — INPUT XBAR Registers
0x0000F240 XBARREGS — XBAR Registers
0x0000F280 SYNCSOCREGS — SYNC SOC Registers
0x0000F300 DMACLASRCSELREGS — DMA CLA SRC SEL Registers
0x0000F400 EPWMXBARREGS — EPWM XBAR Registers
0x0000F500 OUTPUTXBARREGS — OUTPUT XBAR Registers
0x0000F800 GPIOCTRLREGS — GPIO CTRL Registers
0x0000FE00 GPIODATAREGS — GPIO DATA Registers
0x00090000 CANAREGS — CAN Registers
0x00094000 CANBREGS — CAN Registers
0x000BA000 DEVCFGREGS — DEV CFG Registers
0x000BA400 CLKCFGREGS — CLK CFG Registers
0x000BA600 CPUSYSREGS — CPU SYS Registers
0x000BAA00 SYSPERIPHACREGS — PERIPH AC Registers
0x000BAE00 ANALOGSUBSYSREGS — ANALOG SUBSYS Registers
0x000BCC10 ROMPREFETCHREGS — ROM PREFETCH Registers
0x000BCE00 DCC0REGS — DCC Registers
0x000BD000 ERADGLOBALREGS — ERAD GLOBAL Registers
{0xBD1F0+0x10*n} ERADHWBP{n}REGS (n=1..8) — ERAD HWBP Registers
0x000BD300 ERADCOUNTER1REGS — ERAD COUNTER Registers
0x000BD320 ERADCOUNTER2REGS — ERAD COUNTER Registers
0x000BD340 ERADCOUNTER3REGS — ERAD COUNTER Registers
0x000BD360 ERADCOUNTER4REGS — ERAD COUNTER Registers
0x000BE000 DCSMBANK0Z1REGS — DCSM BANK0 Z1 Registers
0x000BE080 DCSMBANK0Z2REGS — DCSM BANK0 Z2 Registers
0x000BE0E0 DCSMCOMMONREGS — DCSM COMMON Registers
0x000BE200 DCSMBANK1Z1REGS — DCSM BANK1 Z1 Registers
0x000BE280 DCSMBANK1Z2REGS — DCSM BANK1 Z2 Registers
0x000BE800 MEMCFGREGS — MEM CFG Registers
0x000BE980 ACCESSPROTECTIONREGS — ACCESS PROTECTION Registers
0x000BEA00 MEMORYERRORREGS — MEMORY ERROR Registers
0x000BEA80 ROMWAITSTATEREGS — ROM WAIT STATE Registers
0x000BF000 FLASHCTRLREGS — FLASH CTRL Registers
0x000BF600 FLASHECCREGS — FLASH ECC Registers

## Further device data
tiCore=C28X, tiAddressScale=2, tiCortexDebugCompatible=false, tiProcessorName=c28x, tiGenerator=ti-c2000-toolchain

## Licence text in the file
Generated metadata follows the license of the source TI files. Generator code is MIT licensed.
