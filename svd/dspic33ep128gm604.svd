# dsPIC33EP128GM604 register map
Vendor: Microchip; Series: dsPIC33EP; File version: 1.0
Registers are 16-bit, read-write, reset 0x0 unless marked. A register's access mark holds for its fields unless they carry their own. Offsets are from the block's base; [hi:lo] are bit positions; {n}, {i} and the like mark numbered series.

## SFR — Special Function Register data space
Base 0x00000000
{0x0+2i} WREG{i} (reset mask 0x1) (i=0..4)
{0x0+2i} WREG{i} (reset mask 0x1) (i=6..14)
0x1E WREG15 reset 0x80 (reset mask 0x80)
0x20 SPLIM (reset mask 0x1)
0x22 ACCAL reset not defined
0x24 ACCAH reset not defined
0x26 ACCAU (reset mask 0xFF00)
  [7:0] ACCAU
0x28 ACCBL reset not defined
0x2A ACCBH reset not defined
0x2C ACCBU (reset mask 0xFF00)
  [7:0] ACCBU
0x2E PCL ro (reset mask 0x1)
0x30 PCH ro
  [7:0] PCH
0x32 DSRPAG reset 0x1
  [9:0] DSRPAG
0x34 DSWPAG reset 0x1
  [8:0] DSWPAG
0x36 RCOUNT reset not defined
0x38 DCOUNT reset not defined
0x3A DOSTARTL (reset mask 0x1)
0x3C DOSTARTH reset not defined
  [5:0] DOSTARTH
0x3E DOENDL (reset mask 0x1)
0x40 DOENDH reset not defined
  [5:0] DOENDH
0x42 SR
  [0] C
0x44 CORCON reset 0x20
  [0] IF
0x46 MODCON
  [3:0] XWM
0x48 XMODSRT (reset mask 0x1)
  [15:0] XS
0x4A XMODEND reset 0x1 (reset mask 0x1)
  [15:0] XE
0x4C YMODSRT (reset mask 0x1)
  [15:0] YS
0x4E YMODEND reset 0x1 (reset mask 0x1)
  [15:0] YE
0x50 XBREV reset not defined
  [14:0] XB
0x52 DISICNT reset not defined
  [13:0] DISICNT
0x54 TBLPAG reset not defined
  [7:0] TBLPAG
0x58 MSTRPR reset not defined
0x100 TMR1 reset not defined
0x102 PR1 reset 0xFFFF
0x104 T1CON (reset mask 0xA076)
  [0] TCS
0x106 TMR2 reset not defined
0x108 TMR3HLD reset not defined
0x10A TMR3 reset not defined
0x10C PR2 reset 0xFFFF
0x10E PR3 reset 0xFFFF
0x110 T2CON (reset mask 0xA07A)
  [0] TCS
0x112 T3CON (reset mask 0xA072)
  [0] TCS
0x114 TMR4 reset not defined
0x116 TMR5HLD reset not defined
0x118 TMR5 reset not defined
0x11A PR4 reset 0xFFFF
0x11C PR5 reset 0xFFFF
0x11E T4CON (reset mask 0xA07A)
  [0] TCS
0x120 T5CON (reset mask 0xA072)
  [0] TCS
0x122 TMR6 reset not defined
0x124 TMR7HLD reset not defined
0x126 TMR7 reset not defined
0x128 PR6 reset 0xFFFF
0x12A PR7 reset 0xFFFF
0x12C T6CON (reset mask 0xA07A)
  [0] TCS
0x12E T7CON (reset mask 0xA072)
  [0] TCS
0x130 TMR8 reset not defined
0x132 TMR9HLD reset not defined
0x134 TMR9 reset not defined
0x136 PR8 reset 0xFFFF
0x138 PR9 reset 0xFFFF
0x13A T8CON (reset mask 0xA07A)
  [0] TCS
0x13C T9CON (reset mask 0xA072)
  [0] TCS
{0x138+8i} IC{i}CON1 (i=1..8)
  [2:0] ICM
{0x13A+8i} IC{i}CON2 reset 0xD (i=1..8)
  [4:0] SYNCSEL
{0x13C+8i} IC{i}BUF ro (reset mask 0x1) (i=1..8)
{0x13E+8i} IC{i}TMR ro (reset mask 0x1) (i=1..8)
0x1C0 QEI1CON reset not defined
  [1:0] CCM
0x1C2 QEI1IOC reset not defined
  [0] QEA
0x1C4 QEI1STAT reset not defined
  [0] IDXIEN
0x1C6 POS1CNTL reset not defined
  [15:0] POSCNTL
0x1C8 POS1CNTH reset not defined
  [15:0] POSCNTH
0x1CA POS1HLD reset not defined
  [15:0] POSHLD
0x1CC VEL1CNT reset not defined
  [15:0] VELCNT
0x1CE INT1TMRL reset not defined
  [15:0] INTTMRL
0x1D0 INT1TMRH reset not defined
  [15:0] INTTMRH
0x1D2 INT1HLDL reset not defined
  [15:0] INTHLDL
0x1D4 INT1HLDH reset not defined
  [15:0] INTHLDH
0x1D6 INDX1CNTL reset not defined
  [15:0] INDXCNTL
0x1D8 INDX1CNTH reset not defined
  [15:0] INDXCNTH
0x1DA INDX1HLD reset not defined
  [15:0] INDXHLD
0x1DC QEI1GECL reset not defined
  [15:0] QEIGEC
0x1DE QEI1GECH reset not defined
  [15:0] QEIGEC
0x1E0 QEI1LECL reset not defined
  [15:0] QEILEC
0x1E2 QEI1LECH reset not defined
  [15:0] QEILEC
0x200 I2C1RCV ro
  [7:0] I2CRCV
0x202 I2C1TRN wo reset 0xFF
  [7:0] I2CTRN
0x204 I2C1BRG
  [8:0] I2CBRG
0x206 I2C1CON reset 0x1000
  [0] SEN
0x208 I2C1STAT ro
  [0] TBF
0x20A I2C1ADD
  [9:0] I2CADD
0x20C I2C1MSK
  [9:0] AMSK
0x210 I2C2RCV ro
  [7:0] I2CRCV
0x212 I2C2TRN wo reset 0xFF
  [7:0] I2CTRN
0x214 I2C2BRG
  [8:0] I2CBRG
0x216 I2C2CON reset 0x1000
  [0] SEN
0x218 I2C2STAT ro
  [0] TBF
0x21A I2C2ADD
  [9:0] I2CADD
0x21C I2C2MSK
  [9:0] AMSK
0x220 U1MODE
  [0] STSEL
0x222 U1STA reset 0x110
  [0] URXDA
0x224 U1TXREG wo reset not defined
  [8:0] U1TXREG
0x226 U1RXREG ro
  [8:0] U1RXREG
0x228 U1BRG (reset mask 0x1)
  [15:0] BRG
0x230 U2MODE
  [0] STSEL
0x232 U2STA reset 0x110
  [0] URXDA
0x234 U2TXREG wo reset not defined
  [8:0] U2TXREG
0x236 U2RXREG ro
  [8:0] U2RXREG
0x238 U2BRG (reset mask 0x1)
  [15:0] BRG
0x240 SPI1STAT
  [0] SPIRBF
0x242 SPI1CON1
  [1:0] PPRE
0x244 SPI1CON2
  [0] SPIBEN
0x248 SPI1BUF (reset mask 0x1)
0x250 U3MODE
  [0] STSEL
0x252 U3STA reset 0x110
  [0] URXDA
0x254 U3TXREG wo reset not defined
  [8:0] U3TXREG
0x256 U3RXREG ro
  [8:0] U3RXREG
0x258 U3BRG (reset mask 0x1)
  [15:0] BRG
0x260 SPI2STAT
  [0] SPIRBF
0x262 SPI2CON1
  [1:0] PPRE
0x264 SPI2CON2
  [0] SPIBEN
0x268 SPI2BUF (reset mask 0x1)
0x280 DCICON1
  [1:0] COFSM
0x282 DCICON2
  [3:0] WS
0x284 DCICON3
  [11:0] BCG
0x286 DCISTAT ro
  [0] TMPTY
0x288 TSCON
  [0] TSE0
0x28C RSCON
  [0] RSE0
{0x290+2i} RXBUF{i} ro reset not defined (i=0..3)
{0x298+2i} TXBUF{i} wo (reset mask 0x1) (i=0..3)
0x2A0 SPI3STAT
  [0] SPIRBF
0x2A2 SPI3CON1
  [1:0] PPRE
0x2A4 SPI3CON2
  [0] SPIBEN
0x2A8 SPI3BUF (reset mask 0x1)
0x2B0 U4MODE
  [0] STSEL
0x2B2 U4STA reset 0x110
  [0] URXDA
0x2B4 U4TXREG wo reset not defined
  [8:0] U4TXREG
0x2B6 U4RXREG ro
  [8:0] U4RXREG
0x2B8 U4BRG (reset mask 0x1)
  [15:0] BRG
{0x300+2i} ADC1BUF{i} ro reset not defined (i=0..9)
  [11:0] ADC1BUF{i}
0x314 ADC1BUFA ro reset not defined
  [11:0] ADC1BUFA
0x316 ADC1BUFB ro reset not defined
  [11:0] ADC1BUFB
0x318 ADC1BUFC ro reset not defined
  [11:0] ADC1BUFC
0x31A ADC1BUFD ro reset not defined
  [11:0] ADC1BUFD
0x31C ADC1BUFE ro reset not defined
  [11:0] ADC1BUFE
0x31E ADC1BUFF ro reset not defined
  [11:0] ADC1BUFF
0x320 AD1CON1
  [0] DONE
0x322 AD1CON2
  [0] ALTS
0x324 AD1CON3
  [7:0] ADCS
0x326 AD1CHS123
  [0] CH123SA0
0x328 AD1CHS0 (reset mask 0x8080)
  [5:0] CH0SA
0x32E AD1CSSH
  [0] CSS16
0x330 AD1CSSL
  [0] CSS0
0x332 AD1CON4
  [2:0] DMABL
0x33A CTMUCON1 (reset mask 0xBF00)
  [0] CTTRIG
0x33C CTMUCON2 (reset mask 0xC3C0)
  [3:0] EDG2SEL
0x33E CTMUICON (reset mask 0xFF00)
  [1:0] IRNG
{0x340+2i} ADC2BUF{i} ro reset not defined (i=0..9)
  [11:0] ADC2BUF{i}
0x354 ADC2BUFA ro reset not defined
  [11:0] ADC2BUFA
0x356 ADC2BUFB ro reset not defined
  [11:0] ADC2BUFB
0x358 ADC2BUFC ro reset not defined
  [11:0] ADC2BUFC
0x35A ADC2BUFD ro reset not defined
  [11:0] ADC2BUFD
0x35C ADC2BUFE ro reset not defined
  [11:0] ADC2BUFE
0x35E ADC2BUFF ro reset not defined
  [11:0] ADC2BUFF
0x360 AD2CON1
  [0] DONE
0x362 AD2CON2
  [0] ALTS
0x364 AD2CON3
  [7:0] ADCS
0x366 AD2CHS123
  [0] CH123SA0
0x368 AD2CHS0 (reset mask 0x8080)
  [5:0] CH0SA
0x36E AD2CSSH
  [0] CSS16
0x370 AD2CSSL
  [0] CSS0
0x372 AD2CON4
  [2:0] DMABL
0x400 C1CTRL1 reset 0x480
  [0] WIN
0x402 C1CTRL2 ro (reset mask 0x1)
  [4:0] DNCNT
0x404 C1VEC ro reset 0x4 (reset mask 0x4)
  [6:0] ICODE
0x406 C1FCTRL (reset mask 0x1)
  [4:0] FSA
0x408 C1FIFO ro (reset mask 0x1)
  [5:0] FNRB
0x40A C1INTF ro
  [0] TBIF
0x40C C1INTE
  [0] TBIE
0x40E C1EC (reset mask 0x1)
  [7:0] RERRCNT
0x410 C1CFG1 (reset mask 0x1)
  [5:0] BRP
0x412 C1CFG2
  [2:0] PRSEG
0x414 C1FEN1 reset not defined
  [0] FLTEN0
0x418 C1FMSKSEL1 (reset mask 0x1)
  [1:0] F0MSK
0x41A C1FMSKSEL2 (reset mask 0x1)
  [1:0] F8MSK
0x420 C1RXFUL1
  [0] RXFUL0
0x422 C1RXFUL2
  [0] RXFUL16
0x424 C1BUFPNT3 (reset mask 0x1)
  [3:0] F8BP
0x426 C1BUFPNT4 (reset mask 0x1)
  [3:0] F12BP
0x428 C1RXOVF1
  [0] RXOVF0
0x42A C1RXOVF2
  [0] RXOVF16
0x430 C1TR01CON (reset mask 0x1)
  [1:0] TX0PRI
0x432 C1TR23CON (reset mask 0x1)
  [1:0] TX2PRI
0x434 C1TR45CON (reset mask 0x1)
  [1:0] TX4PRI
0x436 C1TR67CON (reset mask 0x1)
  [1:0] TX6PRI
0x438 C1RXM2SID reset not defined
  [0] EID16
0x43A C1RXM2EID reset not defined
  [0] EID0
0x440 C1RXD reset not defined
0x442 C1TXD reset not defined
0x444 C1RXF1SID reset not defined
  [0] EID16
{0x442+4i} C1RXF{i}EID reset not defined (i=1..4)
  [0] EID0
0x448 C1RXF2SID reset not defined
  [0] EID16
{0x440+4i} C1RXF{i}SID reset not defined (i=4..15)
  [0] EID16
{0x442+4i} C1RXF{i}EID reset not defined (i=6..15)
  [0] EID0
0x500 C2CTRL1 reset 0x480
  [0] WIN
0x502 C2CTRL2 ro (reset mask 0x1)
  [4:0] DNCNT
0x504 C2VEC ro reset 0x4 (reset mask 0x4)
  [6:0] ICODE
0x506 C2FCTRL (reset mask 0x1)
  [4:0] FSA
0x508 C2FIFO ro (reset mask 0x1)
  [5:0] FNRB
0x50A C2INTF ro
  [0] TBIF
0x50C C2INTE
  [0] TBIE
0x50E C2EC (reset mask 0x1)
  [7:0] RERRCNT
0x510 C2CFG1 (reset mask 0x1)
  [5:0] BRP
0x512 C2CFG2
  [2:0] PRSEG
0x514 C2FEN1 reset not defined
  [0] FLTEN0
0x518 C2FMSKSEL1 (reset mask 0x1)
  [1:0] F0MSK
0x51A C2FMSKSEL2 (reset mask 0x1)
  [1:0] F8MSK
0x520 C2RXFUL1
  [0] RXFUL0
0x522 C2RXFUL2
  [0] RXFUL16
0x524 C2BUFPNT3 (reset mask 0x1)
  [3:0] F8BP
0x526 C2BUFPNT4 (reset mask 0x1)
  [3:0] F12BP
0x528 C2RXOVF1
  [0] RXOVF0
0x52A C2RXOVF2
  [0] RXOVF16
0x530 C2TR01CON (reset mask 0x1)
  [1:0] TX0PRI
0x532 C2TR23CON (reset mask 0x1)
  [1:0] TX2PRI
0x534 C2TR45CON (reset mask 0x1)
  [1:0] TX4PRI
0x536 C2TR67CON (reset mask 0x1)
  [1:0] TX6PRI
0x538 C2RXM2SID reset not defined
  [0] EID16
0x53A C2RXM2EID reset not defined
  [0] EID0
0x540 C2RXD reset not defined
0x542 C2TXD reset not defined
{0x540+4i} C2RXF{i}SID reset not defined (i=1..15)
  [0] EID16
{0x542+4i} C2RXF{i}EID reset not defined (i=1..15)
  [0] EID0
0x5C0 QEI2CON reset not defined
  [1:0] CCM
0x5C2 QEI2IOC reset not defined
  [0] QEA
0x5C4 QEI2STAT reset not defined
  [0] IDXIEN
0x5C6 POS2CNTL reset not defined
  [15:0] POSCNTL
0x5C8 POS2CNTH reset not defined
  [15:0] POSCNTH
0x5CA POS2HLD reset not defined
  [15:0] POSHLD
0x5CC VEL2CNT reset not defined
  [15:0] VELCNT
0x5CE INT2TMRL reset not defined
  [15:0] INTTMRL
0x5D0 INT2TMRH reset not defined
  [15:0] INTTMRH
0x5D2 INT2HLDL reset not defined
  [15:0] INTHLDL
0x5D4 INT2HLDH reset not defined
  [15:0] INTHLDH
0x5D6 INDX2CNTL reset not defined
  [15:0] INDXCNTL
0x5D8 INDX2CNTH reset not defined
  [15:0] INDXCNTH
0x5DA INDX2HLD reset not defined
  [15:0] INDXHLD
0x5DC QEI2GECL reset not defined
  [15:0] QEIGEC
0x5DE QEI2GECH reset not defined
  [15:0] QEIGEC
0x5E0 QEI2LECL reset not defined
  [15:0] QEILEC
0x5E2 QEI2LECH reset not defined
  [15:0] QEILEC
0x620 ALRMVAL (reset mask 0x1)
0x622 ALCFGRPT (reset mask 0x1)
  [7:0] ARPT
0x624 RTCVAL (reset mask 0x1)
0x626 RCFGCAL
  [7:0] CAL
0x640 CRCCON1 reset 0x40 (reset mask 0xBFD8)
  [0] LENDIAN
0x642 CRCCON2
  [4:0] PLEN
0x644 CRCXORL (reset mask 0xFFFE)
  [0] X1
0x646 CRCXORH
  [0] X16
0x648 CRCDATL reset not defined
0x64A CRCDATH reset not defined
0x64C CRCWDATL reset not defined
0x64E CRCWDATH reset not defined
0x680 RPOR0 reset not defined
  [5:0] RP20R
{0x680+2i} RPOR{i} reset not defined (i=1..4)
  [5:0] RP{2i+34}R
0x68A RPOR5 reset not defined
  [5:0] RP48R
0x68C RPOR6 reset not defined
  [5:0] RP54R
0x68E RPOR7 reset not defined
  [5:0] RP56R
0x690 RPOR8 reset not defined
  [5:0] RP69R
0x692 RPOR9 reset not defined
  [5:0] RP81R
0x694 RPOR10 reset not defined
  [5:0] RP113R
0x696 RPOR11 reset not defined
  [5:0] RP120R
0x698 RPOR12 reset not defined
  [5:0] RP126R
0x6A0 RPINR0 (reset mask 0x7F00)
  [6:0] INT1R
0x6A2 RPINR1
  [6:0] INT2R
0x6A6 RPINR3
  [6:0] T2CKR
{0x6A0+2i} RPINR{i} (i=7..10)
  [6:0] IC{2i-13}R
0x6B6 RPINR11
  [6:0] OCFAR
0x6B8 RPINR12
  [6:0] FLT1R
0x6BC RPINR14
  [6:0] QEA1R
0x6BE RPINR15
  [6:0] INDX1R
0x6C0 RPINR16
  [6:0] QEA2R
0x6C2 RPINR17
  [6:0] INDX2R
0x6C4 RPINR18
  [6:0] U1RXR
0x6C6 RPINR19
  [6:0] U2RXR
0x6CC RPINR22
  [6:0] SDI2R
0x6CE RPINR23
  [6:0] SS2R
0x6D0 RPINR24
  [6:0] CSDIR
0x6D2 RPINR25
  [6:0] COFSR
0x6D4 RPINR26
  [6:0] C1RXR
0x6D6 RPINR27
  [6:0] U3RXR
0x6D8 RPINR28
  [6:0] U4RXR
0x6DA RPINR29
  [6:0] SDI3R
0x6DC RPINR30
  [6:0] SS3R
0x6EA RPINR37 (reset mask 0x7F00)
  [6:0] SYNCI1R
0x6EC RPINR38 (reset mask 0x7F00)
  [6:0] DTCMP1R
{0x6A0+2i} RPINR{i} (i=39..41)
  [6:0] DTCMP{2i-76}R
0x728 NVMCON
  [3:0] NVMOP
0x72A NVMADR reset not defined
0x72C NVMADRU reset not defined
  [7:0] NVMADRU
0x72E NVMKEY wo
  [7:0] NVMKEY
0x730 NVMSRCADRL reset not defined
0x732 NVMSRCADRH reset not defined
  [7:0] NVMSRCADRH
0x740 RCON reset 0x3
  [0] POR
0x742 OSCCON
  [0] OSWEN
0x744 CLKDIV reset 0x3040
  [4:0] PLLPRE
0x746 PLLFBD reset 0x30
  [8:0] PLLDIV
0x748 OSCTUN
  [5:0] TUN
0x74E REFOCON (reset mask 0xBF00)
  [3:0] RODIV
0x760 PMD1
  [0] AD1MD
0x762 PMD2
  [0] OC1MD
0x764 PMD3 (reset mask 0x402)
  [0] ADC2MD
0x766 PMD4 (reset mask 0x8)
  [0] CTMUMD
0x76A PMD6 (reset mask 0x700)
  [0] SPI3MD
0x76C PMD7 reset not defined
  [0] PTGMD
0x800 IFS0
  [0] INT0IF
0x802 IFS1
  [0] SI2C1IF
0x804 IFS2
  [0] SPI2EIF
0x806 IFS3
  [0] T7IF
0x808 IFS4 (reset mask 0x2ACE)
  [0] U1EIF
0x80A IFS5 (reset mask 0xCF8E)
  [0] U3EIF
0x80C IFS6
  [0] PWM3IF
0x810 IFS8 (reset mask 0xC000)
  [0] ICDIF
0x812 IFS9 (reset mask 0x7E)
  [0] PTGSTEPIF
0x820 IEC0
  [0] INT0IE
0x822 IEC1
  [0] SI2C1IE
0x824 IEC2
  [0] SPI2EIE
0x826 IEC3
  [0] T7IE
0x828 IEC4 (reset mask 0x2ACE)
  [0] U1EIE
0x82A IEC5 (reset mask 0xCF8E)
  [0] U3EIE
0x82C IEC6
  [0] PWM3IE
0x830 IEC8 (reset mask 0xC000)
  [0] ICDIE
0x832 IEC9 (reset mask 0x7E)
  [0] PTGSTEPIE
0x840 IPC0 reset 0x4444
  [2:0] INT0IP
0x842 IPC1 reset 0x4444
  [2:0] DMA0IP
0x844 IPC2 reset 0x4444
  [2:0] T3IP
0x846 IPC3 reset 0x444
  [2:0] U1TXIP
0x848 IPC4 reset 0x4444
  [2:0] SI2C1IP
0x84A IPC5 reset 0x4444
  [2:0] INT1IP
0x84C IPC6 reset 0x4444
  [2:0] DMA2IP
0x84E IPC7 reset 0x4444
  [2:0] T5IP
0x850 IPC8 reset 0x4444
  [2:0] SPI2EIP
0x852 IPC9 reset 0x4444
  [2:0] DMA3IP
0x854 IPC10 reset 0x4444
  [2:0] IC6IP
0x856 IPC11 reset 0x4004
  [2:0] OC8IP
0x858 IPC12 reset 0x4444
  [2:0] T7IP
0x85A IPC13 reset 0x4444
  [2:0] T9IP
0x85C IPC14 reset 0x4444
  [2:0] C2IP
0x85E IPC15 reset 0x404
  [2:0] DCIIP
0x860 IPC16 reset 0x440 (reset mask 0x770)
  [2:0] U1EIP
0x862 IPC17 reset 0x4400 (reset mask 0x7700)
  [2:0] C1TXIP
0x864 IPC18 reset 0x4040 (reset mask 0x7070)
  [2:0] PCESIP
0x866 IPC19 reset 0x40 (reset mask 0x70)
  [2:0] CTMUIP
0x868 IPC20 reset 0x4440 (reset mask 0x7770)
  [2:0] U3EIP
0x86A IPC21 reset 0x4000 (reset mask 0x7000)
  [2:0] U4EIP
0x86C IPC22 reset 0x4444
  [2:0] U4RXIP
0x86E IPC23 reset 0x4400 (reset mask 0x7700)
  [2:0] PWM1IP
0x870 IPC24 reset 0x4444
  [2:0] PWM3IP
0x886 IPC35 reset 0x4400 (reset mask 0x7700)
  [2:0] ICDIP
0x888 IPC36 reset 0x4440 (reset mask 0x7770)
  [2:0] PTGSTEPIP
0x88A IPC37 reset 0x444
  [2:0] PTG1IP
0x8C0 INTCON1
  [0] OSCFAIL
0x8C2 INTCON2 reset 0x8000
  [0] INT0EP
0x8C4 INTCON3 (reset mask 0x30)
  [0] DOOVR
0x8C6 INTCON4 reset not defined
  [0] SGHT
0x8C8 INTTREG ro
  [7:0] VECNUM
{0x8F6+0xA*i} OC{i}CON1 (i=1..8)
  [2:0] OCM
{0x8F8+0xA*i} OC{i}CON2 reset 0xC (i=1..8)
  [4:0] SYNCSEL
{0x8FA+0xA*i} OC{i}RS reset not defined (i=1..8)
{0x8FC+0xA*i} OC{i}R reset not defined (i=1..8)
{0x8FE+0xA*i} OC{i}TMR ro reset not defined (i=1..8)
0xA80 CMSTAT
  [0] C1OUT
0xA82 CVR1CON
  [3:0] CVR
{0xA7C+8i} CM{i}CON (reset mask 0xE3D0) (i=1..5)
  [1:0] CCH
{0xA7E+8i} CM{i}MSKSRC reset not defined (i=1..5)
  [3:0] SELSRCA
{0xA80+8i} CM{i}MSKCON reset not defined (i=1..5)
  [0] AANEN
{0xA82+8i} CM{i}FLTR reset not defined (i=1..5)
  [2:0] CFDIV
0xAB4 CVR2CON reset not defined
  [3:0] CVR
0xAC0 PTGCST (reset mask 0xB400)
  [1:0] PTGITM
0xAC2 PTGCON
  [2:0] PTGWDT
0xAC4 PTGBTE reset not defined
0xAC6 PTGHOLD reset not defined
0xAC8 PTGT0LIM reset not defined
0xACA PTGT1LIM reset not defined
0xACC PTGSDLIM reset not defined
0xACE PTGC0LIM reset not defined
0xAD0 PTGC1LIM reset not defined
0xAD2 PTGADJ reset not defined
0xAD4 PTGL0 reset not defined
0xAD6 PTGQPTR reset not defined
  [4:0] PTGQPTR
{0xAD8+2i} PTGQUE{i} reset not defined (i=0..15)
  [7:0] STEP{2i}
{0xB00+0x10*i} DMA{i}CON (i=0..3)
  [1:0] MODE
{0xB02+0x10*i} DMA{i}REQ (reset mask 0x8000) (i=0..3)
  [7:0] IRQSEL
{0xB04+0x10*i} DMA{i}STAL (reset mask 0x1) (i=0..3)
  [15:0] STA
{0xB06+0x10*i} DMA{i}STAH reset not defined (i=0..3)
  [7:0] STA
{0xB08+0x10*i} DMA{i}STBL (reset mask 0x1) (i=0..3)
  [15:0] STB
{0xB0A+0x10*i} DMA{i}STBH reset not defined (i=0..3)
  [7:0] STB
{0xB0C+0x10*i} DMA{i}PAD (reset mask 0x1) (i=0..3)
  [15:0] PAD
{0xB0E+0x10*i} DMA{i}CNT (i=0..3)
  [13:0] CNT
0xBF0 DMAPWC reset not defined
  [0] PWCOL0
0xBF2 DMARQC reset not defined
  [0] RQCOL0
0xBF4 DMAPPS reset not defined
  [0] PPST0
0xBF6 DMALCA reset not defined
  [3:0] LSTCH
0xBF8 DSADRL ro (reset mask 0x1)
  [15:0] DSADR
0xBFA DSADRH ro
  [7:0] DSADR
0xC00 PTCON
  [3:0] SEVTPS
0xC02 PTCON2
  [2:0] PCLKDIV
0xC04 PTPER reset 0xFFFF
0xC06 SEVTCMP (reset mask 0x1)
0xC0A MDC (reset mask 0x1)
0xC0E STCON
  [3:0] SEVTPS
0xC10 STCON2
  [2:0] PCLKDIV
0xC12 STPER reset 0xFFFF
0xC14 SSEVTCMP (reset mask 0x1)
0xC1A CHOP
  [9:0] CHOPCLK
0xC1E PWMKEY reset not defined
{0xC00+0x20*i} PWMCON{i} (i=1..6)
  [0] IUE
{0xC02+0x20*i} IOCON{i} (i=1..6)
  [0] OSYNC
{0xC04+0x20*i} FCLCON{i} (reset mask 0x1) (i=1..6)
  [1:0] FLTMOD
{0xC06+0x20*i} PDC{i} (reset mask 0x1) (i=1..6)
{0xC08+0x20*i} PHASE{i} (reset mask 0x1) (i=1..6)
{0xC0A+0x20*i} DTR{i} (i=1..6)
  [13:0] DTR{i}
{0xC0C+0x20*i} ALTDTR{i} (i=1..6)
  [13:0] ALTDTR{i}
{0xC0E+0x20*i} SDC{i} (reset mask 0x1) (i=1..6)
{0xC10+0x20*i} SPHASE{i} (reset mask 0x1) (i=1..6)
{0xC12+0x20*i} TRIG{i} (reset mask 0x1) (i=1..6)
  [15:0] TRGCMP
{0xC14+0x20*i} TRGCON{i} (i=1..6)
  [5:0] TRGSTRT
{0xC18+0x20*i} PWMCAP{i} ro (reset mask 0x1) (i=1..6)
  [15:0] PWMCAP
{0xC1A+0x20*i} LEBCON{i} (i=1..6)
  [0] BPLL
{0xC1C+0x20*i} LEBDLY{i} (i=1..6)
  [11:0] LEB
{0xC1E+0x20*i} AUXCON{i} (i=1..6)
  [0] CHOPLEN
0xE00 TRISA reset 0x79F
  [0] TRISA0
0xE02 PORTA reset not defined
  [0] RA0
0xE04 LATA
  [0] LATA0
0xE06 ODCA
  [0] ODCA0
0xE08 CNENA
  [0] CNIEA0
0xE0A CNPUA
  [0] CNPUA0
0xE0C CNPDA
  [0] CNPDA0
0xE0E ANSELA reset 0x21F
  [0] ANSA0
0xE10 TRISB reset 0xFFFF
  [0] TRISB0
0xE12 PORTB reset not defined
  [0] RB0
0xE14 LATB
  [0] LATB0
0xE16 ODCB
  [0] ODCB0
0xE18 CNENB
  [0] CNIEB0
0xE1A CNPUB
  [0] CNPUB0
0xE1C CNPDB
  [0] CNPDB0
0xE1E ANSELB reset 0x38F
  [0] ANSB0
0xE20 TRISC reset 0x3FF
  [0] TRISC0
0xE22 PORTC reset not defined
  [0] RC0
0xE24 LATC
  [0] LATC0
0xE26 ODCC
  [0] ODCC0
0xE28 CNENC
  [0] CNIEC0
0xE2A CNPUC
  [0] CNPUC0
0xE2C CNPDC
  [0] CNPDC0
0xE2E ANSELC reset 0x3F
  [0] ANSC0
0xEFE PADCFG1 reset not defined
  [0] PMPTTL
0xF80 FEXL (reset mask 0x1)
0xF82 FEXU
  [7:0] FEXU
0xF88 VISI (reset mask 0x1)
0xF8A DPCL (reset mask 0x1)
0xF8C DPCU
  [7:0] DPCU
0xFA0 APPO reset not defined
0xFA2 APPIN reset not defined
0xFA4 APPS reset not defined
  [0] APIFUL
0xFA6 STROUTL reset not defined
0xFA8 STROUTH reset not defined
0xFAA STROVCNT reset not defined
0xFC6 DFTADD (reset mask 0x1)
0xFC8 DFTDATA (reset mask 0x1)
0xFCA DFTDATA_INC (reset mask 0x1)
0xFF0 JDATAH reset not defined
0xFF2 JDATAL reset not defined
