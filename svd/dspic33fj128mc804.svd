# dsPIC33FJ128MC804 register map
Vendor: Microchip; Series: dsPIC33FJ; File version: 1.0
Registers are 16-bit, read-write, reset 0x0 unless marked. A register's access mark holds for its fields unless they carry their own. Offsets are from the block's base; [hi:lo] are bit positions; {n}, {i} and the like mark numbered series.

## SFR — Special Function Register data space
Base 0x00000000
{0x0+2i} WREG{i} (reset mask 0x1) (i=0..4)
0x0A DAC1STAT
  [0] REMPTY
{0x0+2i} WREG{i} (reset mask 0x1) (i=6..14)
0x1E WREG15 reset not defined
0x20 SPLIM (reset mask 0x1)
0x22 ACCAL reset not defined
0x24 ACCAH reset not defined
0x26 ACCAU (reset mask 0xFF00)
  [7:0] ACCAU
0x28 ACCBL reset not defined
0x2A ACCBH reset not defined
0x2C ACCBU (reset mask 0xFF00)
  [7:0] ACCBU
0x2E PCL ro (reset mask 0x1)
0x30 PCH ro
  [6:0] PCH
0x32 TBLPAG
  [7:0] TBLPAG
0x34 PSVPAG
  [7:0] PSVPAG
0x36 RCOUNT reset not defined
  [13:0] RCOUNT
0x38 DCOUNT reset not defined
  [13:0] DCOUNT
0x3A DOSTARTL (reset mask 0x1)
0x3C DOSTARTH reset not defined
  [5:0] DOSTARTH
0x3E DOENDL (reset mask 0x1)
0x40 DOENDH reset not defined
  [5:0] DOENDH
0x42 SR
  [0] C
0x44 CORCON reset 0x20
  [0] IF
0x46 MODCON
  [3:0] XWM
0x48 XMODSRT (reset mask 0x1)
  [15:0] XS
0x4A XMODEND reset 0x1 (reset mask 0x1)
  [15:0] XE
0x4C YMODSRT (reset mask 0x1)
  [15:0] YS
0x4E YMODEND reset 0x1 (reset mask 0x1)
  [15:0] YE
0x50 XBREV reset not defined
  [14:0] XB
0x52 DISICNT reset not defined
  [13:0] DISICNT
0x60 CNEN1
  [0] CN0IE
0x62 CNEN2
  [0] CN16IE
0x68 CNPU1
  [0] CN0PUE
0x6A CNPU2
  [0] CN16PUE
0x80 INTCON1
  [0] OSCFAIL
0x82 INTCON2
  [0] INT0EP
0x84 IFS0
  [0] INT0IF
0x86 IFS1
  [0] SI2C1IF
0x88 IFS2
  [0] SPI2EIF
0x8A IFS3 (reset mask 0xE600)
  [0] PWM1IF
0x8C IFS4 (reset mask 0xCE7E)
  [0] U1EIF
0x94 IEC0
  [0] INT0IE
0x96 IEC1
  [0] SI2C1IE
0x98 IEC2
  [0] SPI2EIE
0x9A IEC3 (reset mask 0xE600)
  [0] PWM1IE
0x9C IEC4 (reset mask 0xCE7E)
  [0] U1EIE
0xA4 IPC0 reset 0x4444
  [2:0] INT0IP
0xA6 IPC1 reset 0x4444
  [2:0] DMA0IP
0xA8 IPC2 reset 0x4444
  [2:0] T3IP
0xAA IPC3 reset 0x444
  [2:0] U1TXIP
0xAC IPC4 reset 0x4444
  [2:0] SI2C1IP
0xAE IPC5 reset 0x4404
  [2:0] INT1IP
0xB0 IPC6 reset 0x4444
  [2:0] DMA2IP
0xB2 IPC7 reset 0x4444
  [2:0] T5IP
0xB4 IPC8 reset 0x4444
  [2:0] SPI2EIP
0xB6 IPC9 reset 0x4
  [2:0] DMA3IP
0xBA IPC11 reset 0x440 (reset mask 0x770)
  [2:0] PMPIP
0xC0 IPC14 reset 0x440 (reset mask 0x770)
  [2:0] PWM1IP
0xC2 IPC15 reset 0x4440 (reset mask 0x7770)
  [2:0] DMA5IP
0xC4 IPC16 reset 0x4440 (reset mask 0x7770)
  [2:0] U1EIP
0xC6 IPC17 reset 0x444
  [2:0] DMA6IP
0xC8 IPC18 reset 0x4440 (reset mask 0x7770)
  [2:0] PWM2IP
0xCA IPC19 reset 0x4400 (reset mask 0x7700)
  [2:0] DAC1RIP
0xE0 INTTREG ro
  [6:0] VECNUM
0x100 TMR1 reset not defined
0x102 PR1 reset 0xFFFF
0x104 T1CON (reset mask 0xA076)
  [0] TCS
0x106 TMR2 reset not defined
0x108 TMR3HLD reset not defined
0x10A TMR3 reset not defined
0x10C PR2 reset 0xFFFF
0x10E PR3 reset 0xFFFF
0x110 T2CON (reset mask 0xA07A)
  [0] TCS
0x112 T3CON (reset mask 0xA072)
  [0] TCS
0x114 TMR4 reset not defined
0x116 TMR5HLD reset not defined
0x118 TMR5 reset not defined
0x11A PR4 reset 0xFFFF
0x11C PR5 reset 0xFFFF
0x11E T4CON (reset mask 0xA07A)
  [0] TCS
0x120 T5CON (reset mask 0xA072)
  [0] TCS
0x140 IC1BUF ro reset not defined
0x142 IC1CON
  [2:0] ICM
0x144 IC2BUF ro reset not defined
0x146 IC2CON
  [2:0] ICM
0x158 IC7BUF ro reset not defined
0x15A IC7CON
  [2:0] ICM
0x15C IC8BUF ro reset not defined
0x15E IC8CON
  [2:0] ICM
{0x17A+6i} OC{i}RS reset not defined (i=1..4)
{0x17C+6i} OC{i}R reset not defined (i=1..4)
{0x17E+6i} OC{i}CON (i=1..4)
  [2:0] OCM
0x1C0 P1TCON
  [1:0] PTMOD
0x1C2 P1TMR (reset mask 0x1)
  [14:0] PTMR
0x1C4 P1TPER (reset mask 0x1)
  [14:0] PTPER
0x1C6 P1SECMP (reset mask 0x1)
  [14:0] SEVTCMP
0x1C8 PWM1CON1
  [0] PEN1L
0x1CA PWM1CON2
  [0] UDIS
0x1CC DTCON1 (reset mask 0x1)
  [5:0] DTA
0x1CE DTCON2
  [0] DTS1I
0x1D0 FLTACON
  [0] FAEN1
0x1D4 OVDCON reset 0x3F00
  [0] POUT1L
{0x1D4+2i} P1DC{i} (reset mask 0x1) (i=1..3)
  [15:0] PDC{i}
0x1E0 QEI1CON
  [0] UPDN_SRC
0x1E2 DFLT1CON (reset mask 0x7F0)
  [2:0] QECK
0x1E4 POS1CNT (reset mask 0x1)
0x1E6 MAX1CNT (reset mask 0x1)
0x1F0 QEI2CON
  [0] UPDN_SRC
0x1F2 DFLT2CON (reset mask 0x7F0)
  [2:0] QECK
0x1F4 POS2CNT (reset mask 0x1)
0x1F6 MAX2CNT (reset mask 0x1)
0x200 I2C1RCV ro
  [7:0] I2C1RCV
0x202 I2C1TRN wo reset 0xFF
  [7:0] I2C1TRN
0x204 I2C1BRG
  [8:0] I2C1BRG
0x206 I2C1CON reset 0x1000
  [0] SEN
0x208 I2C1STAT ro
  [0] TBF
0x20A I2C1ADD
  [9:0] I2C1ADD
0x20C I2C1MSK
  [9:0] AMSK
0x220 U1MODE
  [0] STSEL
0x222 U1STA reset 0x110
  [0] URXDA
0x224 U1TXREG wo
  [0] UTXREG0
0x226 U1RXREG ro
  [0] URXREG0
0x228 U1BRG (reset mask 0x1)
  [15:0] BRG
0x230 U2MODE
  [0] STSEL
0x232 U2STA reset 0x110
  [0] URXDA
0x234 U2TXREG wo
  [0] UTXREG0
0x236 U2RXREG ro
  [0] URXREG0
0x238 U2BRG (reset mask 0x1)
  [15:0] BRG
0x240 SPI1STAT
  [0] SPIRBF
0x242 SPI1CON1
  [1:0] PPRE
0x244 SPI1CON2 (reset mask 0xE002)
  [0] FRMDLY
0x248 SPI1BUF (reset mask 0x1)
0x260 SPI2STAT
  [0] SPIRBF
0x262 SPI2CON1
  [1:0] PPRE
0x264 SPI2CON2 (reset mask 0xE002)
  [0] FRMDLY
0x268 SPI2BUF (reset mask 0x1)
0x2C0 TRISA reset 0x79F
  [0] TRISA0
0x2C2 PORTA reset not defined
  [0] RA0
0x2C4 LATA
  [0] LATA0
0x2C6 ODCA
  [0] ODCA0
0x2C8 TRISB reset 0xFFFF
  [0] TRISB0
0x2CA PORTB reset not defined
  [0] RB0
0x2CC LATB
  [0] LATB0
0x2CE ODCB
  [0] ODCB0
0x2D0 TRISC reset 0x3FF
  [0] TRISC0
0x2D2 PORTC reset not defined
  [0] RC0
0x2D4 LATC
  [0] LATC0
0x2D6 ODCC
  [0] ODCC0
0x2FC PADCFG1
  [0] PMPTTL
0x300 ADC1BUF0 ro reset not defined
  [15:0] ADCBUF0
0x320 AD1CON1
  [0] DONE
0x322 AD1CON2
  [0] ALTS
0x324 AD1CON3
  [7:0] ADCS
0x326 AD1CHS123
  [0] CH123SA
0x328 AD1CHS0
  [4:0] CH0SA
0x32C AD1PCFGL
  [0] PCFG0
0x330 AD1CSSL
  [0] CSS0
0x332 AD1CON4
  [2:0] DMABL
{0x380+0xC*i} DMA{i}CON (i=0..7)
  [1:0] MODE
{0x382+0xC*i} DMA{i}REQ (i=0..7)
  [6:0] IRQSEL
{0x384+0xC*i} DMA{i}STA (reset mask 0x7FF) (i=0..7)
  [15:0] STA
{0x386+0xC*i} DMA{i}STB (reset mask 0x7FF) (i=0..7)
  [15:0] STB
{0x388+0xC*i} DMA{i}PAD (reset mask 0x7FF) (i=0..7)
  [15:0] PAD
{0x38A+0xC*i} DMA{i}CNT (reset mask 0x7FF) (i=0..7)
  [15:0] CNT
0x3E0 DMACS0 ro (reset mask 0x1)
  [7:0] XWCOL
0x3E2 DMACS1 ro reset 0xF00
  [0] PPST0
0x3E4 DSADR ro (reset mask 0x1)
0x3F0 DAC1CON
  [6:0] DACFDIV
0x3F4 DAC1DFLT (reset mask 0x1)
  [15:0] DACDFLT
0x3F6 DAC1RDAT (reset mask 0x1)
  [15:0] DACRDAT
0x3F8 DAC1LDAT (reset mask 0x1)
  [15:0] DACLDAT
0x400 C1CTRL1 reset 0x200 (reset mask 0x300)
  [0] WIN
0x402 C1CTRL2 ro (reset mask 0x1)
  [4:0] DNCNT
0x404 C1VEC ro reset 0x4 (reset mask 0x4)
  [6:0] ICODE
0x406 C1FCTRL (reset mask 0x1)
  [4:0] FSA
0x408 C1FIFO ro (reset mask 0x1)
  [5:0] FNRB
0x40A C1INTF ro
  [0] TBIF
0x40C C1INTE
  [0] TBIE
0x40E C1EC (reset mask 0x1)
  [7:0] RERRCNT
0x410 C1CFG1 (reset mask 0x1)
  [5:0] BRP
0x412 C1CFG2 (reset mask 0x1)
  [2:0] PRSEG
0x414 C1FEN1 (reset mask 0x1)
  [15:0] FLTEN
0x418 C1FMSKSEL1 (reset mask 0x1)
  [1:0] F0MSK
0x41A C1FMSKSEL2 (reset mask 0x1)
  [1:0] F8MSK
0x420 C1RXFUL1
  [0] RXFUL0
0x422 C1RXFUL2
  [0] RXFUL16
0x424 C1BUFPNT3 (reset mask 0x1)
  [3:0] F8BP
0x426 C1BUFPNT4 (reset mask 0x1)
  [3:0] F12BP
0x428 C1RXOVF1
  [0] RXOVF0
0x42A C1RXOVF2
  [0] RXOVF16
0x430 C1TR01CON (reset mask 0x1)
  [1:0] TX0PRI
0x432 C1TR23CON (reset mask 0x1)
  [1:0] TX2PRI
0x434 C1TR45CON (reset mask 0x1)
  [1:0] TX4PRI
0x436 C1TR67CON (reset mask 0x1)
  [1:0] TX6PRI
0x438 C1RXM2SID
  [0] EID16
0x43A C1RXM2EID
  [0] EID0
0x440 C1RXD reset not defined
0x442 C1TXD (reset mask 0xFFFE)
  [14:0] C1TXD
0x444 C1RXF1SID
  [1:0] EID
{0x442+4i} C1RXF{i}EID (reset mask 0x1) (i=1..4)
  [15:0] EID
0x448 C1RXF2SID
  [1:0] EID
{0x440+4i} C1RXF{i}SID (i=4..15)
  [1:0] EID
{0x442+4i} C1RXF{i}EID (reset mask 0x1) (i=6..15)
  [15:0] EID
0x5C0 P2TCON
  [1:0] PTMOD
0x5C2 P2TMR (reset mask 0x1)
  [14:0] PTMR
0x5C4 P2TPER (reset mask 0x1)
  [14:0] PTPER
0x5C6 P2SECMP (reset mask 0x1)
  [14:0] SEVTCMP
0x5C8 PWM2CON1
  [0] PEN1L
0x5CA PWM2CON2
  [0] UDIS
0x5CC P2DTCON1 (reset mask 0x1)
  [5:0] DTA
0x5CE P2DTCON2
  [0] DTS1I
0x5D0 P2FLTACON
  [0] FAEN1
0x5D4 P2OVDCON reset 0x300
  [0] POUT1L
0x5D6 P2DC1 (reset mask 0x1)
0x600 PMCON
  [0] RDSP
0x602 PMMODE (reset mask 0x1)
  [1:0] WAITE
0x604 PMADDR (reset mask 0x1)
  [13:0] ADDR
0x606 PMDOUT2 (reset mask 0x1)
  [15:0] DATA
0x608 PMDIN1 (reset mask 0x1)
  [15:0] DATA
0x60A PMDIN2 (reset mask 0x1)
  [15:0] PTEN
0x60C PMAEN
  [10:0] PTEN
0x60E PMSTAT
  [0] OB0E
0x620 ALRMVAL (reset mask 0x1)
0x622 ALCFGRPT (reset mask 0x1)
  [7:0] ARPT
0x624 RTCVAL (reset mask 0x1)
0x626 RCFGCAL
  [7:0] CAL
0x630 CMCON
  [0] C1POS
0x632 CVRCON
  [3:0] CVR
0x640 CRCCON reset 0x40
  [3:0] PLEN
0x642 CRCXOR (reset mask 0x1)
0x644 CRCDAT (reset mask 0x1)
0x646 CRCWDAT (reset mask 0x1)
0x680 RPINR0 reset 0x1F00 (reset mask 0x1F00)
  [4:0] INT1R
0x682 RPINR1 reset 0x1F
  [4:0] INT2R
0x686 RPINR3 reset 0x1F1F
  [4:0] T2CKR
0x688 RPINR4 reset 0x1F1F
  [4:0] T4CKR
0x68E RPINR7 reset 0x1F1F
  [4:0] IC1R
0x694 RPINR10 reset 0x1F1F
  [4:0] IC7R
0x696 RPINR11 reset 0x1F
  [4:0] OCFAR
0x698 RPINR12 reset 0x1F
  [4:0] FLTA1R
0x69A RPINR13 reset 0x1F
  [4:0] FLTA2R
0x69C RPINR14 reset 0x1F1F
  [4:0] QEA1R
0x69E RPINR15 reset 0x1F
  [4:0] INDX1R
0x6A0 RPINR16 reset 0x1F1F
  [4:0] QEA2R
0x6A2 RPINR17 reset 0x1F
  [4:0] INDX2R
0x6A4 RPINR18 reset 0x1F1F
  [4:0] U1RXR
0x6A6 RPINR19 reset 0x1F1F
  [4:0] U2RXR
0x6A8 RPINR20 reset 0x1F1F
  [4:0] SDI1R
0x6AA RPINR21 reset 0x1F
  [4:0] SS1R
0x6AC RPINR22 reset 0x1F1F
  [4:0] SDI2R
0x6AE RPINR23 reset 0x1F
  [4:0] SS2R
0x6B4 RPINR26 reset 0x1F
  [4:0] C1RXR
{0x6C0+2i} RPOR{i} (i=0..12)
  [4:0] RP{2i}R
0x740 RCON reset 0x3
  [0] POR
0x742 OSCCON
  [0] OSWEN
0x744 CLKDIV reset 0x3040
  [4:0] PLLPRE
0x746 PLLFBD
  [8:0] PLLDIV
0x748 OSCTUN
  [5:0] TUN
0x74A ACLKCON reset not defined
  [0] ASRCSEL
0x750 BSRAM
  [0] RL_BSR
0x752 SSRAM
  [0] RL_SSR
0x760 NVMCON
  [3:0] NVMOP
0x766 NVMKEY wo
  [7:0] NVMKEY
0x770 PMD1
  [0] AD1MD
0x772 PMD2
  [0] OC1MD
0x774 PMD3 (reset mask 0x7C0)
  [0] PWM2MD
