# dsPIC33FJ128MC804 register map
Vendor: Microchip; Series: dsPIC33FJ; File version: 1.0
Microchip dsPIC33FJ128MC804 dsPIC Digital Signal Controller
Registers are 16-bit, read-write, reset 0x0 unless marked. A register's access mark holds for its fields unless they carry their own. Offsets are from the block's base; lines under a group give offsets from that group; [hi:lo] are bit positions; {n}, {i} and the like mark numbered series; 'fields as' and 'values as' point back to an identical list; <NAME> marks a mode.

## Memory map
0x00000000 SFR size 0x776 — Special Function Register data space

## Interrupts
0 INT0Interrupt (SFR) — INT0 - External Interrupt 0
1 IC1Interrupt (SFR) — IC1 - Input Compare 1
2 OC1Interrupt (SFR) — OC1 - Output Compare 1
3 T1Interrupt (SFR) — T1 - Timer1
4 DMA0Interrupt (SFR) — DMA0 - DMA Channel 0
5 IC2Interrupt (SFR) — IC2 - Input Capture 2
6 OC2Interrupt (SFR) — OC2 - Output Compare 2
7 T2Interrupt (SFR) — T2 - Timer2
8 T3Interrupt (SFR) — T3 - Timer3
9 SPI1ErrInterrupt (SFR) — SPI1E - SPI1 Error
12 U1TXInterrupt (SFR) — U1TX - UART1 Transmitter
13 ADC1Interrupt (SFR) — ADC1 - A/D Converter 1
14 DMA1Interrupt (SFR) — DMA1 - DMA Channel 1
15 Interrupt15 (SFR) — Reserved
16 SI2C1Interrupt (SFR) — SI2C1 - I2C1 Slave Events
17 MI2C1Interrupt (SFR) — MI2C1 - I2C1 Master Events
18 CMPInterrupt (SFR) — CMP - Comparator Interrupt
19 CNInterrupt (SFR) — Change Notification Interrupt
20 INT1Interrupt (SFR) — INT1 - External Interrupt 1
21 Interrupt21 (SFR) — Reserved
22 IC7Interrupt (SFR) — IC7 - Input Capture 7
23 IC8Interrupt (SFR) — IC8 - Input Capture 8
24 DMA2Interrupt (SFR) — DMA2 - DMA Channel 2
25 OC3Interrupt (SFR) — OC3 - Output Compare 3
26 OC4Interrupt (SFR) — OC4 - Output Compare 4
27 T4Interrupt (SFR) — T4 - Timer4
28 T5Interrupt (SFR) — T5 - Timer5
29 INT2Interrupt (SFR) — INT2 - External Interrupt 2
30 U2RXInterrupt (SFR) — U2RX - UART2 Receiver
31 U2TXInterrupt (SFR) — U2TX - UART2 Transmitter
32 SPI2ErrInterrupt (SFR) — SPI2E - SPI2 Error
33 SPI2Interrupt (SFR) — SPI2 - SPI2 Transfer Done
34 C1RxRdyInterrupt (SFR) — C1RX-ECAN1 Receive Data Ready
35 C1Interrupt (SFR) — C1-ECAN1 Event
36 DMA3Interrupt (SFR) — DMA3 - DMA Channel 3
{n} Interrupt{n} (SFR) (n=37..44) — Reserved
45 PMPInterrupt (SFR) — PMP - Parallel Master Port
46 DMA4Interrupt (SFR) — DMA4 - DMA Channel 4
{n} Interrupt{n} (SFR) (n=47..56) — Reserved
57 MPWM1Interrupt (SFR) — MPWM1 - MPWM1 Period Match
58 QEI1Interrupt (SFR) — QEI1 - Positiono Counter Match
59 Interrupt59 (SFR) — Reserved
60 Interrupt60 (SFR) — Reserved
61 DMA5Interrupt (SFR) — DMA5 - DMA Channel 5
62 RTCCInterrupt (SFR) — RTCC - Real-Time Clock and Calendar
63 FLTA1Interrupt (SFR) — FLTA1 - MPWM1 Fault A
64 Interrupt64 (SFR) — Reserved
65 U1ErrInterrupt (SFR) — U1E - UART1 Error
66 U2ErrInterrupt (SFR) — U2E - UART2 Error
67 CRCInterrupt (SFR) — CRC - Cyclic Redunancy Check
68 DMA6Interrupt (SFR) — DMA6 - DMA Channel 6
69 DMA7Interrupt (SFR) — DMA7 - DMA Channel 7
70 C1TxReqInterrupt (SFR) — C1TX-ECAN1 Transmit Data Request
71 Interrupt71 (SFR) — Reserved
72 Interrupt72 (SFR) — Reserved
73 MPWM2Interrupt (SFR) — MPWM2 - MPWM2 Period Match
74 FLTA2Interrupt (SFR) — FLTA2 - MPWM2 Fault A
75 QEI2Interrupt (SFR) — QEI2 - Positiono Counter Match
76 Interrupt76 (SFR) — Reserved
77 Interrupt77 (SFR) — Reserved
78 DAC1RInterrupt (SFR) — DaC1-Right Data Request
79 DAC1LInterrupt (SFR) — DaC1-Left Data Request

## Licence text in the file
Derived from Microchip Device Family Pack data; see metadata.
