# dsPIC33EP128GM604 register map
Vendor: Microchip; Series: dsPIC33EP; File version: 1.0
Microchip dsPIC33EP128GM604 dsPIC Digital Signal Controller
Registers are 16-bit, read-write, reset 0x0 unless marked. A register's access mark holds for its fields unless they carry their own. Offsets are from the block's base; lines under a group give offsets from that group; [hi:lo] are bit positions; {n}, {i} and the like mark numbered series; 'fields as' and 'values as' point back to an identical list; <NAME> marks a mode.

## Memory map
0x00000000 SFR size 0xFF4 — Special Function Register data space

## Interrupts
0 INT0Interrupt (SFR) — External Interrupt 0
1 IC1Interrupt (SFR) — Input Compare 1
2 OC1Interrupt (SFR) — Output Compare 1
3 T1Interrupt (SFR) — Timer 1
4 DMA0Interrupt (SFR) — DMA Channel 0
5 IC2Interrupt (SFR) — Input Capture 2
6 OC2Interrupt (SFR) — Output Compare 2
7 T2Interrupt (SFR) — Timer 2
8 T3Interrupt (SFR) — Timer 3
9 SPI1ErrInterrupt (SFR) — SPI1 error
12 U1TXInterrupt (SFR) — UART1 Transmitter
13 AD1Interrupt (SFR) — ADC1 Convert Done
14 DMA1Interrupt (SFR) — DMA Channel 1
16 SI2C1Interrupt (SFR) — I2C1 Slave Events
17 MI2C1Interrupt (SFR) — I2C1 Master Events
18 CM1Interrupt (SFR) — Analog Comparator Combined Interrupt
19 CNInterrupt (SFR) — Change Notification Interrupt
20 INT1Interrupt (SFR) — External Interrupt 1
21 AD2Interrupt (SFR) — ADC2 Convert Done
22 IC7Interrupt (SFR) — Input Compare 7
23 IC8Interrupt (SFR) — Input Compare 8
24 DMA2Interrupt (SFR) — DMA Channel 2
25 OC3Interrupt (SFR) — Output Compare 3
26 OC4Interrupt (SFR) — Output Compare 4
27 T4Interrupt (SFR) — Timer 4
28 T5Interrupt (SFR) — Timer 5
29 INT2Interrupt (SFR) — External Interrupt 2
30 U2RXInterrupt (SFR) — UART2 Receiver
31 U2TXInterrupt (SFR) — UART2 Transmitter
32 SPI2ErrInterrupt (SFR) — SPI2 error
33 SPI2Interrupt (SFR) — SPI2 transfer done
34 C1RxRdyInterrupt (SFR) — ECAN1 Receive Data Ready
35 C1Interrupt (SFR) — ECAN1 Event
36 DMA3Interrupt (SFR) — DMA Channel 3
37 IC3Interrupt (SFR) — Input Capture 3
38 IC4Interrupt (SFR) — Input Capture 4
39 IC5Interrupt (SFR) — Input Capture 5
40 IC6Interrupt (SFR) — Input Capture 6
41 OC5Interrupt (SFR) — Output Compare 5
42 OC6Interrupt (SFR) — Output Compare 6
43 OC7Interrupt (SFR) — Output Compare 7
44 OC8Interrupt (SFR) — Output Compare 8
45 PMPInterrupt (SFR)
47 T6Interrupt (SFR) — Timer 6
48 T7Interrupt (SFR) — Timer 7
49 SI2C2Interrupt (SFR) — I2C2 Slave Events
50 MI2C2Interrupt (SFR) — I2C2 Master Events
51 T8Interrupt (SFR) — Timer 8
52 T9Interrupt (SFR) — Timer 9
53 INT3Interrupt (SFR) — External Interrupt 3
54 INT4Interrupt (SFR) — External Interrupt 4
55 C2RxRdyInterrupt (SFR) — ECAN2 Receive Data Ready
56 C2Interrupt (SFR) — ECAN2 Event
57 PWMSpEventMatchInterrupt (SFR) — PWM special event match
58 QEI1Interrupt (SFR) — QEI1 Position Counter Compare
59 DCIEInterrupt (SFR) — DCI Fault Interrupt
60 DCIInterrupt (SFR) — DCI Transfer Done
62 RTCCInterrupt (SFR)
65 U1ErrInterrupt (SFR) — UART1 Error
66 U2ErrInterrupt (SFR) — UART2 Error
67 CRCInterrupt (SFR) — CRC Generator Intrrupt
70 C1TxReqInterrupt (SFR) — ECAN1 Transmit Data Request
71 C2TxReqInterrupt (SFR) — ECAN2 Transmit Data Request
73 PWMSecSpEventMatchInterrupt (SFR) — PWM secondary special event match
75 QEI2Interrupt (SFR) — QEI2 Position Counter Compare
77 CTMUInterrupt (SFR)
81 U3ErrInterrupt (SFR) — UART3 Error
82 U3RXInterrupt (SFR) — UART3 Receiver
83 U3TXInterrupt (SFR) — UART3 Transmitter
87 U4ErrInterrupt (SFR) — UART4 Error
88 U4RXInterrupt (SFR) — UART4 Receiver
89 U4TXInterrupt (SFR) — UART4 Transmitter
90 SPI3ErrInterrupt (SFR) — SPI3 error
91 SPI3Interrupt (SFR) — SPI3 transfer done
94 PWM1Interrupt (SFR)
95 PWM2Interrupt (SFR)
96 PWM3Interrupt (SFR)
97 PWM4Interrupt (SFR)
98 PWM5Interrupt (SFR)
99 PWM6Interrupt (SFR)
142 ICDInterrupt (SFR) — ICD Application
143 JTAGInterrupt (SFR) — JTAG Programming
145 PTGSTEPInterrupt (SFR) — PTG Step
146 PTGWDTInterrupt (SFR) — PTG Watchdog Timeout
147 PTG0Interrupt (SFR) — PTG Interrupt 0
148 PTG1Interrupt (SFR) — PTG Interrupt 1
149 PTG2Interrupt (SFR) — PTG Interrupt 2
150 PTG3Interrupt (SFR) — PTG Interrupt 3

## Licence text in the file
Derived from Microchip Device Family Pack data; see metadata.
