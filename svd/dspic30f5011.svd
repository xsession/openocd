# dsPIC30F5011 register map
Vendor: Microchip; Series: dsPIC30F; File version: 1.0
Microchip dsPIC30F5011 dsPIC Digital Signal Controller
Registers are 16-bit, read-write, no defined reset value unless marked. A register's access mark holds for its fields unless they carry their own. Offsets are from the block's base; lines under a group give offsets from that group; [hi:lo] are bit positions; {n}, {i} and the like mark numbered series; 'fields as' and 'values as' point back to an identical list; <NAME> marks a mode.

## Memory map
0x00000000 SFR size 0x774 — Special Function Register data space

## Interrupts
0 INT0Interrupt (SFR) — INT0 - External Interrupt 0
1 IC1Interrupt (SFR) — IC1 - Input Capture 1
2 OC1Interrupt (SFR) — OC1 - Output Compare 1
3 T1Interrupt (SFR) — T1 - Timer1
4 IC2Interrupt (SFR) — IC2 - Input Capture 2
5 OC2Interrupt (SFR) — OC2 - Output Compare 2
6 T2Interrupt (SFR) — T2 - Timer2
7 T3Interrupt (SFR) — T3 - Timer3
8 SPI1Interrupt (SFR) — SPI1 - SPI1 Transfer Done
9 U1RXInterrupt (SFR) — U1RX - UART1 Receiver
12 NVMInterrupt (SFR) — NVM Write Complete Interrupt
13 SI2CInterrupt (SFR) — SI2C1 - I2C1 Slave Events
14 MI2CInterrupt (SFR) — MI2C1 - I2C1 Master Events
15 CNInterrupt (SFR) — CN - Change Notification Interrupt
16 INT1Interrupt (SFR) — INT1 - External Interrupt 1
17 IC7Interrupt (SFR) — IC7 - Input Capture 7
18 IC8Interrupt (SFR) — IC8 - Input Capture 8
19 OC3Interrupt (SFR) — OC3 - Output Compare 3
20 OC4Interrupt (SFR) — OC4 - Output Compare 4
21 T4Interrupt (SFR) — T4 - Timer4
22 T5Interrupt (SFR) — T5 - Timer5
23 INT2Interrupt (SFR) — INT2 - External Interrupt 2
24 U2RXInterrupt (SFR) — U2RX - UART2 Receiver
25 U2TXInterrupt (SFR) — U2TX - UART2 Transmitter
26 SPI2Interrupt (SFR) — SPI2 - SPI2 Transfer Done
27 C1Interrupt (SFR) — C1 - ECAN1 Event
28 IC3Interrupt (SFR) — IC3 - Input Capture 3
29 IC4Interrupt (SFR) — IC4 - Input Capture 4
30 IC5Interrupt (SFR) — IC5 - Input Capture 5
31 IC6Interrupt (SFR) — IC5 - Input Capture 6
32 OC5Interrupt (SFR) — OC5 - Output Compare 5
33 OC6Interrupt (SFR) — OC6 - Output Compare 6
34 OC7Interrupt (SFR) — OC7 - Output Compare 7
35 OC8Interrupt (SFR) — OC8 - Output Compare 8
36 INT3Interrupt (SFR) — INT3 - External Interrupt 3
37 INT4Interrupt (SFR) — INT4 - External Interrupt 4
38 C2Interrupt (SFR) — C2 - ECAN2 Event
39 PWMInterrupt (SFR) — PWM - PWM Period Match
40 QEIInterrupt (SFR) — QEI - Position Counter Compare
41 DCIInterrupt (SFR)
42 LVDInterrupt (SFR)
43 FLTAInterrupt (SFR) — FLTA - MCPWM Fault A
44 FLTBInterrupt (SFR) — FLTB - MCPWM Fault B

## Licence text in the file
Derived from Microchip Device Family Pack data; see metadata.
