# dsPIC30F5011 register map
Vendor: Microchip; Series: dsPIC30F; File version: 1.0
Registers are 16-bit, read-write, no defined reset value unless marked. A register's access mark holds for its fields unless they carry their own. Offsets are from the block's base; [hi:lo] are bit positions; {n}, {i} and the like mark numbered series.

## SFR — Special Function Register data space
Base 0x00000000
{0x0+2i} WREG{i} reset 0x0 (reset mask 0x1) (i=0..4)
0x0A C2RXM0EIDH
  [0] EID6
{0x0+2i} WREG{i} reset 0x0 (reset mask 0x1) (i=6..14)
0x1E WREG15
0x20 SPLIM reset 0x0 (reset mask 0x1)
0x22 ACCAL
0x24 ACCAH
0x26 ACCAU reset 0x0 (reset mask 0xFF00)
  [7:0] ACCAU
0x28 ACCBL
0x2A ACCBH
0x2C ACCBU reset 0x0 (reset mask 0xFF00)
  [7:0] ACCBU
0x2E PCL ro reset 0x0 (reset mask 0x1)
0x30 PCH ro reset 0x0
  [6:0] PCH
0x32 TBLPAG reset 0x0
  [7:0] TBLPAG
0x34 PSVPAG reset 0x0
  [7:0] PSVPAG
0x36 RCOUNT
  [13:0] RCOUNT
0x38 DCOUNT
  [13:0] DCOUNT
0x3A DOSTARTL reset 0x0 (reset mask 0x1)
0x3C DOSTARTH
  [6:0] DOSTARTH
0x3E DOENDL reset 0x0 (reset mask 0x1)
0x40 DOENDH
  [6:0] DOENDH
0x42 SR reset 0x0
  [0] C
0x44 CORCON reset 0x20
  [0] IF
0x46 MODCON reset 0x0
  [3:0] XWM
0x48 XMODSRT reset 0x0 (reset mask 0x1)
  [15:0] XS
0x4A XMODEND reset 0x1 (reset mask 0x1)
  [15:0] XE
0x4C YMODSRT reset 0x0 (reset mask 0x1)
  [15:0] YS
0x4E YMODEND reset 0x1 (reset mask 0x1)
  [15:0] YE
0x50 XBREV
  [14:0] XB
0x52 DISICNT reset 0x0
  [13:0] DISICNT
0x80 INTCON1 reset 0x0 (reset mask 0x871E)
  [0] OSCFAIL
0x82 INTCON2 reset 0x0
  [0] INT0EP
0x84 IFS0 reset 0x0
  [0] INT0IF
0x86 IFS1 reset 0x0
  [0] INT1IF
0x88 IFS2 reset 0x0
  [0] OC5IF
0x8C IEC0 reset 0x0
  [0] INT0IE
0x8E IEC1 reset 0x0
  [0] INT1IE
0x90 IEC2 reset 0x0
  [0] OC5IE
0x94 IPC0 reset 0x4444
  [2:0] INT0IP
0x96 IPC1 reset 0x4444
  [2:0] IC2IP
0x98 IPC2 reset 0x4444
  [2:0] SPI1IP
0x9A IPC3 reset 0x4444
  [2:0] NVMIP
0x9C IPC4 reset 0x4444
  [2:0] INT1IP
0x9E IPC5 reset 0x4444
  [2:0] OC4IP
0xA0 IPC6 reset 0x4444
  [2:0] U2RXIP
0xA2 IPC7 reset 0x4444
  [2:0] IC3IP
0xA4 IPC8 reset 0x4444
  [2:0] OC5IP
0xA6 IPC9 reset 0x444
  [2:0] INT3IP
0xA8 IPC10 reset 0x440 (reset mask 0x770)
  [2:0] DCIIP
0xB0 INTTREG reset 0x0
  [5:0] VECNUM
0xC0 CNEN1 reset 0x0
  [0] CN0IE
0xC2 CNEN2 reset 0x0
  [0] CN16IE
0xC4 CNPU1 reset 0x0
  [0] CN0PUE
0xC6 CNPU2 reset 0x0
  [0] CN16PUE
0x100 TMR1
0x102 PR1 reset 0xFFFF
0x104 T1CON reset 0x0 (reset mask 0xA076)
  [0] TCS
0x106 TMR2
0x108 TMR3HLD
0x10A TMR3
0x10C PR2 reset 0xFFFF
0x10E PR3 reset 0xFFFF
0x110 T2CON reset 0x0 (reset mask 0xA07A)
  [0] TCS
0x112 T3CON reset 0x0 (reset mask 0xA072)
  [0] TCS
0x114 TMR4
0x116 TMR5HLD
0x118 TMR5
0x11A PR4 reset 0xFFFF
0x11C PR5 reset 0xFFFF
0x11E T4CON reset 0x0
  [0] TCS
0x120 T5CON reset 0x0
  [0] TCS
{0x13C+4i} IC{i}BUF ro (i=1..8)
{0x13E+4i} IC{i}CON reset 0x0 (i=1..8)
  [2:0] ICM
{0x17A+6i} OC{i}RS reset 0x0 (reset mask 0x1) (i=1..8)
{0x17C+6i} OC{i}R reset 0x0 (reset mask 0x1) (i=1..8)
{0x17E+6i} OC{i}CON reset 0x0 (i=1..8)
  [2:0] OCM
0x200 I2CRCV ro reset 0x0
  [7:0] I2CRCV
0x202 I2CTRN wo reset 0x0
  [7:0] I2CTRN
0x204 I2CBRG reset 0x0
  [8:0] I2CBRG
0x206 I2CCON reset 0x1000
  [0] SEN
0x208 I2CSTAT ro reset 0x0
  [0] TBF
0x20A I2CADD reset 0x0
  [9:0] I2CADD
0x20C U1MODE reset 0x0
  [0] STSEL
0x20E U1STA reset 0x110
  [0] URXDA
0x210 U1TXREG
  [8:0] U1TXREG
0x212 U1RXREG ro reset 0x0
  [8:0] U1RXREG
0x214 U1BRG reset 0x0 (reset mask 0x1)
  [15:0] BRG
0x216 U2MODE reset 0x0
  [0] STSEL
0x218 U2STA reset 0x110
  [0] URXDA
0x21A U2TXREG
  [8:0] U2TXREG
0x21C U2RXREG ro reset 0x0
  [8:0] U2RXREG
0x21E U2BRG reset 0x0 (reset mask 0x1)
  [15:0] BRG
0x220 SPI1STAT reset 0x0
  [0] SPIRBF
0x222 SPI1CON reset 0x0
  [0] PPRE0
0x224 SPI1BUF reset 0x0 (reset mask 0x1)
0x226 SPI2STAT reset 0x0
  [0] SPIRBF
0x228 SPI2CON reset 0x0
  [0] PPRE0
0x22A SPI2BUF reset 0x0 (reset mask 0x1)
0x240 DCICON1 reset 0x0
  [1:0] COFSM
0x242 DCICON2 reset 0x0
  [3:0] WS
0x244 DCICON3 reset 0x0
  [11:0] BCG
0x246 DCISTAT ro reset 0x0
  [0] TMPTY
0x248 TSCON reset 0x0
  [0] TSE0
0x24C RSCON reset 0x0
  [0] RSE0
{0x250+2i} RXBUF{i} ro (i=0..3)
{0x258+2i} TXBUF{i} wo reset 0x0 (reset mask 0x1) (i=0..3)
{0x280+2i} ADCBUF{i} ro (i=0..9)
0x294 ADCBUFA ro
0x296 ADCBUFB ro
0x298 ADCBUFC ro
0x29A ADCBUFD ro
0x29C ADCBUFE ro
0x29E ADCBUFF ro
0x2A0 ADCON1 reset 0x0
  [0] DONE
0x2A2 ADCON2 reset 0x0
  [0] ALTS
0x2A4 ADCON3 reset 0x0
  [5:0] ADCS
0x2A6 ADCHS reset 0x0
  [3:0] CH0SA
0x2A8 ADPCFG reset 0x0 (reset mask 0x1)
  [15:0] PCFG
0x2AA ADCSSL reset 0x0 (reset mask 0x1)
  [15:0] CSSL
0x2C6 TRISB reset 0xFFFF
  [0] TRISB0
0x2C8 PORTB
  [0] RB0
0x2CA LATB reset 0x0
  [0] LATB0
0x2CC TRISC reset 0xE006 (reset mask 0xE006)
  [0] TRISC1
0x2CE PORTC
  [0] RC1
0x2D0 LATC reset 0x0 (reset mask 0xE006)
  [0] LATC1
0x2D2 TRISD reset 0xFFF
  [0] TRISD0
0x2D4 PORTD
  [0] RD0
0x2D6 LATD reset 0x0
  [0] LATD0
0x2DE TRISF reset 0x7F
  [0] TRISF0
0x2E0 PORTF
  [0] RF0
0x2E2 LATF reset 0x0
  [0] LATF0
0x2E4 TRISG reset 0xF3CF
  [0] TRISG0
0x2E6 PORTG
  [0] RG0
0x2E8 LATG reset 0x0
  [0] LATG0
{0x300+8i} C1RXF{i}SID (i=0..5)
  [0] EXIDE
{0x302+8i} C1RXF{i}EIDH (i=0..5)
  [0] EID6
{0x304+8i} C1RXF{i}EIDL (i=0..5)
  [0] EID0
0x330 C1RXM0SID
  [0] MIDE
0x332 C1RXM0EIDH
  [0] EID6
0x334 C1RXM0EIDL
  [0] EID0
0x338 C1RXM1SID
  [0] MIDE
0x33A C1RXM1EIDH
  [0] EID6
0x33C C1RXM1EIDL
  [0] EID0
0x340 C1TX2SID
  [0] TXIDE
0x342 C1TX2EID
  [0] EID6
0x344 C1TX2DLC
  [3:0] DLC
{0x344+2i} C1TX2B{i} (i=1..4)
  [7:0] TXB2D{2i-2}
0x34E C1TX2CON reset 0x0
  [1:0] TXPRI
0x350 C1TX1SID
  [0] TXIDE
0x352 C1TX1EID
  [0] EID6
0x354 C1TX1DLC
  [3:0] DLC
{0x354+2i} C1TX1B{i} (i=1..4)
  [7:0] TXB1D{2i-2}
0x35E C1TX1CON reset 0x0
  [1:0] TXPRI
0x360 C1TX0SID
  [0] TXIDE
0x362 C1TX0EID
  [0] EID6
0x364 C1TX0DLC
  [3:0] DLC
{0x364+2i} C1TX0B{i} (i=1..4)
  [7:0] TXB0D{2i-2}
0x36E C1TX0CON reset 0x0
  [1:0] TXPRI
0x370 C1RX1SID
  [0] RXIDE
0x372 C1RX1EID
  [0] EID6
0x374 C1RX1DLC
  [3:0] DLC
{0x374+2i} C1RX1B{i} (i=1..4)
  [7:0] TXB1D{2i-2}
0x37E C1RX1CON ro reset 0x0
  [2:0] FILHIT
0x380 C1RX0SID
  [0] RXIDE
0x382 C1RX0EID
  [0] EID6
0x384 C1RX0DLC
  [3:0] DLC
{0x384+2i} C1RX0B{i} (i=1..4)
  [7:0] TXB0D{2i-2}
0x38E C1RX0CON reset 0x0
  [0] FILHIT0
0x390 C1CTRL reset 0x480 (reset mask 0xFFEE)
  [2:0] ICODE
0x392 C1CFG1 reset 0x0
  [5:0] BRP
0x394 C1CFG2
  [2:0] PRSEG
0x396 C1INTF reset 0x0
  [0] RXB0IF
0x398 C1INTE reset 0x0
  [0] RXB0IE
0x39A C1EC ro reset 0x0 (reset mask 0x1)
  [7:0] REC
{0x3C0+8i} C2RXF{i}SID (i=0..4)
  [0] EXIDE
{0x3C2+8i} C2RXF{i}EIDH (i=0..5)
  [0] EID6
{0x3C4+8i} C2RXF{i}EIDL (i=0..5)
  [0] EID0
0x3F0 C2RXM0SID
  [0] MIDE
0x3F4 C2RXM0EIDL
  [0] EID0
0x3F8 C2RXM1SID
  [0] MIDE
0x3FA C2RXM1EIDH
  [0] EID6
0x3FC C2RXM1EIDL
  [0] EID0
0x400 C2TX2SID
  [0] TXIDE
0x402 C2TX2EID
  [0] EID6
0x404 C2TX2DLC
  [3:0] DLC
{0x404+2i} C2TX2B{i} (i=1..4)
  [7:0] TXB2D{2i-2}
0x40E C2TX2CON reset 0x0
  [1:0] TXPRI
0x410 C2TX1SID
  [0] TXIDE
0x412 C2TX1EID
  [0] EID6
0x414 C2TX1DLC
  [3:0] DLC
{0x414+2i} C2TX1B{i} (i=1..4)
  [7:0] TXB1D{2i-2}
0x41E C2TX1CON reset 0x0
  [1:0] TXPRI
0x420 C2TX0SID
  [0] TXIDE
0x422 C2TX0EID
  [0] EID6
0x424 C2TX0DLC
  [3:0] DLC
{0x424+2i} C2TX0B{i} (i=1..4)
  [7:0] TXB0D{2i-2}
0x42E C2TX0CON reset 0x0
  [1:0] TXPRI
0x430 C2RX1SID
  [0] RXIDE
0x432 C2RX1EID
  [0] EID6
0x434 C2RX1DLC
  [3:0] DLC
{0x434+2i} C2RX1B{i} (i=1..4)
  [7:0] TXB1D{2i-2}
0x43E C2RX1CON ro reset 0x0
  [2:0] FILHIT
0x440 C2RX0SID
  [0] RXIDE
0x442 C2RX0EID
  [0] EID6
0x444 C2RX0DLC
  [3:0] DLC
{0x444+2i} C2RX0B{i} (i=1..3)
  [7:0] TXB0D{2i-2}
0x44E C2RX0CON reset 0x0
  [0] FILHIT0
0x450 C2CTRL reset 0x480 (reset mask 0xFFEE)
  [2:0] ICODE
0x452 C2CFG1 reset 0x0
  [5:0] BRP
0x454 C2CFG2
  [2:0] PRSEG
0x458 C2INTE reset 0x0
  [0] RXB0IE
0x45A C2EC ro reset 0x0 (reset mask 0x1)
  [7:0] REC
0x740 RCON reset 0x210 (reset mask 0x354)
  [0] POR
0x742 OSCCON reset 0x0
  [0] OSWEN
0x750 BSRAM reset 0x0
  [0] RL_BSR
0x752 SSRAM reset 0x0
  [0] RL_SSR
0x760 NVMCON reset 0x0
  [6:0] PROGOP
0x762 NVMADR
0x764 NVMADRU
  [7:0] NVMADR
0x766 NVMKEY wo reset 0x0
  [7:0] KEY
0x770 PMD1 reset 0x0
  [0] ADCMD
0x772 PMD2 reset 0x0
  [0] OC1MD
