## prj.conf
```kconfig
CONFIG_LOG=y
CONFIG_LOG_MODE_IMMEDIATE=y
CONFIG_CONSOLE=y
CONFIG_UART_CONSOLE=y
CONFIG_MAIN_STACK_SIZE=4096
CONFIG_HEAP_MEM_POOL_SIZE=16384
CONFIG_USB_DEVICE_STACK=y
CONFIG_USB_DEVICE_INITIALIZE_AT_BOOT=n
CONFIG_USB_DEVICE_PRODUCT="Open Microchip Tools RI4 Probe"
CONFIG_USB_DEVICE_MANUFACTURER="open_microchip_tools"
CONFIG_USB_DEVICE_VID=0x1209
CONFIG_USB_DEVICE_PID=0x0004
CONFIG_REBOOT=y
```

## boards/native_sim.conf
```kconfig
CONFIG_USB_DEVICE_STACK=n
```

## boards/nrf52840dk_nrf52840.conf
```kconfig
CONFIG_USB_DEVICE_STACK=y
CONFIG_SERIAL=n
CONFIG_CONSOLE=y
CONFIG_UART_CONSOLE=n
CONFIG_LOG=y
```

## src/main.c
```c
#include <zephyr/kernel.h>
#include <zephyr/logging/log.h>

#include "device_state.h"
#include "pk4_recovered_project.h"
#include "ri4_family_catalog.h"
#include "ri4_protocol.h"
#include "usb_transport.h"

LOG_MODULE_REGISTER(ri4_probe, LOG_LEVEL_INF);

static struct device_state g_state;
static struct pk4_recovered_project g_project;

static void log_catalog_summary(void)
{
    uint32_t preview = ri4_family_catalog_count < 3U ? ri4_family_catalog_count : 3U;
    uint32_t i;

    LOG_INF("RI4 catalog families: %u", (unsigned int)ri4_family_catalog_count);
    for (i = 0U; i < preview; ++i) {
        LOG_INF("Family[%u]: %s (%s)", (unsigned int)i, ri4_family_catalog[i].family, ri4_family_catalog[i].behavior);
    }
}

static void log_profile_summary(const struct device_state *state)
{
    const struct device_state_profile *profile = device_state_get_profile(state);

    LOG_INF("Observed probe profile: %s family=%s", profile->name, profile->family);
    LOG_INF("Observed boot/app/app2 base: 0x%08X / 0x%08X / 0x%08X", profile->boot_base, profile->app_base, profile->app2_base);
    LOG_INF("Observed reset vector=0x%08X SP=0x%08X boot-window=[0x%08X,+0x%X] app-window=[0x%08X,+0x%X] app2-window=[0x%08X,+0x%X]",
        profile->reset_vector,
        profile->initial_sp,
        profile->boot_base,
        profile->boot_window_size,
        profile->app_base,
        profile->app_window_size,
        profile->app2_base,
        profile->app2_window_size);
    LOG_INF("Observed app2 reset=0x%08X SP=0x%08X role=%s identity=%s",
        profile->app2_reset_vector,
        profile->app2_initial_sp,
        profile->secondary_role,
        profile->secondary_identity);
}

static void log_recovered_project_summary(const struct pk4_recovered_project *project)
{
    LOG_INF("Recovered project: %s family=%s", project->name, project->target_family);
    LOG_INF("Recovered slot %s base=0x%08X size=0x%X role=%s identity=%s",
        project->boot.name,
        project->boot.base,
        project->boot.window_size,
        project->boot.role,
        project->boot.identity);
    LOG_INF("Recovered slot %s base=0x%08X rv=0x%08X sp=0x%08X role=%s identity=%s",
        project->primary_app.name,
        project->primary_app.base,
        project->primary_app.reset_vector,
        project->primary_app.initial_sp,
        project->primary_app.role,
        project->primary_app.identity);
    LOG_INF("Recovered slot %s base=0x%08X rv=0x%08X sp=0x%08X role=%s identity=%s",
        project->secondary_app.name,
        project->secondary_app.base,
        project->secondary_app.reset_vector,
        project->secondary_app.initial_sp,
        project->secondary_app.role,
        project->secondary_app.identity);
}

void main(void)
{
    int rc;

    device_state_init(&g_state);
    pk4_recovered_project_init(&g_project, &g_state);
    log_catalog_summary();
    log_profile_summary(&g_state);
    log_recovered_project_summary(&g_project);

    LOG_INF("Zephyr RI4 probe scaffold started");
    LOG_INF("Expected endpoints side-out=0x%02X side-in=0x%02X data-out=0x%02X data-in=0x%02X stream-in=0x%02X",
        RI4_SIDE_EP_OUT,
        RI4_SIDE_EP_IN,
        RI4_DATA_EP_OUT,
        RI4_DATA_EP_IN,
        RI4_STREAM_EP_IN);

    rc = ri4_usb_transport_init(&g_state);
    if (rc == -ENOTSUP) {
        LOG_WRN("USB transport not enabled for this board/configuration");
    } else if (rc != 0) {
        LOG_ERR("USB transport init failed: %d", rc);
    }

    while (1) {
        k_sleep(K_SECONDS(1));
    }
}
```

## src/device_state.c
```c
#include "device_state.h"

#include <errno.h>
#include <stdio.h>
#include <string.h>

#include "pk4_observed_firmware_profile.h"

static const struct device_state_profile g_pk4_profile = {
    .name = "PK4_OBSERVED_DUAL_APP_LAYOUT",
    .family = "ARM_MPU",
    .secondary_role = "CMSIS-DAP control/update slot",
    .secondary_identity = PK4_OBS_APP2_IDENTITY,
    .boot_base = PK4_OBS_BOOT_BASE,
    .app_base = PK4_OBS_APP_BASE,
    .app2_base = PK4_OBS_APP2_BASE,
    .initial_sp = PK4_OBS_APP_INITIAL_SP,
    .reset_vector = PK4_OBS_APP_RESET_VECTOR,
    .app2_initial_sp = PK4_OBS_APP2_INITIAL_SP,
    .app2_reset_vector = PK4_OBS_APP2_RESET_VECTOR,
    .boot_window_size = DEVICE_STATE_BOOT_WINDOW_SIZE,
    .app_window_size = DEVICE_STATE_APP_WINDOW_SIZE,
    .app2_window_size = DEVICE_STATE_APP2_WINDOW_SIZE,
};

struct flash_region_view {
    uint8_t *data;
    uint32_t base;
    uint32_t size;
    const char *name;
};

static const char *region_role(const struct device_state *state, const char *region_name)
{
    (void)state;

    if (strcmp(region_name, "boot") == 0) {
        return "boot strap slot";
    }
    if (strcmp(region_name, "app") == 0) {
        return "RI4 host-facing app slot";
    }
    if (strcmp(region_name, "app2") == 0) {
        return g_pk4_profile.secondary_role;
    }
    return "unknown";
}

static const char *slot_name_for_pc(const struct device_state *state)
{
    if (state->pc >= state->profile->boot_base && state->pc < (state->profile->boot_base + state->profile->boot_window_size)) {
        return "boot";
    }
    if (state->pc >= state->profile->app_base && state->pc < (state->profile->app_base + state->profile->app_window_size)) {
        return "app";
    }
    if (state->pc >= state->profile->app2_base && state->pc < (state->profile->app2_base + state->profile->app2_window_size)) {
        return "app2";
    }
    return "external";
}

static void set_last_program_region(struct device_state *state, const char *region_name)
{
    snprintf(state->last_program_region, sizeof(state->last_program_region), "%s", region_name);
    snprintf(state->last_program_role, sizeof(state->last_program_role), "%s", region_role(state, region_name));
}

static int translate_flash_address(
    const struct device_state *state,
    uint32_t address,
    size_t size,
    struct flash_region_view *region,
    size_t *offset
)
{
    uint32_t normalized;
    uint32_t region_size;
    uint32_t region_base;

    if (address >= state->profile->boot_base && address < (state->profile->boot_base + state->profile->boot_window_size)) {
        region->data = (uint8_t *)state->boot_flash_window;
        region->base = state->profile->boot_base;
        region->size = state->profile->boot_window_size;
        region->name = "boot";
    } else if (address >= state->profile->app_base && address < (state->profile->app_base + state->profile->app_window_size)) {
        region->data = (uint8_t *)state->app_flash_window;
        region->base = state->profile->app_base;
        region->size = state->profile->app_window_size;
        region->name = "app";
    } else if (address >= state->profile->app2_base && address < (state->profile->app2_base + state->profile->app2_window_size)) {
        region->data = (uint8_t *)state->app2_flash_window;
        region->base = state->profile->app2_base;
        region->size = state->profile->app2_window_size;
        region->name = "app2";
    } else if (address < state->profile->app_window_size) {
        region->data = (uint8_t *)state->app_flash_window;
        region->base = state->profile->app_base;
        region->size = state->profile->app_window_size;
        region->name = "app";
    } else {
        return -ERANGE;
    }

    region_base = region->base;
    region_size = region->size;

    if (address < region_size) {
        normalized = address;
    } else if (address >= region_base) {
        normalized = address - region_base;
    } else {
        return -ERANGE;
    }

    if ((size > 0U) && (normalized > (region_size - size))) {
        return -ERANGE;
    }

    *offset = (size_t)normalized;
    return 0;
}

void device_state_init(struct device_state *state)
{
    memset(state, 0, sizeof(*state));
    state->profile = &g_pk4_profile;
    set_last_program_region(state, "none");
    device_state_erase_flash(state);
    device_state_reset(state);
}

void device_state_reset(struct device_state *state)
{
    state->debug_mode = false;
    state->halted = false;
    state->pc = state->profile->reset_vector;
}

void device_state_halt(struct device_state *state)
{
    state->debug_mode = true;
    state->halted = true;
}

void device_state_run(struct device_state *state)
{
    state->debug_mode = true;
    state->halted = false;
}

void device_state_step(struct device_state *state)
{
    state->debug_mode = true;
    state->halted = true;
    state->pc += 2U;
}

void device_state_set_pc(struct device_state *state, uint32_t pc)
{
    state->pc = pc;
}

uint32_t device_state_get_pc(const struct device_state *state)
{
    return state->pc;
}

void device_state_erase_flash(struct device_state *state)
{
    memset(state->boot_flash_window, 0xFF, sizeof(state->boot_flash_window));
    memset(state->app_flash_window, 0xFF, sizeof(state->app_flash_window));
    memset(state->app2_flash_window, 0xFF, sizeof(state->app2_flash_window));
    set_last_program_region(state, "chip-erase");
}

int device_state_write_flash(struct device_state *state, uint32_t address, const uint8_t *data, size_t size)
{
    struct flash_region_view region;
    size_t offset;

    if (translate_flash_address(state, address, size, &region, &offset) != 0) {
        return -ERANGE;
    }

    memcpy(&region.data[offset], data, size);
    set_last_program_region(state, region.name);
    return 0;
}

int device_state_read_flash(const struct device_state *state, uint32_t address, uint8_t *data, size_t size)
{
    struct flash_region_view region;
    size_t offset;

    if (translate_flash_address(state, address, size, &region, &offset) != 0) {
        return -ERANGE;
    }

    memcpy(data, &region.data[offset], size);
    ((struct device_state *)state)->last_program_region[0] = '\0';
    ((struct device_state *)state)->last_program_role[0] = '\0';
    set_last_program_region((struct device_state *)state, region.name);
    return 0;
}

int device_state_write_primary_slot(struct device_state *state, uint32_t offset, const uint8_t *data, size_t size)
{
    return device_state_write_flash(state, state->profile->app_base + offset, data, size);
}

int device_state_read_primary_slot(const struct device_state *state, uint32_t offset, uint8_t *data, size_t size)
{
    return device_state_read_flash(state, state->profile->app_base + offset, data, size);
}

int device_state_write_secondary_slot(struct device_state *state, uint32_t offset, const uint8_t *data, size_t size)
{
    return device_state_write_flash(state, state->profile->app2_base + offset, data, size);
}

int device_state_read_secondary_slot(const struct device_state *state, uint32_t offset, uint8_t *data, size_t size)
{
    return device_state_read_flash(state, state->profile->app2_base + offset, data, size);
}

const struct device_state_profile *device_state_get_profile(const struct device_state *state)
{
    return state->profile;
}

const char *device_state_get_family(const struct device_state *state)
{
    return state->profile->family;
}

const char *device_state_get_profile_name(const struct device_state *state)
{
    return state->profile->name;
}

uint32_t device_state_get_flash_window_base(const struct device_state *state)
{
    return state->profile->boot_base;
}

uint32_t device_state_get_boot_window_size(const struct device_state *state)
{
    return state->profile->boot_window_size;
}

uint32_t device_state_get_app_window_base(const struct device_state *state)
{
    return state->profile->app_base;
}

uint32_t device_state_get_app_window_size(const struct device_state *state)
{
    return state->profile->app_window_size;
}

uint32_t device_state_get_app2_window_base(const struct device_state *state)
{
    return state->profile->app2_base;
}

uint32_t device_state_get_app2_window_size(const struct device_state *state)
{
    return state->profile->app2_window_size;
}

const char *device_state_get_status_value(struct device_state *state, const char *key)
{
    if (strcmp(key, "Family") == 0) {
        return state->profile->family;
    }
    if (strcmp(key, "Probe Profile") == 0) {
        return state->profile->name;
    }
    if (strcmp(key, "Boot Base") == 0) {
        snprintf(state->status_value, sizeof(state->status_value), "0x%08X", state->profile->boot_base);
        return state->status_value;
    }
    if (strcmp(key, "App Base") == 0) {
        snprintf(state->status_value, sizeof(state->status_value), "0x%08X", state->profile->app_base);
        return state->status_value;
    }
    if (strcmp(key, "App2 Base") == 0) {
        snprintf(state->status_value, sizeof(state->status_value), "0x%08X", state->profile->app2_base);
        return state->status_value;
    }
    if (strcmp(key, "Reset Vector") == 0) {
        snprintf(state->status_value, sizeof(state->status_value), "0x%08X", state->profile->reset_vector);
        return state->status_value;
    }
    if (strcmp(key, "App2 Reset Vector") == 0) {
        snprintf(state->status_value, sizeof(state->status_value), "0x%08X", state->profile->app2_reset_vector);
        return state->status_value;
    }
    if (strcmp(key, "Initial SP") == 0) {
        snprintf(state->status_value, sizeof(state->status_value), "0x%08X", state->profile->initial_sp);
        return state->status_value;
    }
    if (strcmp(key, "App2 Initial SP") == 0) {
        snprintf(state->status_value, sizeof(state->status_value), "0x%08X", state->profile->app2_initial_sp);
        return state->status_value;
    }
    if (strcmp(key, "Boot Window Size") == 0) {
        snprintf(state->status_value, sizeof(state->status_value), "0x%X", state->profile->boot_window_size);
        return state->status_value;
    }
    if (strcmp(key, "App Window Size") == 0) {
        snprintf(state->status_value, sizeof(state->status_value), "0x%X", state->profile->app_window_size);
        return state->status_value;
    }
    if (strcmp(key, "App2 Window Size") == 0) {
        snprintf(state->status_value, sizeof(state->status_value), "0x%X", state->profile->app2_window_size);
        return state->status_value;
    }
    if (strcmp(key, "Secondary Role") == 0) {
        return state->profile->secondary_role;
    }
    if (strcmp(key, "Secondary Identity") == 0) {
        return state->profile->secondary_identity;
    }
    if (strcmp(key, "Primary Role") == 0) {
        return region_role(state, "app");
    }
    if (strcmp(key, "Execution Slot") == 0) {
        return slot_name_for_pc(state);
    }
    if (strcmp(key, "Execution Role") == 0) {
        return region_role(state, slot_name_for_pc(state));
    }
    if (strcmp(key, "Last Program Region") == 0) {
        return state->last_program_region;
    }
    if (strcmp(key, "Last Program Role") == 0) {
        return state->last_program_role;
    }
    if (strcmp(key, "Architecture") == 0) {
        return PK4_OBS_ARCH_CORTEX_M ? "arm-cortex-m" : "unknown";
    }
    return NULL;
}
```

## src/device_state.h
```c
#ifndef ZEPHYR_PICKIT4_REPLACEMENT_DEVICE_STATE_H_
#define ZEPHYR_PICKIT4_REPLACEMENT_DEVICE_STATE_H_

#include <stdbool.h>
#include <stddef.h>
#include <stdint.h>

#define DEVICE_STATE_BOOT_WINDOW_SIZE (48U * 1024U)
#define DEVICE_STATE_APP_WINDOW_SIZE  (64U * 1024U)
#define DEVICE_STATE_APP2_WINDOW_SIZE (160U * 1024U)

struct device_state_profile {
    const char *name;
    const char *family;
    const char *secondary_role;
    const char *secondary_identity;
    uint32_t boot_base;
    uint32_t app_base;
    uint32_t app2_base;
    uint32_t initial_sp;
    uint32_t reset_vector;
    uint32_t app2_initial_sp;
    uint32_t app2_reset_vector;
    uint32_t boot_window_size;
    uint32_t app_window_size;
    uint32_t app2_window_size;
};

struct device_state {
    const struct device_state_profile *profile;
    bool debug_mode;
    bool halted;
    uint32_t pc;
    uint8_t boot_flash_window[DEVICE_STATE_BOOT_WINDOW_SIZE];
    uint8_t app_flash_window[DEVICE_STATE_APP_WINDOW_SIZE];
    uint8_t app2_flash_window[DEVICE_STATE_APP2_WINDOW_SIZE];
    char status_value[48];
    char last_program_region[16];
    char last_program_role[40];
};

void device_state_init(struct device_state *state);
void device_state_reset(struct device_state *state);
void device_state_halt(struct device_state *state);
void device_state_run(struct device_state *state);
void device_state_step(struct device_state *state);
void device_state_set_pc(struct device_state *state, uint32_t pc);
uint32_t device_state_get_pc(const struct device_state *state);
void device_state_erase_flash(struct device_state *state);
int device_state_write_flash(struct device_state *state, uint32_t address, const uint8_t *data, size_t size);
int device_state_read_flash(const struct device_state *state, uint32_t address, uint8_t *data, size_t size);
int device_state_write_primary_slot(struct device_state *state, uint32_t offset, const uint8_t *data, size_t size);
int device_state_read_primary_slot(const struct device_state *state, uint32_t offset, uint8_t *data, size_t size);
int device_state_write_secondary_slot(struct device_state *state, uint32_t offset, const uint8_t *data, size_t size);
int device_state_read_secondary_slot(const struct device_state *state, uint32_t offset, uint8_t *data, size_t size);
const struct device_state_profile *device_state_get_profile(const struct device_state *state);
const char *device_state_get_family(const struct device_state *state);
const char *device_state_get_profile_name(const struct device_state *state);
uint32_t device_state_get_boot_window_base(const struct device_state *state);
uint32_t device_state_get_boot_window_size(const struct device_state *state);
uint32_t device_state_get_app_window_base(const struct device_state *state);
uint32_t device_state_get_app_window_size(const struct device_state *state);
uint32_t device_state_get_app2_window_base(const struct device_state *state);
uint32_t device_state_get_app2_window_size(const struct device_state *state);
const char *device_state_get_status_value(struct device_state *state, const char *key);

#endif
```

## src/pk4_observed_firmware_profile.h
```c
#ifndef ZEPHYR_PICKIT4_REPLACEMENT_PK4_OBSERVED_FIRMWARE_PROFILE_H_
#define ZEPHYR_PICKIT4_REPLACEMENT_PK4_OBSERVED_FIRMWARE_PROFILE_H_

#include <stdint.h>

/*
 * Clean-room summary of the vendored PK4 boot/app blobs.
 * These constants are derived from observed Intel HEX layout and vector tables,
 * not from copied vendor source.
 */

#define PK4_OBS_BOOT_BASE           0x00400000U
#define PK4_OBS_APP_BASE            0x0040C000U
#define PK4_OBS_APP2_BASE           0x00500000U

#define PK4_OBS_BOOT_INITIAL_SP     0x2040DC08U
#define PK4_OBS_BOOT_RESET_VECTOR   0x004001ADU

#define PK4_OBS_APP_INITIAL_SP      0x20449460U
#define PK4_OBS_APP_RESET_VECTOR    0x0040E8ADU

#define PK4_OBS_APP2_INITIAL_SP     0x2040A910U
#define PK4_OBS_APP2_RESET_VECTOR   0x00504189U

#define PK4_OBS_RAM_REGION_BASE     0x20400000U
#define PK4_OBS_ARCH_CORTEX_M       1U
#define PK4_OBS_APP2_IDENTITY       "MPLAB PICkit 4 CMSIS-DAP"

#endif
```

## src/pk4_recovered_project.c
```c
#include "pk4_recovered_project.h"

#include <errno.h>

static const char *const g_boot_role = "boot strap slot";
static const char *const g_primary_role = "RI4 host-facing app slot";
static const char *const g_boot_identity = "PK4 observed boot image";
static const char *const g_primary_identity = "PK4 observed primary RI4 app";

void pk4_recovered_project_init(struct pk4_recovered_project *project, const struct device_state *state)
{
    const struct device_state_profile *profile = device_state_get_profile(state);

    project->name = "pk4_cleanroom_recovery_project";
    project->target_family = profile->family;
    project->boot.kind = PK4_RECOVERED_SLOT_BOOT;
    project->boot.name = "boot";
    project->boot.role = g_boot_role;
    project->boot.identity = g_boot_identity;
    project->boot.base = profile->boot_base;
    project->boot.window_size = profile->boot_window_size;
    project->boot.initial_sp = 0U;
    project->boot.reset_vector = 0U;

    project->primary_app.kind = PK4_RECOVERED_SLOT_PRIMARY_APP;
    project->primary_app.name = "app";
    project->primary_app.role = g_primary_role;
    project->primary_app.identity = g_primary_identity;
    project->primary_app.base = profile->app_base;
    project->primary_app.window_size = profile->app_window_size;
    project->primary_app.initial_sp = profile->initial_sp;
    project->primary_app.reset_vector = profile->reset_vector;

    project->secondary_app.kind = PK4_RECOVERED_SLOT_SECONDARY_APP;
    project->secondary_app.name = "app2";
    project->secondary_app.role = profile->secondary_role;
    project->secondary_app.identity = profile->secondary_identity;
    project->secondary_app.base = profile->app2_base;
    project->secondary_app.window_size = profile->app2_window_size;
    project->secondary_app.initial_sp = profile->app2_initial_sp;
    project->secondary_app.reset_vector = profile->app2_reset_vector;
}

const struct pk4_recovered_slot_descriptor *pk4_recovered_project_get_slot(
    const struct pk4_recovered_project *project,
    enum pk4_recovered_slot_kind kind
)
{
    switch (kind) {
    case PK4_RECOVERED_SLOT_BOOT:
        return &project->boot;
    case PK4_RECOVERED_SLOT_PRIMARY_APP:
        return &project->primary_app;
    case PK4_RECOVERED_SLOT_SECONDARY_APP:
        return &project->secondary_app;
    default:
        return NULL;
    }
}

int pk4_recovered_project_write_slot(
    struct device_state *state,
    enum pk4_recovered_slot_kind kind,
    uint32_t offset,
    const uint8_t *data,
    size_t size
)
{
    switch (kind) {
    case PK4_RECOVERED_SLOT_BOOT:
        return device_state_write_flash(state, device_state_get_boot_window_base(state) + offset, data, size);
    case PK4_RECOVERED_SLOT_PRIMARY_APP:
        return device_state_write_primary_slot(state, offset, data, size);
    case PK4_RECOVERED_SLOT_SECONDARY_APP:
        return device_state_write_secondary_slot(state, offset, data, size);
    default:
        return -EINVAL;
    }
}

int pk4_recovered_project_read_slot(
    const struct device_state *state,
    enum pk4_recovered_slot_kind kind,
    uint32_t offset,
    uint8_t *data,
    size_t size
)
{
    switch (kind) {
    case PK4_RECOVERED_SLOT_BOOT:
        return device_state_read_flash(state, device_state_get_boot_window_base(state) + offset, data, size);
    case PK4_RECOVERED_SLOT_PRIMARY_APP:
        return device_state_read_primary_slot(state, offset, data, size);
    case PK4_RECOVERED_SLOT_SECONDARY_APP:
        return device_state_read_secondary_slot(state, offset, data, size);
    default:
        return -EINVAL;
    }
}
```

## src/script_dispatch.c
```c
#include "script_dispatch.h"

#include <errno.h>
#include <string.h>

#include <zephyr/logging/log.h>

#include "ri4_family_catalog.h"

LOG_MODULE_REGISTER(script_dispatch, LOG_LEVEL_INF);

#define STUB_MAGIC0 0x5AU
#define STUB_MAGIC1 0xA5U

enum stub_script_opcode {
    STUB_OP_ENTER_DEBUG_MODE = 0x10,
    STUB_OP_GET_PC = 0x11,
    STUB_OP_SET_PC = 0x12,
    STUB_OP_RUN = 0x13,
    STUB_OP_HALT = 0x14,
    STUB_OP_SINGLE_STEP = 0x15,
    STUB_OP_SINGLE_STEP_UFEX = 0x16,
    STUB_OP_ERASE_CHIP = 0x20,
    STUB_OP_WRITE_PROGMEM = 0x21,
    STUB_OP_READ_PROGMEM = 0x22,
    STUB_OP_WRITE_PRIMARY_SLOT = 0x23,
    STUB_OP_READ_PRIMARY_SLOT = 0x24,
    STUB_OP_WRITE_SECONDARY_SLOT = 0x25,
    STUB_OP_READ_SECONDARY_SLOT = 0x26,
    STUB_OP_ENTER_TMOD_LV = 0x30,
    STUB_OP_EXIT_TMOD = 0x31,
    STUB_OP_NOOP = 0x7F,
};

struct script_call {
    uint32_t param_size;
    uint32_t script_size;
    const uint8_t *params;
    const uint8_t *script_bytes;
};

static uint32_t read_le32(const uint8_t *buffer)
{
    return ((uint32_t)buffer[0]) |
           ((uint32_t)buffer[1] << 8) |
           ((uint32_t)buffer[2] << 16) |
           ((uint32_t)buffer[3] << 24);
}

static int parse_script_call(const uint8_t *payload, size_t payload_length, struct script_call *call)
{
    if (payload_length < 8U) {
        return -EINVAL;
    }
    call->param_size = read_le32(payload);
    call->script_size = read_le32(payload + 4U);
    if ((size_t)(8U + call->param_size + call->script_size) > payload_length) {
        return -EINVAL;
    }
    call->params = payload + 8U;
    call->script_bytes = call->params + call->param_size;
    return 0;
}

static uint8_t detect_opcode(const struct script_call *call)
{
    if (call->script_size >= 3U &&
        call->script_bytes[0] == STUB_MAGIC0 &&
        call->script_bytes[1] == STUB_MAGIC1) {
        return call->script_bytes[2];
    }
    return STUB_OP_NOOP;
}

static uint32_t first_param_u32(const struct script_call *call, uint32_t fallback)
{
    if (call->param_size < 4U) {
        return fallback;
    }
    return read_le32(call->params);
}

static uint32_t second_param_u32(const struct script_call *call, uint32_t fallback)
{
    if (call->param_size < 8U) {
        return fallback;
    }
    return read_le32(call->params + 4U);
}

static void erase_flash(struct device_state *state)
{
    device_state_erase_flash(state);
}

static void seed_default_upload(struct device_state *state, size_t requested_upload_length, struct script_dispatch_result *result)
{
    size_t produced = requested_upload_length;

    if (produced > sizeof(result->upload_data)) {
        produced = sizeof(result->upload_data);
    }

    memset(result->upload_data, 0, produced);
    if (produced >= sizeof(uint32_t)) {
        uint32_t pc = device_state_get_pc(state);
        memcpy(result->upload_data, &pc, sizeof(pc));
    }
    result->upload_length = produced;
}

int script_dispatch_execute(
    struct device_state *state,
    enum script_dispatch_mode mode,
    const uint8_t *script_payload,
    size_t script_length,
    const uint8_t *download_payload,
    size_t download_length,
    size_t requested_upload_length,
    struct script_dispatch_result *result
)
{
    struct script_call call;
    uint8_t opcode;
    uint32_t address;
    uint32_t size;

    memset(result, 0, sizeof(*result));

    if (parse_script_call(script_payload, script_length, &call) != 0) {
        result->status = 1U;
        return -EINVAL;
    }

    opcode = detect_opcode(&call);

    switch (opcode) {
    case STUB_OP_ENTER_DEBUG_MODE:
    case STUB_OP_ENTER_TMOD_LV:
        device_state_halt(state);
        return 0;
    case STUB_OP_EXIT_TMOD:
        device_state_run(state);
        return 0;
    case STUB_OP_GET_PC:
        if (mode != SCRIPT_DISPATCH_UPLOAD) {
            result->status = 1U;
            return -EINVAL;
        }
        seed_default_upload(state, requested_upload_length, result);
        return 0;
    case STUB_OP_SET_PC:
        device_state_set_pc(state, first_param_u32(&call, 0U));
        device_state_halt(state);
        return 0;
    case STUB_OP_RUN:
        device_state_run(state);
        return 0;
    case STUB_OP_HALT:
        device_state_halt(state);
        return 0;
    case STUB_OP_SINGLE_STEP:
    case STUB_OP_SINGLE_STEP_UFEX:
        device_state_step(state);
        return 0;
    case STUB_OP_ERASE_CHIP:
        erase_flash(state);
        return 0;
    case STUB_OP_WRITE_PROGMEM:
        if (mode != SCRIPT_DISPATCH_DOWNLOAD || download_payload == NULL) {
            result->status = 1U;
            return -EINVAL;
        }
        address = first_param_u32(&call, 0U);
        if (device_state_write_flash(state, address, download_payload, download_length) != 0) {
            result->status = 1U;
            return -EINVAL;
        }
        LOG_INF("%s WriteProgmem addr=0x%08X size=%u region=%s role=%s",
            device_state_get_profile_name(state),
            (unsigned int)address,
            (unsigned int)download_length,
            device_state_get_status_value(state, "Last Program Region"),
            device_state_get_status_value(state, "Last Program Role"));
        return 0;
    case STUB_OP_READ_PROGMEM:
        if (mode != SCRIPT_DISPATCH_UPLOAD) {
            result->status = 1U;
            return -EINVAL;
        }
        address = first_param_u32(&call, 0U);
        size = second_param_u32(&call, (uint32_t)requested_upload_length);
        if (size > sizeof(result->upload_data)) {
            size = sizeof(result->upload_data);
        }
        if (device_state_read_flash(state, address, result->upload_data, size) != 0) {
            result->status = 1U;
            return -EINVAL;
        }
        result->upload_length = size;
        return 0;
    case STUB_OP_WRITE_PRIMARY_SLOT:
        if (mode != SCRIPT_DISPATCH_DOWNLOAD || download_payload == NULL) {
            result->status = 1U;
            return -EINVAL;
        }
        address = first_param_u32(&call, 0U);
        if (device_state_write_primary_slot(state, address, download_payload, download_length) != 0) {
            result->status = 1U;
            return -EINVAL;
        }
        LOG_INF("%s WritePrimarySlot offset=0x%08X size=%u role=%s",
            device_state_get_profile_name(state),
            (unsigned int)address,
            (unsigned int)download_length,
            device_state_get_status_value(state, "Primary Role"));
        return 0;
    case STUB_OP_READ_PRIMARY_SLOT:
        if (mode != SCRIPT_DISPATCH_UPLOAD) {
            result->status = 1U;
            return -EINVAL;
        }
        address = first_param_u32(&call, 0U);
        size = second_param_u32(&call, (uint32_t)requested_upload_length);
        if (size > sizeof(result->upload_data)) {
            size = sizeof(result->upload_data);
        }
        if (device_state_read_primary_slot(state, address, result->upload_data, size) != 0) {
            result->status = 1U;
            return -EINVAL;
        }
        result->upload_length = size;
        return 0;
    case STUB_OP_WRITE_SECONDARY_SLOT:
        if (mode != SCRIPT_DISPATCH_DOWNLOAD || download_payload == NULL) {
            result->status = 1U;
            return -EINVAL;
        }
        address = first_param_u32(&call, 0U);
        if (device_state_write_secondary_slot(state, address, download_payload, download_length) != 0) {
            result->status = 1U;
            return -EINVAL;
        }
        LOG_INF("%s WriteSecondarySlot offset=0x%08X size=%u role=%s",
            device_state_get_profile_name(state),
            (unsigned int)address,
            (unsigned int)download_length,
            device_state_get_status_value(state, "Secondary Role"));
        return 0;
    case STUB_OP_READ_SECONDARY_SLOT:
        if (mode != SCRIPT_DISPATCH_UPLOAD) {
            result->status = 1U;
            return -EINVAL;
        }
        address = first_param_u32(&call, 0U);
        size = second_param_u32(&call, (uint32_t)requested_upload_length);
        if (size > sizeof(result->upload_data)) {
            size = sizeof(result->upload_data);
        }
        if (device_state_read_secondary_slot(state, address, result->upload_data, size) != 0) {
            result->status = 1U;
            return -EINVAL;
        }
        result->upload_length = size;
        return 0;
    case STUB_OP_NOOP:
    default:
        break;
    }

    if (mode == SCRIPT_DISPATCH_DOWNLOAD && download_payload != NULL && download_length > 0U) {
        if (device_state_write_flash(state, device_state_get_app_window_base(state), download_payload, download_length) != 0) {
            result->status = 1U;
            return -1;
        }
        LOG_INF("Accepted %u bytes of mock program data at app base 0x%08X role=%s",
            (unsigned int)download_length,
            (unsigned int)device_state_get_app_window_base(state),
            device_state_get_status_value(state, "Primary Role"));
        return 0;
    }

    if (mode == SCRIPT_DISPATCH_UPLOAD) {
        seed_default_upload(state, requested_upload_length, result);
        LOG_INF("Returning %u bytes of mock upload data", (unsigned int)result->upload_length);
        return 0;
    }

    LOG_INF("Stub basic script executed for %s; catalog families=%u", device_state_get_family(state), (unsigned int)ri4_family_catalog_count);
    device_state_halt(state);
    return 0;
}
```

## src/usb_transport.c
```c
#include "usb_transport.h"

#include <errno.h>
#include <string.h>

#if defined(CONFIG_USB_DEVICE_STACK) && CONFIG_USB_DEVICE_STACK
#include <zephyr/logging/log.h>
#include <zephyr/sys/util.h>
#include <zephyr/usb/usb_ch9.h>
#include <zephyr/usb/usb_device.h>
#endif

#include "ri4_protocol.h"

#if defined(CONFIG_USB_DEVICE_STACK) && CONFIG_USB_DEVICE_STACK
LOG_MODULE_REGISTER(usb_transport, LOG_LEVEL_INF);

static struct device_state *g_state;
static uint8_t g_side_out[RI4_PACKET_SIZE];
static uint8_t g_data_out[RI4_PACKET_SIZE];
static size_t g_data_out_length;

static int handle_side_out(size_t length)
{
    struct ri4_response response;
    int rc;

    rc = ri4_handle_side_packet(g_state, g_side_out, length, g_data_out, g_data_out_length, &response);
    if (rc != 0) {
        LOG_ERR("RI4 side packet handling failed: %d", rc);
        return rc;
    }
    if (response.side_length > 0U) {
        (void)usb_write(RI4_SIDE_EP_IN, response.side_data, response.side_length, NULL);
    }
    if (response.data_length > 0U) {
        (void)usb_write(RI4_DATA_EP_IN, response.data_payload, response.data_length, NULL);
    }
    return 0;
}

static void side_out_cb(uint8_t ep, enum usb_dc_ep_cb_status_code status)
{
    uint32_t read = 0U;

    ARG_UNUSED(status);
    if (usb_read(ep, g_side_out, sizeof(g_side_out), &read) != 0) {
        LOG_ERR("usb_read failed on RI4 side OUT endpoint");
        return;
    }
    if (read > 0U) {
        (void)handle_side_out((size_t)read);
    }
}

static void data_out_cb(uint8_t ep, enum usb_dc_ep_cb_status_code status)
{
    uint32_t read = 0U;

    ARG_UNUSED(status);
    if (usb_read(ep, g_data_out, sizeof(g_data_out), &read) != 0) {
        LOG_ERR("usb_read failed on RI4 data OUT endpoint");
        return;
    }
    g_data_out_length = (size_t)read;
}

static struct usb_ep_cfg_data ep_cfg[] = {
    {
        .ep_cb = side_out_cb,
        .ep_addr = RI4_SIDE_EP_OUT,
    },
    {
        .ep_cb = data_out_cb,
        .ep_addr = RI4_DATA_EP_OUT,
    },
};

USBD_CLASS_DESCR_DEFINE(primary, 0) struct usb_if_descriptor ri4_if_desc = {
    .bLength = sizeof(struct usb_if_descriptor),
    .bDescriptorType = USB_DESC_INTERFACE,
    .bInterfaceNumber = 0,
    .bAlternateSetting = 0,
    .bNumEndpoints = 4,
    .bInterfaceClass = USB_BCC_VENDOR,
    .bInterfaceSubClass = 0,
    .bInterfaceProtocol = 0,
    .iInterface = 0,
};

USBD_CLASS_DESCR_DEFINE(primary, 1) struct usb_ep_descriptor ri4_side_out_desc = {
    .bLength = sizeof(struct usb_ep_descriptor),
    .bDescriptorType = USB_DESC_ENDPOINT,
    .bEndpointAddress = RI4_SIDE_EP_OUT,
    .bmAttributes = USB_DC_EP_BULK,
    .wMaxPacketSize = sys_cpu_to_le16(RI4_PACKET_SIZE),
    .bInterval = 0,
};

USBD_CLASS_DESCR_DEFINE(primary, 2) struct usb_ep_descriptor ri4_side_in_desc = {
    .bLength = sizeof(struct usb_ep_descriptor),
    .bDescriptorType = USB_DESC_ENDPOINT,
    .bEndpointAddress = RI4_SIDE_EP_IN,
    .bmAttributes = USB_DC_EP_BULK,
    .wMaxPacketSize = sys_cpu_to_le16(RI4_PACKET_SIZE),
    .bInterval = 0,
};

USBD_CLASS_DESCR_DEFINE(primary, 3) struct usb_ep_descriptor ri4_data_out_desc = {
    .bLength = sizeof(struct usb_ep_descriptor),
    .bDescriptorType = USB_DESC_ENDPOINT,
    .bEndpointAddress = RI4_DATA_EP_OUT,
    .bmAttributes = USB_DC_EP_BULK,
    .wMaxPacketSize = sys_cpu_to_le16(RI4_PACKET_SIZE),
    .bInterval = 0,
};

USBD_CLASS_DESCR_DEFINE(primary, 4) struct usb_ep_descriptor ri4_data_in_desc = {
    .bLength = sizeof(struct usb_ep_descriptor),
    .bDescriptorType = USB_DESC_ENDPOINT,
    .bEndpointAddress = RI4_DATA_EP_IN,
    .bmAttributes = USB_DC_EP_BULK,
    .wMaxPacketSize = sys_cpu_to_le16(RI4_PACKET_SIZE),
    .bInterval = 0,
};

static void status_cb(enum usb_dc_status_code status, const uint8_t *param)
{
    ARG_UNUSED(param);
    LOG_INF("USB status: %d", status);
}

static struct usb_cfg_data usb_config = {
    .usb_device_description = NULL,
    .interface = {
        .class_handler = NULL,
        .custom_handler = NULL,
        .vendor_handler = NULL,
    },
    .num_endpoints = ARRAY_SIZE(ep_cfg),
    .endpoint = ep_cfg,
    .cb_usb_status = status_cb,
};

int ri4_usb_transport_init(struct device_state *state)
{
    int rc;

    g_state = state;
    g_data_out_length = 0U;
    memset(g_side_out, 0, sizeof(g_side_out));
    memset(g_data_out, 0, sizeof(g_data_out));

    rc = usb_enable(&usb_config);
    if (rc != 0) {
        LOG_ERR("usb_enable failed: %d", rc);
        return rc;
    }

    LOG_INF("RI4 USB transport initialized");
    return 0;
}
#else
int ri4_usb_transport_init(struct device_state *state)
{
    ARG_UNUSED(state);
    return -ENOTSUP;
}
#endif
```
